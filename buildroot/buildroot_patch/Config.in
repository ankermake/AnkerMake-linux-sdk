## buildroot/buildroot_patch/Config.in
```kconfig
menuconfig APP_br
    bool "buidroot 相关配置"
    default y

menu "rootfs 相关配置"

source rootfs_config/sh_utils.in
source rootfs_config/log_in_tty.in
source rootfs_config/adb_server.in
source rootfs_config/ubi.in
source rootfs_config/jffs2.in
source rootfs_config/mmc.in
source rootfs_config/sdcard.in
source rootfs_config/mass_storage.in
source rootfs_config/h264_server.in
source rootfs_config/usb_storage.in
source rootfs_config/display_logo.in
source rootfs_config/usb_mtp_server.in
source rootfs_config/asound_conf_dmix.in

endmenu # "rootfs 相关配置"

menu "软件包相关配置"

endmenu

endmenu # APP_br
```

## kernel/kernel-x1000/arch/mips/xburst/soc-x1000/chip-x1000/Kconfig
```kconfig
choice
	prompt "Board type"
	depends on CHIP_X1000
	default PRODUCT_X1000_PHOENIX

config  PRODUCT_X1000_PHOENIX
    bool "product x1000 phoenix"

config	PRODUCT_X1000_HALLEY2
	bool "product x1000 halley2"

config  PRODUCT_X1000_CANNA
    bool "product x1000 canna"

config	PRODUCT_X1000_PANSY
	bool "product x1000 pansy"

config	PRODUCT_X1000_D0085
	bool "product x1000 d0085"

config	PRODUCT_X1000_D0038
	bool "product x1000 d0038"

config	PRODUCT_X1000_D00129
	bool "product x1000 d00129"

config	PRODUCT_X1000_MODULE_BASE
	bool "product x1000 module base"

endchoice

if PRODUCT_X1000_PHOENIX
config PRODUCT_NAME
string
default "phoenix"
source "arch/mips/xburst/soc-x1000/chip-x1000/phoenix/Kconfig"
endif

if PRODUCT_X1000_CANNA
config PRODUCT_NAME
string
default "canna"
source "arch/mips/xburst/soc-x1000/chip-x1000/canna/Kconfig"
endif

if PRODUCT_X1000_HALLEY2
config PRODUCT_NAME
string
default "halley2"
source "arch/mips/xburst/soc-x1000/chip-x1000/halley2/Kconfig"
endif

if PRODUCT_X1000_PANSY
config PRODUCT_NAME
string
default "pansy"
source "arch/mips/xburst/soc-x1000/chip-x1000/pansy/Kconfig"
endif

if PRODUCT_X1000_D0085
config PRODUCT_NAME
string
default "d0085"
source "arch/mips/xburst/soc-x1000/chip-x1000/d0085/Kconfig"
endif

if PRODUCT_X1000_D0038
config PRODUCT_NAME
string
default "d0038"
source "arch/mips/xburst/soc-x1000/chip-x1000/d0038/Kconfig"
endif

if PRODUCT_X1000_D00129
config PRODUCT_NAME
string
default "d00129"
source "arch/mips/xburst/soc-x1000/chip-x1000/d00129/Kconfig"
endif

if PRODUCT_X1000_MODULE_BASE
config PRODUCT_NAME
string
default "module_base"
source "arch/mips/xburst/soc-x1000/chip-x1000/module_base/Kconfig"
endif
```

## kernel/kernel-x1000/arch/mips/xburst/soc-x1000/chip-x1000/canna/Kconfig
```kconfig
choice

prompt "BOARD version"
depends on PRODUCT_X1000_CANNA
default BOARD_X1000_CANNA_V23

config BOARD_X1000_CANNA_V23
bool "board x1000 canna v23"
depends on PRODUCT_X1000_CANNA

config BOARD_X1000_CANNA_V21
bool "board x1000 canna v21"
depends on PRODUCT_X1000_CANNA


endchoice

config BOARD_NAME
string
default "canna_v23" if BOARD_X1000_CANNA_V23
default "canna_v21" if BOARD_X1000_CANNA_V21
```

## kernel/kernel-x1000/arch/mips/xburst/soc-x1000/chip-x1000/d00129/Kconfig
```kconfig
choice

prompt "BOARD version"
depends on PRODUCT_X1000_D00129
default BOARD_X1000_D00129_V10

config BOARD_X1000_D00129_V10
bool "board x1000 d00129 v10"
depends on PRODUCT_X1000_D00129

endchoice

config BOARD_NAME
string
default "d00129_v10" if BOARD_X1000_D00129_V10
```

## kernel/kernel-x1000/arch/mips/xburst/soc-x1000/chip-x1000/d0038/Kconfig
```kconfig
choice
	prompt "BOARD version"
	depends on PRODUCT_X1000_D0038
	default BOARD_X1000_D0038_V10

config BOARD_X1000_D0038_V10
	bool "board x1000 d0038 v10"
	depends on PRODUCT_X1000_D0038
endchoice

config BOARD_NAME
	string
	default "d0038_v10" if BOARD_X1000_D0038_V10
```

## kernel/kernel-x1000/arch/mips/xburst/soc-x1000/chip-x1000/d0085/Kconfig
```kconfig
choice

prompt "BOARD version"
depends on PRODUCT_X1000_D0085
default BOARD_X1000_D0085_V10

config BOARD_X1000_D0085_V10
bool "board x1000 d0085 v10"
depends on PRODUCT_X1000_D0085

endchoice

config BOARD_NAME
string
default "d0085_v10" if BOARD_X1000_D0085_V10
```

## kernel/kernel-x1000/arch/mips/xburst/soc-x1000/chip-x1000/module_base/Kconfig
```kconfig
choice
prompt "Ext BOARD version"
depends on PRODUCT_X1000_MODULE_BASE
default BOARD_X1000_MODULE_BASE_BOARD0

config BOARD_X1000_MODULE_BASE_BOARD0
bool "board0"
depends on PRODUCT_X1000_MODULE_BASE

endchoice

config BOARD_NAME
string
default "board0" if BOARD_X1000_MODULE_BASE_BOARD0
```

## kernel/kernel-x1000/arch/mips/xburst/soc-x1520/Kconfig
```kconfig
choice
	prompt "Chip type"
	depends on SOC_X1520
	default CHIP_X1520

config CHIP_X1520
	bool "chip-x1520"
	select TRACEPOINTS
	select SYS_SUPPORTS_HIGHMEM
	select GENERIC_CLOCKEVENTS_BROADCAST

endchoice
```

## kernel/kernel-x1000/arch/mips/xburst/soc-x1630/chip-x1630/Kconfig
```kconfig
choice
	prompt "Platform type"
	depends on CHIP_X1630
	default PLATFORM_X1630_ISVP

config PLATFORM_X1630_ISVP
	bool "isvp"

endchoice

config PRODUCT_NAME
	string
	default "isvp" if PLATFORM_X1630_ISVP

if PLATFORM_X1630_ISVP
source "arch/mips/xburst/soc-x1630/chip-x1630/isvp/Kconfig"
endif
```

## kernel/kernel-x1000/arch/mips/xburst/soc-x1630/chip-x1630/isvp/Kconfig
```kconfig
choice
	prompt "Board type"
	depends on PLATFORM_X1630_ISVP
	default BOARD_GOLD

config BOARD_GOLD
       bool "gold"
       depends on PLATFORM_X1630_ISVP

endchoice

config BOARD_NAME
	string
	default "gold" if BOARD_GOLD
```

## kernel/kernel-x1000/arch/mips/xburst/soc-x1830/Kconfig
```kconfig
choice
	prompt "Chip type"
	depends on SOC_X1830
	default CHIP_X1830

config CHIP_X1830
       bool "chip-x1830"
       select TRACEPOINTS
       select SYS_SUPPORTS_HIGHMEM
       select GENERIC_CLOCKEVENTS_BROADCAST

endchoice

if CHIP_X1830
#source "arch/mips/xburst/soc-x1830/chip-x1830/Kconfig"
endif
```

## kernel/kernel-x1000/drivers/media/i2c/tx-isp-camera-v120/Kconfig
```kconfig
comment "tx-isp camera sensor drivers v120"


config TX_ISP_CAMERA_SC2235
	tristate "sc2235 camera support"
	depends on I2C && VIDEO_TX_ISP_V120
	help
	  This is a tx-isp camera driver for the sc2235 sensor

config TX_ISP_CAMERA_OV9732
	tristate "ov9732 camera support"
	depends on I2C && VIDEO_TX_ISP_V120
	help
	  This is a tx-isp camera driver for the ov9732 sensor

config TX_ISP_CAMERA_GC2375A
	tristate "gc2375a camera support"
	depends on I2C && VIDEO_TX_ISP_V120
	help
	  This is a tx-isp camera driver for the gc2375a sensor

config TX_ISP_CAMERA_OV9281_DVP
	tristate "ov9281 dvp camera support"
	depends on I2C && VIDEO_TX_ISP_V120
	help
	  This is a tx-isp camera driver for the ov9281 sensor

config TX_ISP_CAMERA_OV9281_MIPI
	tristate "ov9281 mipi camera support"
	depends on I2C && VIDEO_TX_ISP_V120
	help
	  This is a tx-isp camera driver for the ov9281 sensor
if TX_ISP_CAMERA_OV9281_MIPI
	choice
	    prompt "ov9281 mipi resolution select"
	    default OV9281_MIPI_1280X720

	    config OV9281_MIPI_1280X800
			bool "1280*800"

	    config OV9281_MIPI_1280X720
			bool "1280*720"

	    config OV9281_MIPI_640X480
			bool "640*480"

		config OV9281_MIPI_640X400
			bool "640*400"
	endchoice
endif	  

config TX_ISP_CAMERA_SC031GS
	tristate "sc031gs camera support"
	depends on I2C && VIDEO_TX_ISP_V120
	help
	  This is a tx-isp camera driver for the sc031gs sensor

config TX_ISP_CAMERA_TW9912
	tristate "tw9912 camera support"
	depends on I2C && VIDEO_TX_ISP_V120
	help
	  This is a tx-isp camera driver for the tw9912 sensor
	  
config TX_ISP_CAMERA_OV5693
	tristate "ov5693 camera support"
	depends on I2C && VIDEO_TX_ISP_V120
	help
	  This is a tx-isp camera driver for the ov5693 sensor

config TX_ISP_CAMERA_SC132GS
	tristate "sc132gs camera support"
	depends on I2C && VIDEO_TX_ISP_V120
	help
	  This is a tx-isp camera driver for the sc132gs sensor
if TX_ISP_CAMERA_SC132GS
	choice
	    prompt "sc132gs resolution & fps select"
	    default SC123GS_1072X1280_30FPS

	    config SC123GS_1072X1280_30FPS
			bool "1072*1280 30fps"

	    config SC123GS_1072X1280_60FPS
			bool "1072*1280 60fps"
	endchoice
endif	 	  

config TX_ISP_CAMERA_AR0144_MIPI
	tristate "ar0144_mipi camera support"
	depends on I2C && VIDEO_TX_ISP_V120
	help
	  This is a tx-isp camera driver for the ar0144_mipi sensor
```

## kernel/kernel-x1000/drivers/media/i2c/tx-isp-camera-v130/Kconfig
```kconfig
comment "tx-isp camera sensor drivers v130"


config TX_ISP_CAMERA_SC2235
	tristate "sc2235 camera support"
	depends on I2C && VIDEO_TX_ISP_V130
	help
	  This is a tx-isp camera driver for the sc2235 sensor
if TX_ISP_CAMERA_SC2235
	choice
	    prompt "sc2235 resolution select"
	    default SC2235_1920X1080

	    config SC2235_640X1072
			bool "640*1072"

	    config SC2235_1440X1080
			bool "1440*1080"

	    config SC2235_1920X1080
			bool "1920*1080"
	endchoice
endif

config TX_ISP_CAMERA_SC2235_DOUBLE
	tristate "sc2235 double camera support"
	depends on I2C && VIDEO_TX_ISP_V130
	help
	  This is a tx-isp camera driver for the sc2235 double sensor
if TX_ISP_CAMERA_SC2235_DOUBLE
	choice
	    prompt "sc2235 resolution select"
	    default SC2235_DOUBLE_1920X1080

	    config SC2235_DOUBLE_480X800
			bool "480*800"

	    config SC2235_DOUBLE_640X1072
			bool "640*1072"

	    config SC2235_DOUBLE_1920X1080
			bool "1920*1080"
	endchoice
endif

config TX_ISP_CAMERA_GC0328
	tristate "gc0328 camera support"
	depends on I2C && VIDEO_TX_ISP_V130
	help
	  This is a tx-isp camera driver for the gc0328 sensor

config TX_ISP_CAMERA_GC1034
	tristate "gc1034 camera support"
	depends on I2C && VIDEO_TX_ISP_V130
	help
	  This is a tx-isp camera driver for the gc1034 sensor

config TX_ISP_CAMERA_GC2375A
	tristate "gc2375a camera support"
	depends on I2C && VIDEO_TX_ISP_V130
	help
	  This is a tx-isp camera driver for the gc2375a sensor
if TX_ISP_CAMERA_GC2375A
	choice
	    prompt "gc2375a resolution select"
	    default GC2375A_1600X1200

	    config GC2375A_480X800
			bool "480*800"

	    config GC2375A_720X1200
			bool "720*1200"

	    config GC2375A_1600X1200
			bool "1600*1200"
	endchoice
endif

config TX_ISP_CAMERA_GC2385
	tristate "gc2385 camera support"
	depends on I2C && VIDEO_TX_ISP_V130
	help
	  This is a tx-isp camera driver for the gc2385 sensor
if TX_ISP_CAMERA_GC2385
	choice
	    prompt "gc2385 resolution select"
	    default GC2385_1600X1200

	    config GC2385_480X800
			bool "480*800"

	    config GC2385_720X1200
			bool "720*1200"

	    config GC2385_1600X1200
			bool "1600*1200"
	endchoice
endif

config TX_ISP_CAMERA_GC2375A_DOUBLE
	tristate "gc2375a double camera support"
	depends on I2C && VIDEO_TX_ISP_V130
	help
	  This is a tx-isp camera driver for the gc2375a double sensor
if TX_ISP_CAMERA_GC2375A_DOUBLE
	choice
	    prompt "gc2375a resolution select"
	    default GC2375A_DOUBLE_1600X1200

	    config GC2375A_DOUBLE_480X800
			bool "480*800"

	    config GC2375A_DOUBLE_720X1200
			bool "720*1200"

	    config GC2375A_DOUBLE_1600X1200
			bool "1600*1200"
	endchoice
endif

config TX_ISP_CAMERA_OV2735
	tristate "ov2735 camera support"
	depends on I2C && VIDEO_TX_ISP_V130
	help
	  This is a tx-isp camera driver for the ov2735 sensor
if TX_ISP_CAMERA_OV2735
	choice
	    prompt "ov2735 resolution select"
	    default OV2735_1920X1080

	    config OV2735_640X1072
			bool "640*1072"

	    config OV2735_1280X1080
			bool "1280*1080"

	    config OV2735_1440X1080
			bool "1440*1080"

	    config OV2735_1920X1080
			bool "1920*1080"
	endchoice
endif

config TX_ISP_CAMERA_OV9732
	tristate "ov9732 camera support"
	depends on I2C && VIDEO_TX_ISP_V130
	help
	  This is a tx-isp camera driver for the ov9732 sensor
if TX_ISP_CAMERA_OV9732
	choice
	    prompt "ov9732 resolution select"
	    default OV9732_1280X720

	    config OV9732_640X480
			bool "640*480"

	    config OV9732_1280X720
			bool "1280*720"
	endchoice
endif

config TX_ISP_CAMERA_OV7740
	tristate "ov7740 camera support"
	depends on I2C && VIDEO_TX_ISP_V130
	help
	  This is a tx-isp camera driver for the ov7740 sensor

config TX_ISP_CAMERA_JXF37
	tristate "jxf37 camera support"
	depends on I2C && VIDEO_TX_ISP_V130
	help
	  This is a tx-isp camera driver for the jxf37 sensor

config TX_ISP_CAMERA_AR0230
	tristate "ar0230 camera support"
	depends on I2C && VIDEO_TX_ISP_V130
	help
	  This is a tx-isp camera driver for the ar0230 sensor
if TX_ISP_CAMERA_AR0230
	choice
	    prompt "ar0230 resolution select"
	    default AR0230_1920X1080

	    config AR0230_640X1072
			bool "640*1072"

	    config AR0230_1920X1080
			bool "1920*1080"
	endchoice
	choice
	    prompt "ar0230 mode select"
	    default AR0230_LINEAR

	    config AR0230_LINEAR
			bool "linear mode"

	    config AR0230_HDR
			bool "HDR mode"
	endchoice
endif


config TX_ISP_CAMERA_AR0522
	tristate "ar0522 camera support"
	depends on I2C && VIDEO_TX_ISP_V130
	help
	  This is a tx-isp camera driver for the ar0522 sensor
if TX_ISP_CAMERA_AR0522
	choice
	    prompt "ar0522 resolution select"
	    default AR0522_2560X1080

	    config AR0522_2592X1944
			bool "2592X1944"

	    config AR0522_2560X1080
			bool "2560X1080"
	endchoice
endif

config TX_ISP_CAMERA_IMX307
	tristate "imx307 camera support"
	depends on I2C && VIDEO_TX_ISP_V130
	help
	  This is a tx-isp camera driver for the imx307 sensor

config TX_ISP_CAMERA_NEXTCHIP
	tristate "nextchip camera support"
	depends on I2C && VIDEO_TX_ISP_V130
	help
	  This is a tx-isp camera driver for the nextchip sensor

config TX_ISP_CAMERA_AR0144_DVP
	tristate "ar0144 dvp camera support"
	depends on I2C && VIDEO_TX_ISP_V130
	help
	  This is a tx-isp camera driver for the ar0144 sensor

config TX_ISP_CAMERA_AR0144_MIPI
	tristate "ar0144 mipi camera support"
	depends on I2C && VIDEO_TX_ISP_V130
	help
	  This is a tx-isp camera driver for the ar0144 sensor

config TX_ISP_CAMERA_AR0234_MIPI
	tristate "ar0234 mipi camera support"
	depends on I2C && VIDEO_TX_ISP_V130
	help
	  This is a tx-isp camera driver for the ar0234 sensor

config TX_ISP_CAMERA_BF2253L_MIPI
	tristate "bf2253l mipi camera support"
	depends on I2C && VIDEO_TX_ISP_V130
	help
	  This is a tx-isp camera driver for the bf2253l sensor

config TX_ISP_CAMERA_S5K6A1_MIPI
	tristate "s5k6a1 mipi camera support"
	depends on I2C && VIDEO_TX_ISP_V130
	help
	  This is a tx-isp camera driver for the s5k6a1 sensor
```

## kernel/kernel-x1000/drivers/misc/efuse/Kconfig
```kconfig
menuconfig JZ_EFUSE
	bool "ingenic efuse support"
	default n
if JZ_EFUSE
config JZ_EFUSE_WRITE
	bool "Jz efuse write interface support"
	default n
	help
	  Say 'Y' to enable efuse write interface, only enable in
	  slt test or debugging, in other instances,
	  strongly recommended to turn off this option.
endif
```

## kernel/kernel-x1000/drivers/net/wireless/rtl8723ds/Kconfig
```kconfig
config RTL8723DS
	tristate "Realtek 8723D SDIO or SPI WiFi"
	---help---
	  Help message of RTL8723DS

if RTL8723DS
choice
    prompt "select efuse map for rtl8723ds"
    default RTL8723DS_DEFUALT_EFUSE_MAP

config RTL8723DS_DEFUALT_EFUSE_MAP
	bool "default efuse map"

config RTL8723DS_SUNING_ALARM_EFUSE_MAP
	bool "board suning alarm efuse map"

endchoice

endif
```
