## kernel/kernel-x1000/drivers/video/jz_fb_v14/Kconfig
```kconfig
menuconfig FB_JZ_V14
	tristate "JZ LCDC framebuffer V1.4"
	depends on FB
	select FB_CFB_FILLRECT
	select FB_CFB_COPYAREA
	select FB_CFB_IMAGEBLIT
	help
	  Framebuffer support for the x1830/x1630/T30 SoC.

choice
	depends on FB_JZ_V14
	prompt "set lcd gpio"
	default LCD_V14_TFT_18BIT

config LCD_V14_TFT_18BIT
	bool "lcd v14 tft 18bit"

config LCD_V14_SLCD_8BIT
	bool "lcd v14 8bit slcd"

config LCD_V14_SLCD_9BIT
	bool "lcd v14 9bit slcd"

config LCD_V14_SLCD_16BIT
	bool "lcd v14 16bit slcd"
endchoice

choice
	depends on FB_JZ_V14
	prompt "set lcd frame buffer num"
	default CONFIG_ONE_FRAME_BUFFERS

config LCD_V14_ONE_FRAME_BUFFERS
	bool "one frame buffer"

config LCD_V14_TWO_FRAME_BUFFERS
	bool "two frame buffers"

config LCD_V14_THREE_FRAME_BUFFERS
	bool "three frame buffers"

endchoice

config LCD_V14_SLCD_CS
	bool "use slcd cs pin function"
	depends on FB_JZ_V14 && (LCD_V14_SLCD_8BIT || LCD_V14_SLCD_9BIT || LCD_V14_SLCD_16BIT)
	default n
	help
		use slcd te function

config LCD_V14_SLCD_TE
	bool "use slcd te pin function"
	depends on FB_JZ_V14 && (LCD_V14_SLCD_8BIT || LCD_V14_SLCD_9BIT || LCD_V14_SLCD_16BIT)
	default n
	help
		use slcd te function

config LCD_V14_SLCD_RDY
	bool "use slcd ready pin function"
	depends on FB_JZ_V14 && (LCD_V14_SLCD_8BIT || LCD_V14_SLCD_9BIT || LCD_V14_SLCD_16BIT)
	default n
	help
		use slcd ready function

config FB_JZ_V14_DISPLAY_TEST
	bool "dispaly test"
	depends on FB_JZ_V14

config FB_JZ_V14_DELAY_BACKLIGHT
	int "delay to turn on the backlight"
	depends on FB_JZ_V14_DISPLAY_TEST
	range 0 1000000000
	default "0"
	help
		delay to turn on the backlight
		unit: us

config FB_JZ_LOGO
	bool "display logo"
	depends on FB_JZ_V14_DISPLAY_TEST
	select LOGO
	default n
	help
		display ingenic logo

config FB_JZ_DEBUG
	bool "fb test for displaying color bar"
	depends on FB_JZ_V14_DISPLAY_TEST
	default n
	help
	fb test for displaying color bar in your board.
```

## kernel/kernel-x1000/drivers/video/soc_vpu/jz_nvpu/Kconfig
```kconfig
config JZ_NVPU
    depends on SOC_VPU
    bool "vpu client device of soc_vpu"
    default n
```

## kernel/kernel-x1000/drivers/video/soc_vpu/radix/Kconfig
```kconfig
config VPU_RADIX
    depends on SOC_VPU && !JZ_NVPU
    bool "vpu radix client device of soc_vpu"
    default n

if VPU_RADIX
config VPU_RADIX_NUM
    depends on VPU_RADIX
    int "vpu radix node number"
    default 1
endif
```

## kernel/kernel-x1000/ingenic/Kconfig
```kconfig
menu "ingenic drivers"

if SOC_X1520
source "ingenic/x1520/Kconfig"
endif

if SOC_X1830
source "ingenic/x1830/Kconfig"
endif

source "ingenic/drivers/Kconfig"

source "ingenic/for_module/Kconfig"

endmenu
```

## kernel/kernel-x1000/ingenic/drivers/Kconfig
```kconfig
source "ingenic/drivers/leds/Kconfig"
source "ingenic/drivers/mic/Kconfig"
source "ingenic/drivers/si1143/Kconfig"
source "ingenic/drivers/aw9163/Kconfig"
source "ingenic/drivers/aw87519/Kconfig"
source "ingenic/drivers/sensory_license/Kconfig"
source "ingenic/drivers/im501/Kconfig"
source "ingenic/drivers/gsl1680/Kconfig"
source "ingenic/drivers/fingerprint/Kconfig"
source "ingenic/drivers/gt917s/Kconfig"
source "ingenic/drivers/ax88796c/Kconfig"
```

## kernel/kernel-x1000/ingenic/drivers/aw87519/Kconfig
```kconfig
config AW87519
    bool "aw87519"
    help
        AW87519 is specifically designed to improve the musical
        output dynamic range, enhance the overall sound quality. It
        is a new high efficiency, high PSRR,low noise, constant
        large volume, 3rd generation Smart K audio amplifier.
```

## kernel/kernel-x1000/ingenic/drivers/ax88796c/Kconfig
```kconfig
config AX88796C_SPI
    tristate "AX88796C SPI Ethernet"
    help
        This selects spi support.
```

## kernel/kernel-x1000/ingenic/drivers/fingerprint/Kconfig
```kconfig
menuconfig FINGERPRINT
	bool "Fingerprint sensor support"

if FINGERPRINT


config FINGERPRINT_MICROARRAY
	bool "MicroArray fingerprint sensor"
	depends on JZ_SPI
	help
	  Support for MicroArray fingerPrint.

endif
```

## kernel/kernel-x1000/ingenic/drivers/gsl1680/Kconfig
```kconfig
config GSL1680
    tristate "GSL1680 touch screen driver"
    help
        GSL1680 touch screen driver support
        320 * 480
```
