## module_driver/package/soc/x1600/fb/Config.in
```kconfig
menuconfig MD_X1600_FB
    bool "fb 显示驱动"
    help
        Framebuffer support for the x1600 SoC.
        kernel must select those options
        select FB
        select FB_CFB_FILLRECT
        select FB_CFB_COPYAREA
        select FB_CFB_IMAGEBLIT

config MD_X1600_RTOS_BOOT_LOGO_FOR_KERNEL
    bool "rtos 中已初始化过 lcd (此时无需再初始化)"
    default n
    help
        rtos 中已初始化过 lcd, 无需再初始化

config MD_X1600_FB_FRAME_NUM
    int "帧缓冲数量"
    default 2

config MD_X1600_FB_PAN_DISPLAY_SYNC
    bool "pan_display 调用时等待帧刷新完成(单缓冲时选中)"
    default y

endmenu
```

## module_driver/package/soc/x1600/spi/Config.in
```kconfig
array SOC_X1600_SPI0_CLK_IO
    string "SPI0 CLK 引脚"
    item "GPIO_NULL  " -1
    item "PA31" PA31
    item "PB12" PB12

array SOC_X1600_SPI0_MISO_IO
    string "SPI0 MISO(DR) 引脚"
    item "GPIO_NULL  " -1
    item "PA29" PA29
    item "PB14" PB14

array SOC_X1600_SPI0_MOSI_IO
    string "SPI0 MOSI(DT) 引脚"
    item "GPIO_NULL  " -1
    item "PA30" PA30
    item "PB13" PB13


menu "SPI 总线"
    help
        "依赖于 SPI 驱动"

config MD_X1600_SPI
    bool

config MD_X1600_SPI_CLK_RATE
    int "SPI内部时钟源频率(单位Hz)"
    default 100000000
    help
            SPI频率 = SPI内部时钟源频率 / (2 * (CGV + 1))
            CGV范围: 0 ~ 255
            当前SPI频率范围: 195312.5 ~ 50000000

config MD_X1600_SPI0
    bool "选择 SPI0"
    select MD_X1600_SPI

config MD_X1600_SPI0_CLK
    string "        CLK(时钟引脚)"
    default PA31
    choice from SOC_X1600_SPI0_CLK_IO
    depends on MD_X1600_SPI0

config MD_X1600_SPI0_MISO
    string "        MISO(输入引脚)"
    default PA29
    choice from SOC_X1600_SPI0_MISO_IO
    depends on MD_X1600_SPI0
    help
        "MISO= -1,表示不使用MISO引脚"

config MD_X1600_SPI0_MOSI
    string "        MOSI(输出引脚)"
    default PA30
    choice from SOC_X1600_SPI0_MOSI_IO
    depends on MD_X1600_SPI0
    help
        "MOSI= -1,表示不使用MOSI引脚"

endmenu # SPI 总线
```

## module_driver/package/soc/x1600/sslv/Config.in
```kconfig
array SOC_X1600_SSLV0_CLK_IO
    string "SSLV CLK 引脚"
    item "GPIO_NULL  " -1
    item "GPIO_SSLV_CLK" PA31
    item "GPIO_SSLV_CLK" PB12

array SOC_X1600_SSLV0_DT_IO
    string "SSLV DT 引脚"
    item "GPIO_NULL  " -1
    item "GPIO_SSLV_DT" PA30
    item "GPIO_SSLV_DT" PB13

array SOC_X1600_SSLV0_DR_IO
    string "SSLV DR 引脚"
    item "GPIO_NULL  " -1
    item "GPIO_SSLV_DR" PA29
    item "GPIO_SSLV_DR" PB14

array SOC_X1600_SSLV0_CS_IO
    string "SSLV CS 引脚"
    item "GPIO_NULL  " -1
    item "GPIO_SSLV_CS" PA28
    item "GPIO_SSLV_CS" PB17


menuconfig MD_X1600_SSLV
    bool "SSLV0"

config MD_X1600_SSLV0_CLK
    string "CLK(时钟引脚)"
    default PA31
    choice from SOC_X1600_SSLV0_CLK_IO

config MD_X1600_SSLV0_DT
    string "DT(输出引脚)"
    default PA30
    choice from SOC_X1600_SSLV0_DT_IO
    help
        "DT= -1,表示不使用DT引脚"

config MD_X1600_SSLV0_DR
    string "DR(输入引脚)"
    default PA29
    choice from SOC_X1600_SSLV0_DR_IO
    help
        "DR= -1,表示不使用DR引脚"

config MD_X1600_SSLV0_CS
    string "CS(片选脚)"
    default PA28
    choice from SOC_X1600_SSLV0_CS_IO

endmenu # SPI SLV
```

## module_driver/package/soc/x1600/uart/Config.in
```kconfig
menuconfig MD_X1600_UART
    bool "uart tty驱动 dma模式接收"

config MD_X1600_UART0
    bool "uart 0"

config MD_X1600_UART0_RX
    string "    rx gpio"
    choice from UART0_RX_PINS
    depends on MD_X1600_UART0
    default -1

config MD_X1600_UART0_TX
    string "    tx gpio"
    choice from UART0_TX_PINS
    depends on MD_X1600_UART0
    default -1

config MD_X1600_UART0_CTS
    string "    cts gpio"
    choice from UART0_CTS_PINS
    depends on MD_X1600_UART0
    default -1

config MD_X1600_UART0_RTS
    string "    rts gpio"
    choice from UART0_RTS_PINS
    depends on MD_X1600_UART0
    default -1

config MD_X1600_UART1
    bool "uart 1"

config MD_X1600_UART1_RX
    string "    rx gpio"
    choice from UART1_RX_PINS
    depends on MD_X1600_UART1
    default -1

config MD_X1600_UART1_TX
    string "    tx gpio"
    choice from UART1_TX_PINS
    depends on MD_X1600_UART1
    default -1

config MD_X1600_UART1_CTS
    string "    cts gpio"
    choice from UART1_CTS_PINS
    depends on MD_X1600_UART1
    default -1

config MD_X1600_UART1_RTS
    string "    rts gpio"
    choice from UART1_RTS_PINS
    depends on MD_X1600_UART1
    default -1

config MD_X1600_UART2
    bool "uart 2"

config MD_X1600_UART2_RX
    string "    rx gpio"
    choice from UART2_RX_PINS
    depends on MD_X1600_UART2
    default -1

config MD_X1600_UART2_TX
    string "    tx gpio"
    choice from UART2_TX_PINS
    depends on MD_X1600_UART2
    default -1

config MD_X1600_UART2_CTS
    string "    cts gpio"
    choice from UART2_CTS_PINS
    depends on MD_X1600_UART2
    default -1

config MD_X1600_UART2_RTS
    string "    rts gpio"
    choice from UART2_RTS_PINS
    depends on MD_X1600_UART2
    default -1

config MD_X1600_UART3
    bool "uart 3"

config MD_X1600_UART3_RX
    string "    rx gpio"
    choice from UART3_RX_PINS
    depends on MD_X1600_UART3
    default -1

config MD_X1600_UART3_TX
    string "    tx gpio"
    choice from UART3_TX_PINS
    depends on MD_X1600_UART3
    default -1

config MD_X1600_UART3_CTS
    string "    cts gpio"
    choice from UART3_CTS_PINS
    depends on MD_X1600_UART3
    default -1

config MD_X1600_UART3_RTS
    string "    rts gpio"
    choice from UART3_RTS_PINS
    depends on MD_X1600_UART3
    default -1

endmenu

array UART0_RX_PINS
    string "uart0 rx 引脚"
    item "PB7" PB7
    item "NULL" -1

array UART0_TX_PINS
    string "uart0 tx 引脚"
    item "PB8" PB8
    item "NULL" -1

array UART0_CTS_PINS
    string "uart0 cts 引脚"
    item "NULL" -1
    item "PB9" PB9

array UART0_RTS_PINS
    string "uart0 rts 引脚"
    item "NULL" -1
    item "PB10" PB10

array UART1_RX_PINS
    string "uart1 rx 引脚"
    item "PB3" PB3
    item "NULL" -1

array UART1_TX_PINS
    string "uart1 tx 引脚"
    item "PB2" PB2
    item "NULL" -1

array UART1_CTS_PINS
    string "uart1 cts 引脚"
    item "NULL" -1
    item "PB5" PB5

array UART1_RTS_PINS
    string "uart1 rts 引脚"
    item "NULL" -1
    item "PB4" PB4

array UART2_RX_PINS
    string "uart2 rx 引脚"
    item "PA31" PA31
    item "PB1" PB1
    item "NULL" -1

array UART2_TX_PINS
    string "uart2 tx 引脚"
    item "PA30" PA30
    item "PB0" PB0
    item "NULL" -1

array UART2_CTS_PINS
    string "uart2 cts 引脚"
    item "NULL" -1

array UART2_RTS_PINS
    string "uart2 rts 引脚"
    item "NULL" -1

array UART3_RX_PINS
    string "uart3 rx 引脚"
    item "PB5" PB5
    item "PD5" PD5
    item "NULL" -1

array UART3_TX_PINS
    string "uart3 tx 引脚"
    item "PB4" PB4
    item "PD4" PD4
    item "NULL" -1

array UART3_CTS_PINS
    string "uart3 cts 引脚"
    item "NULL" -1

array UART3_RTS_PINS
    string "uart3 rts 引脚"
    item "NULL" -1
```

## module_driver/package/soc/x1600_510/Config.in
```kconfig
menuconfig MD_SOC_X1600_510
    bool "x1600 驱动列表"
    depends on MD_CHOICE_SOC_X1600_510_BASE

config MD_SOC_DIR
    string
    default soc/x1600_510

source package/soc/x1600_510/def_gpio_pins.in

source package/soc/x1600_510/gpio/Config.in

source package/soc/x1600_510/watchdog/Config.in

source package/soc/x1600_510/utils/Config.in

source package/soc/x1600_510/i2c/Config.in

source package/soc/x1600_510/spi/Config.in

source package/soc/x1600_510/camera/Config.in

source package/soc/x1600_510/adc/Config.in

source package/soc/x1600_510/fb/Config.in

source package/soc/x1600_510/pwm/Config.in

source package/soc/x1600_510/mac/Config.in

source package/soc/x1600_510/dtrng/Config.in

source package/soc/x1600_510/hash/Config.in

source package/soc/x1600_510/aic/Config.in
source package/soc/x1600_510/msc/Config.in

source package/soc/x1600_510/efuse/Config.in

endmenu
```

## module_driver/package/soc/x1600_510/aic/Config.in
```kconfig
menuconfig MD_X1600_510_AIC
    bool "aic(i2s 接口)"

menuconfig MD_X1600_510_AIC_IF_SEND_INVALID_DATA
    bool "外部codec是否需要在传输有效数据之前先传输空数据至传输稳定"
    default y

config MD_X1600_510_AIC_IF_SEND_INVALID_DATA_EVERYTIME
    bool "每次播放均先传输空数据至稳定"
    default n
    help
        若不选中该项 仅上电后首次播放先传输空数据至稳定

config MD_X1600_510_AIC_SEND_INVALID_DATA_TIME_MS
    int "需要先传输空数据至传输稳定的时长(以ms为单位)"
    default 120
    help
        基于halley6_x1600_v10板极测得播放音频为8k时对应时间为720
        16k为360 48k为120 96k为60

endmenu

endmenu # aic(i2s 接口)
```

## module_driver/package/soc/x1600_510/camera/Config.in
```kconfig
array SOC_X1600_510_CAMERA_MCLK_IO
    string "X1600_510 MCLK 引脚"
    item "PA24" PA24
    item "PC(25)    24M晶振旁路,输出频率不可调整" PC25

menuconfig MD_X1600_510_CAMERA
    bool "camera 驱动(cim控制器)"


config MD_X1600_510_CAMERA_MCLK
    string "CIM MCLK管脚选择"
    default PA24
    choice from SOC_X1600_510_CAMERA_MCLK_IO

config MD_X1600_510_CAMERA_CIM_FRAME_NUMS
    int "CIM Camera 帧缓冲数 "
    default 2

endmenu
```

## module_driver/package/soc/x1600_510/efuse/Config.in
```kconfig
menuconfig MD_X1600_510_EFUSE
    bool "efuse 驱动(芯片熔丝功能)"

config MD_X1600_510_EFUSE_VDDQ
    string "efuse 写使能引脚(低电平使能)"
    choice from SOC_GPIO_PINS
    default -1

endmenu
```

## module_driver/package/soc/x1600_510/i2c/Config.in
```kconfig
menuconfig MD_X1600_510_I2C
    bool "i2c 控制器驱动"


config MD_X1600_510_I2C0_BUS
    bool "选择I2C0"

choice "              选择I2C0 GPIO"
    default MD_X1600_510_I2C0_PA
    depends on MD_X1600_510_I2C0_BUS

config MD_X1600_510_I2C0_PA
    bool "SCL:GPIO_PA(28) SDA:GPIO_PA(29)"

config MD_X1600_510_I2C0_PB
    bool "SCL:GPIO_PB(30) SDA:GPIO_PB(31)"
    depends on MD_CHOICE_SOC_X1600_510

endchoice

config MD_X1600_510_I2C0_RATE
    int "       I2C0 速度 "
    default 400000
    depends on MD_X1600_510_I2C0_BUS



config MD_X1600_510_I2C1_BUS
    bool "选择I2C1"

choice "              选择I2C1 GPIO"
    default MD_X1600_510_I2C1_PB_15_16
    depends on MD_X1600_510_I2C1_BUS

config MD_X1600_510_I2C1_PB_15_16
    bool "SCL:GPIO_PB(15) SDA:GPIO_PB(16)"

config MD_X1600_510_I2C1_PB_19_20
    bool "SCL:GPIO_PB(19) SDA:GPIO_PB(20)"
    depends on MD_CHOICE_SOC_X1600_510

endchoice

config MD_X1600_510_I2C1_RATE
    int "        I2C1 速度 "
    default 400000
    depends on MD_X1600_510_I2C1_BUS


endmenu
```

## module_driver/package/soc/x1600_510/mac/Config.in
```kconfig
menuconfig MD_X1600_510_MAC
    bool "mac 以太网控制器驱动"

config MD_X1600_510_PHY_PROBE_MASK
    int "PHY探测屏蔽(范围：0x0～0xffffffff)"
    default 0x0
    help
        phy探测屏蔽为32位代表32个地址(0:使能探测 1:屏蔽探测)
        例如：0xfffffff0(探测前4个地址)

config MD_X1600_510_PHY_CLK_DELAY_US
    int "PHY CLK 使能后延迟时间再通讯(单位：us)"
    default 0

config MD_X1600_510_PHY_RESET_TIME_US
    int "PHY复位时间(单位：us)"
    default 10000

config MD_X1600_510_PHY_POWER_GPIO
    string "PHY 上电使能引脚"
    choice from SOC_GPIO_PINS
    default -1

config MD_X1600_510_PHY_POWER_LEVEL
    string "PHY 上电使能电平"
    choice from PHY_POWER_LEVEL
    default 1

config MD_X1600_510_PHY_RESET_GPIO
    string "PHY 复位引脚"
    choice from SOC_GPIO_PINS
    default -1

config MD_X1600_510_PHY_VALID_LEVEL
    string "PHY 复位电平"
    choice from PHY_RESET_LEVEL
    default 0

config MD_X1600_510_VIRTUAL_PHY
    bool "外接虚拟phy设备，RMII直接通讯，用于两个mac互接省略phy芯片或用于直接与FPGA芯片通讯"
    default n

endmenu

array PHY_RESET_LEVEL
    string "RESET_LEVEL"
    item "RESET_LEVEL" 0
    item "RESET_LEVEL" 1

array PHY_POWER_LEVEL
    string "POWER_LEVEL"
    item "POWER_LEVEL" 0
    item "POWER_LEVEL" 1
```

## module_driver/package/soc/x1600_510/msc/Config.in
```kconfig
menuconfig MD_X1600_510_MSC
    bool "msc 控制器驱动"

config MD_X1600_510_WIFI_POWER_ON
    string "    wifi 模块供电引脚"
    choice from SOC_GPIO_PINS
    default -1

config MD_X1600_510_WIFI_POWER_LEVEL
	string "wifi 初始化电平 (msc 模块加载前设置 wifi 供电引脚的电平,使 wifi 断电)"
	default 0
	choice from MD_GPIO_ACTIVE_LEVEL

config MD_X1600_510_WIFI_REG_ON
    string "    wifi 使能引脚"
    choice from SOC_GPIO_PINS
    default -1

config MD_X1600_510_WIFI_REG_LEVEL
	string "wifi 初始化电平 (msc 模块加载前设置 wifi 使能引脚的电平,使 wifi 失能)"
	default 0
	choice from MD_GPIO_ACTIVE_LEVEL

source package/soc/x1600_510/msc/msc0.in
source package/soc/x1600_510/msc/msc1.in
endmenu # MSC 总线
```

## module_driver/package/soc/x1600_510/utils/Config.in
```kconfig
menuconfig MD_X1600_510_UTILS
    bool "utils 驱动(芯片的一些小功能)"

config MD_X1600_510_UTILS_RTC32K
    bool "rtc32k 时钟bypas输出(PC26)"
    default y

config MD_X1600_510_UTILS_RTC32K_INIT_ON
    bool "        初始化即使能rtc32k输出"
    depends on MD_X1600_510_UTILS_RTC32K



config MD_X1600_510_UTILS_CLK24M
    bool "clk24m 时钟bypas输出(PC25)"
    default n

config MD_X1600_510_UTILS_CLK24M_INIT_ON
    bool "        初始化即使能clk24m输出"
    depends on MD_X1600_510_UTILS_CLK24M

endmenu
```

## module_driver/package/soc/x1830/Config.in
```kconfig
menuconfig MD_SOC_X1830
    bool "x1830 驱动列表"
    depends on MD_CHOICE_SOC_X1830

config MD_SOC_DIR
    string
    default soc/x1830

source package/soc/x1830/def_gpio_pins.in

source package/soc/x1830/spi/Config.in

source package/soc/x1830/adc/Config.in

source package/soc/x1830/pwm/Config.in

source package/soc/x1830/efuse/Config.in

source package/soc/x1830/watchdog/Config.in

source package/soc/x1830/i2c/Config.in

source package/soc/x1830/dmic/Config.in

source package/soc/x1830/utils/Config.in

source package/soc/x1830/fb/Config.in

source package/soc/x1830/camera/Config.in

source package/soc/x1830/mscaler/Config.in

source package/soc/x1830/gpio/Config.in

source package/soc/x1830/mac/Config.in

source package/soc/x1830/icodec/Config.in

source package/soc/x1830/aic/Config.in

endmenu
```

## module_driver/package/soc/x1830/adc/Config.in
```kconfig
menuconfig MD_X1830_ADC
    bool "adc 驱动(电压采样功能)"

config MD_X1830_ADC_VREF
    int "参考电压mv"
    default 1800

endmenu
```

## module_driver/package/soc/x1830/efuse/Config.in
```kconfig
menuconfig MD_X1830_EFUSE
    bool "efuse 驱动(芯片熔丝功能)"

config MD_X1830_EFUSE_VDDQ
    string "efuse 写使能引脚"
    choice from SOC_GPIO_PINS
    default -1

endmenu
```

## module_driver/package/soc/x1830/fb/Config.in
```kconfig
menuconfig MD_X1830_FB
    bool "framebuffer 驱动(lcd控制器)"

config MD_X1830_FB_PAN_DISPLAY_SYNC
    bool "pan_display 调用时等待帧刷新完成(单缓冲时选中)"
    default y

config MD_X1830_FB_LAYER0_FRAMES
    int "fb0 的帧缓冲数"
    default 1

config MD_X1830_FB_LAYER1_ENABLE
    bool "使能fb1(fb1在底层,fb0在顶层)"

config MD_X1830_FB_LAYER1_FRAMES
    int "fb1 的帧缓冲数(fb1使能时生效)"
    default 1

config MD_X1830_FB_LAYER0_ALPHA
    int "fb0 的透明度(fb1使能时生效,0-255)"
    default 128

endmenu
```

## module_driver/package/soc/x1830/i2c/Config.in
```kconfig
menuconfig MD_X1830_I2C
    bool "i2c 控制器驱动"


config MD_X1830_I2C0_BUS
    bool "选择I2C0"

choice "              选择I2C0 GPIO"
    default MD_X1830_I2C0_PA
    depends on MD_X1830_I2C0_BUS

config MD_X1830_I2C0_PA
    bool "SCL:GPIO_PA(13) SDA:GPIO_PA(12)"

endchoice

config MD_X1830_I2C0_RATE
    int "       I2C0 速度 "
    default 400000
    depends on MD_X1830_I2C0_BUS



config MD_X1830_I2C1_BUS
    bool "选择I2C1"

choice "              选择I2C1 GPIO"
    default MD_X1830_I2C1_PB
    depends on MD_X1830_I2C1_BUS

config MD_X1830_I2C1_PB
    bool "SCL:GPIO_PB(26) SDA:GPIO_PB(25)"

endchoice

config MD_X1830_I2C1_RATE
    int "        I2C1 速度 "
    default 400000
    depends on MD_X1830_I2C1_BUS



config MD_X1830_I2C2_BUS
    bool "选择I2C2"

choice "              选择I2C2 GPIO"
    default MD_X1830_I2C2_PC
    depends on MD_X1830_I2C2_BUS

config MD_X1830_I2C2_PC
    bool "SCL:GPIO_PC(28) SDA:GPIO_PC(27)"

endchoice

config MD_X1830_I2C2_RATE
    int "       I2C2 速度 "
    default 400000
    depends on MD_X1830_I2C2_BUS

endmenu
```
