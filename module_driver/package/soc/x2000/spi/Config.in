## module_driver/package/soc/x2000/spi/Config.in
```kconfig
array SOC_X2000_SPI0_MISO_IO
    string "SPI0 MISO(DR) 引脚"
    item "GPIO_NULL  " -1
    item "PB29" PB29
    item "PD10" PD10

array SOC_X2000_SPI0_MOSI_IO
    string "SPI0 MOSI(DT) 引脚"
    item "GPIO_NULL  " -1
    item "PB30" PB30
    item "PD9" PD9

array SOC_X2000_SPI0_CLK_IO
    string "SPI0 CLK 引脚"
    item "GPIO_NULL  " -1
    item "PB31" PB31
    item "PD8" PD8



array SOC_X2000_SPI1_MISO_IO
    string "SPI1 MISO(DR) 引脚"
    item "GPIO_NULL  " -1
    item "PC10" PC10
    item "PD19" PD19
    item "PE18" PE18

array SOC_X2000_SPI1_MOSI_IO
    string "SPI1 MOSI(DT) 引脚"
    item "GPIO_NULL  " -1
    item "PC11" PC11
    item "PD18" PD18
    item "PE17" PE17

array SOC_X2000_SPI1_CLK_IO
    string "SPI1 CLK 引脚"
    item "GPIO_NULL  " -1
    item "PC12" PC12
    item "PD17" PD17
    item "PE16" PE16



menu "SPI 总线"
    help
        "依赖于 SPI 驱动"

config MD_X2000_SPI
    bool

config MD_X2000_SPI_CLK_RATE
    int "SPI内部时钟源频率(单位Hz)"
    default 100000000
    help
            SPI频率 = SPI内部时钟源频率 / (2 * (CGV + 1))
            CGV范围: 0 ~ 255
            当前SPI频率范围: 195312.5 ~ 50000000

config MD_X2000_SPI0
    bool "选择 SPI0"
    select MD_X2000_SPI

config MD_X2000_SPI0_MISO
    string "        MISO(输入引脚)"
    default PB29
    choice from SOC_X2000_SPI0_MISO_IO
    depends on MD_X2000_SPI0
    help
        "MISO= -1,表示不使用MISO引脚"

config MD_X2000_SPI0_MOSI
    string "        MOSI(输出引脚)"
    default PB30
    choice from SOC_X2000_SPI0_MOSI_IO
    depends on MD_X2000_SPI0
    help
        "MOSI= -1,表示不使用MOSI引脚"

config MD_X2000_SPI0_CLK
    string "        CLK(时钟引脚)"
    default PB31
    choice from SOC_X2000_SPI0_CLK_IO
    depends on MD_X2000_SPI0


config MD_X2000_SPI1
    bool "选择 SPI1"
    select MD_X2000_SPI

config MD_X2000_SPI1_MISO
    string "        MISO(输入引脚)"
    default PC10
    choice from SOC_X2000_SPI1_MISO_IO
    depends on MD_X2000_SPI1
    help
        "MISO= -1,表示不使用MISO引脚"

config MD_X2000_SPI1_MOSI
    string "        MOSI(输出引脚)"
    default PC11
    choice from SOC_X2000_SPI1_MOSI_IO
    depends on MD_X2000_SPI1
    help
        "MOSI= -1,表示不使用MOSI引脚"

config MD_X2000_SPI1_CLK
    string "        CLK(时钟引脚)"
    default PC12
    choice from SOC_X2000_SPI1_CLK_IO
    depends on MD_X2000_SPI1

endmenu # SPI 总线
```

## module_driver/package/soc/x2000/uart/Config.in
```kconfig
menuconfig MD_X2000_UART
    bool "uart tty驱动 dma模式接收"

config MD_X2000_UART0
    bool "uart 0"

config MD_X2000_UART0_RX
    string "    rx gpio"
    choice from UART0_RX_PINS
    depends on MD_X2000_UART0
    default -1

config MD_X2000_UART0_TX
    string "    tx gpio"
    choice from UART0_TX_PINS
    depends on MD_X2000_UART0
    default -1

config MD_X2000_UART0_CTS
    string "    cts gpio"
    choice from UART0_CTS_PINS
    depends on MD_X2000_UART0
    default -1

config MD_X2000_UART0_RTS
    string "    rts gpio"
    choice from UART0_RTS_PINS
    depends on MD_X2000_UART0
    default -1

config MD_X2000_UART1
    bool "uart 1"

config MD_X2000_UART1_RX
    string "    rx gpio"
    choice from UART1_RX_PINS
    depends on MD_X2000_UART1
    default -1

config MD_X2000_UART1_TX
    string "    tx gpio"
    choice from UART1_TX_PINS
    depends on MD_X2000_UART1
    default -1

config MD_X2000_UART1_CTS
    string "    cts gpio"
    choice from UART1_CTS_PINS
    depends on MD_X2000_UART1
    default -1

config MD_X2000_UART1_RTS
    string "    rts gpio"
    choice from UART1_RTS_PINS
    depends on MD_X2000_UART1
    default -1


config MD_X2000_UART2
    bool "uart 2"

config MD_X2000_UART2_RX
    string "    rx gpio"
    choice from UART2_RX_PINS
    depends on MD_X2000_UART2
    default -1

config MD_X2000_UART2_TX
    string "    tx gpio"
    choice from UART2_TX_PINS
    depends on MD_X2000_UART2
    default -1

config MD_X2000_UART2_CTS
    string "    cts gpio"
    default -1
    depends on MD_X2000_UART2

config MD_X2000_UART2_RTS
    string "    rts gpio"
    default -1
    depends on MD_X2000_UART2


config MD_X2000_UART3
    bool "uart 3"

config MD_X2000_UART3_RX
    string "    rx gpio"
    choice from UART3_RX_PINS
    depends on MD_X2000_UART3
    default -1

config MD_X2000_UART3_TX
    string "    tx gpio"
    choice from UART3_TX_PINS
    depends on MD_X2000_UART3
    default -1

config MD_X2000_UART3_CTS
    string "    cts gpio"
    choice from UART3_CTS_PINS
    depends on MD_X2000_UART3
    default -1

config MD_X2000_UART3_RTS
    string "    rts gpio"
    choice from UART3_RTS_PINS
    depends on MD_X2000_UART3
    default -1


config MD_X2000_UART4
    bool "uart 4"

config MD_X2000_UART4_RX
    string "    rx gpio"
    choice from UART4_RX_PINS
    depends on MD_X2000_UART4
    default -1

config MD_X2000_UART4_TX
    string "    tx gpio"
    choice from UART4_TX_PINS
    depends on MD_X2000_UART4
    default -1

config MD_X2000_UART4_CTS
    string "    cts gpio"
    choice from UART4_CTS_PINS
    depends on MD_X2000_UART4
    default -1

config MD_X2000_UART4_RTS
    string "    rts gpio"
    choice from UART4_RTS_PINS
    depends on MD_X2000_UART4
    default -1


config MD_X2000_UART5
    bool "uart 5"

config MD_X2000_UART5_RX
    string "    rx gpio"
    choice from UART5_RX_PINS
    depends on MD_X2000_UART5
    default -1

config MD_X2000_UART5_TX
    string "    tx gpio"
    choice from UART5_TX_PINS
    depends on MD_X2000_UART5
    default -1

config MD_X2000_UART5_CTS
    string "    cts gpio"
    default -1
    depends on MD_X2000_UART5

config MD_X2000_UART5_RTS
    string "    rts gpio"
    default -1
    depends on MD_X2000_UART5


config MD_X2000_UART6
    bool "uart 6"

config MD_X2000_UART6_RX
    string "    rx gpio"
    choice from UART6_RX_PINS
    depends on MD_X2000_UART6
    default -1

config MD_X2000_UART6_TX
    string "    tx gpio"
    choice from UART6_TX_PINS
    depends on MD_X2000_UART6
    default -1

config MD_X2000_UART6_CTS
    string "    cts gpio"
    default -1
    depends on MD_X2000_UART6

config MD_X2000_UART6_RTS
    string "    rts gpio"
    default -1
    depends on MD_X2000_UART6


config MD_X2000_UART7
    bool "uart 7"

config MD_X2000_UART7_RX
    string "    rx gpio"
    choice from UART7_RX_PINS
    depends on MD_X2000_UART7
    default -1

config MD_X2000_UART7_TX
    string "    tx gpio"
    choice from UART7_TX_PINS
    depends on MD_X2000_UART7
    default -1

config MD_X2000_UART7_CTS
    string "    cts gpio"
    default -1
    depends on MD_X2000_UART7

config MD_X2000_UART7_RTS
    string "    rts gpio"
    default -1
    depends on MD_X2000_UART7


config MD_X2000_UART8
    bool "uart 8"

config MD_X2000_UART8_RX
    string "    rx gpio"
    choice from UART8_RX_PINS
    depends on MD_X2000_UART8
    default -1

config MD_X2000_UART8_TX
    string "    tx gpio"
    choice from UART8_TX_PINS
    depends on MD_X2000_UART8
    default -1

config MD_X2000_UART8_CTS
    string "    cts gpio"
    default -1
    depends on MD_X2000_UART8

config MD_X2000_UART8_RTS
    string "    rts gpio"
    default -1
    depends on MD_X2000_UART8


config MD_X2000_UART9
    bool "uart 9"

config MD_X2000_UART9_RX
    string "    rx gpio"
    choice from UART9_RX_PINS
    depends on MD_X2000_UART9
    default -1

config MD_X2000_UART9_TX
    string "    tx gpio"
    choice from UART9_TX_PINS
    depends on MD_X2000_UART9
    default -1

config MD_X2000_UART9_CTS
    string "    cts gpio"
    default -1
    depends on MD_X2000_UART9

config MD_X2000_UART9_RTS
    string "    rts gpio"
    default -1
    depends on MD_X2000_UART9

endmenu



array UART0_RX_PINS
    string "uart0 rx 引脚"
    item "PD23" PD23
    item "GPIO_NULL  " -1

array UART0_TX_PINS
    string "uart0 tx 引脚"
    item "PD24" PD24
    item "GPIO_NULL  " -1

array UART0_CTS_PINS
    string "uart0 cts 引脚"
    item "PD25" PD25
    item "GPIO_NULL  " -1

array UART0_RTS_PINS
    string "uart0 rts 引脚"
    item "PD26" PD26
    item "GPIO_NULL  " -1


array UART1_RX_PINS
    string "uart1 rx 引脚"
    item "PC23" PC23
    item "GPIO_NULL  " -1

array UART1_TX_PINS
    string "uart1 tx 引脚"
    item "PC24" PC24
    item "GPIO_NULL  " -1

array UART1_CTS_PINS
    string "uart1 cts 引脚"
    item "PC21" PC21
    item "GPIO_NULL  " -1

array UART1_RTS_PINS
    string "uart1 rts 引脚"
    item "PC22" PC22
    item "GPIO_NULL  " -1


array UART2_RX_PINS
    string "uart2 rx 引脚"
    item "PD30" PD30
    item "GPIO_NULL  " -1

array UART2_TX_PINS
    string "uart2 tx 引脚"
    item "PD31" PD31
    item "GPIO_NULL  " -1


array UART3_RX_PINS
    string "uart3 rx 引脚"
    item "PD02" PD02
    item "PC25" PC25
    item "GPIO_NULL  " -1

array UART3_TX_PINS
    string "uart3 tx 引脚"
    item "PD03" PD03
    item "PC26" PC26
    item "GPIO_NULL  " -1

array UART3_CTS_PINS
    string "uart3 cts 引脚"
    item "PD00" PD00
    item "PC27" PC27
    item "GPIO_NULL  " -1

array UART3_RTS_PINS
    string "uart3 cts 引脚"
    item "PD01" PD01
    item "PC28" PC28
    item "GPIO_NULL  " -1


array UART4_RX_PINS
    string "UART4 rx 引脚"
    item "PA02" PA02
    item "PC11" PC11
    item "GPIO_NULL  " -1

array UART4_TX_PINS
    string "UART4 tx 引脚"
    item "PA03" PA03
    item "PC12" PC12
    item "GPIO_NULL  " -1

array UART4_CTS_PINS
    string "UART4 cts 引脚"
    item "PA00" PA00
    item "PC09" PC09
    item "GPIO_NULL  " -1

array UART4_RTS_PINS
    string "UART4 rts 引脚"
    item "PA01" PA01
    item "PC10" PC10
    item "GPIO_NULL  " -1


array UART5_RX_PINS
    string "UART5 rx 引脚"
    item "PA04" PA04
    item "PC05" PC05
    item "GPIO_NULL  " -1

array UART5_TX_PINS
    string "UART5 tx 引脚"
    item "PA05" PA05
    item "PC06" PC06
    item "GPIO_NULL  " -1


array UART6_RX_PINS
    string "UART6 rx 引脚"
    item "PA06" PA06
    item "PC07" PC07
    item "GPIO_NULL  " -1

array UART6_TX_PINS
    string "UART6 tx 引脚"
    item "PA07" PA07
    item "PC08" PC08
    item "GPIO_NULL  " -1


array UART7_RX_PINS
    string "UART7 rx 引脚"
    item "PA08" PA08
    item "PC01" PC01
    item "GPIO_NULL  " -1

array UART7_TX_PINS
    string "UART7 tx 引脚"
    item "PA09" PA09
    item "PC02" PC02
    item "GPIO_NULL  " -1


array UART8_RX_PINS
    string "UART8 rx 引脚"
    item "PB28" PB28
    item "GPIO_NULL  " -1

array UART8_TX_PINS
    string "UART8 tx 引脚"
    item "PB29" PB29
    item "GPIO_NULL  " -1


array UART9_RX_PINS
    string "UART9 rx 引脚"
    item "PB30" PB30
    item "GPIO_NULL  " -1

array UART9_TX_PINS
    string "UART9 tx 引脚"
    item "PB31" PB31
    item "GPIO_NULL  " -1
```

## module_driver/package/soc/x2000/utils/Config.in
```kconfig
menuconfig MD_X2000_UTILS
    bool "utils 驱动(芯片的一些小功能)"

config MD_X2000_UTILS_RTC32K
    bool "rtc32k 时钟bypas输出(PE23)"
    default y

config MD_X2000_UTILS_RTC32K_INIT_ON
    bool "        初始化即使能rtc32k输出"
    depends on MD_X2000_UTILS_RTC32K

endmenu
```

## module_driver/package/soc/x2000_510/Config.in
```kconfig
menuconfig MD_SOC_X2000_510
    bool "x2000驱动列表"
    depends on MD_CHOICE_SOC_X2000_510

config MD_SOC_DIR
    string
    default soc/x2000_510

source package/soc/x2000_510/adc/Config.in
source package/soc/x2000_510/gpio/Config.in
source package/soc/x2000_510/watchdog/Config.in
source package/soc/x2000_510/dtrng/Config.in
source package/soc/x2000_510/i2c/Config.in
source package/soc/x2000_510/pwm/Config.in

source package/soc/x2000_510/def_gpio_pins.in

source package/soc/x2000_510/efuse/Config.in
source package/soc/x2000_510/utils/Config.in
source package/soc/x2000_510/mcu/Config.in
source package/soc/x2000_510/tcu/Config.in
source package/soc/x2000_510/hash/Config.in
source package/soc/x2000_510/fb/Config.in
source package/soc/x2000_510/fb_layer_mixer/Config.in
source package/soc/x2000_510/rotator/Config.in
source package/soc/x2000_510/camera/Config.in
source package/soc/x2000_510/audio_dma/Config.in
source package/soc/x2000_510/aic/Config.in
source package/soc/x2000_510/dmic/Config.in
source package/soc/x2000_510/icodec/Config.in
source package/soc/x2000_510/spdif/Config.in
source package/soc/x2000_510/spi/Config.in
source package/soc/x2000_510/msc/Config.in
source package/soc/x2000_510/mac/Config.in
endmenu
```

## module_driver/package/soc/x2000_510/camera/Config.in
```kconfig
array SOC_X2000_510_CAMERA_MCLK_IO
    string "X2000_510 MCLK 引脚"
    item "PC15" PC15
    item "PE24" PE24

menuconfig MD_X2000_510_CAMERA_VIC
    bool "camera 驱动(vic/cim控制器)"
    select MD_RMEM_MANAGER


config MD_X2000_510_CAMERA_VIC0
    bool "选择VIC0控制器"

config MD_X2000_510_CAMERA_VIC0_MCLK
    string "VIC0 MCLK管脚选择"
    default PE24
    choice from SOC_X2000_510_CAMERA_MCLK_IO
    depends on MD_X2000_510_CAMERA_VIC0

choice "      选择VIC0 数据通路(ISP/DDR)"
    default MD_X2000_510_CAMERA_VIC0_ISP_DISABLE
    depends on MD_X2000_510_CAMERA_VIC0

config MD_X2000_510_CAMERA_VIC0_ISP_DISABLE
    bool "    VIC0数据不通过ISP模块"

config MD_X2000_510_CAMERA_VIC0_ISP_ENABLE
    bool "    VIC0数据通过ISP模块"

endchoice

config MD_X2000_510_CAMERA_VIC0_FRAME_NUMS
    int "VIC0 Camera 帧缓冲数 "
    default 2
    depends on MD_X2000_510_CAMERA_VIC0



config MD_X2000_510_CAMERA_VIC1
    bool "选择VIC1控制器"

config MD_X2000_510_CAMERA_VIC1_MCLK
    string "VIC1 MCLK管脚选择"
    default PE24
    choice from SOC_X2000_510_CAMERA_MCLK_IO
    depends on MD_X2000_510_CAMERA_VIC1

choice "      选择VIC1 数据通路(ISP/DDR)"
    default MD_X2000_510_CAMERA_VIC1_ISP_DISABLE
    depends on MD_X2000_510_CAMERA_VIC1

config MD_X2000_510_CAMERA_VIC1_ISP_DISABLE
    bool "    VIC1数据不通过ISP模块"

config MD_X2000_510_CAMERA_VIC1_ISP_ENABLE
    bool "    VIC1数据通过ISP模块"

endchoice

config MD_X2000_510_CAMERA_VIC1_FRAME_NUMS
    int "VIC1 Camera 帧缓冲数 "
    default 2
    depends on MD_X2000_510_CAMERA_VIC1



config MD_X2000_510_CAMERA_CIM
    bool "选择CIM控制器"

config MD_X2000_510_CAMERA_CIM_MCLK
    string "CIM MCLK管脚选择"
    default PE24
    choice from SOC_X2000_510_CAMERA_MCLK_IO
    depends on MD_X2000_510_CAMERA_CIM

config MD_X2000_510_CAMERA_CIM_FRAME_NUMS
    int "CIM Camera 帧缓冲数 "
    default 2
    depends on MD_X2000_510_CAMERA_CIM



endmenu
```

## module_driver/package/soc/x2000_510/dmic/Config.in
```kconfig
menuconfig MD_X2000_510_DMIC
    bool "dmic(外接数字mic)"
    select MD_X2000_510_AUDIO_DMA

config MD_X2000_510_DMIC_INT0
    bool "使能dmic通道0,1（PC21）"
    default y

config MD_X2000_510_DMIC_INT1
    bool "使能dmic通道2,3（PC22）"
    default n

config MD_X2000_510_DMIC_INT2
    bool "使能dmic通道4,5（PC23）"
    default n

config MD_X2000_510_DMIC_INT3
    bool "使能dmic通道6,7（PC24）"
    default n

endmenu
```

## module_driver/package/soc/x2000_510/efuse/Config.in
```kconfig
menuconfig MD_X2000_510_EFUSE
    bool "efuse 驱动(芯片熔丝功能)"

config MD_X2000_510_EFUSE_VDDQ
    string "efuse 写使能引脚"
    choice from SOC_GPIO_PINS
    default -1

endmenu
```
