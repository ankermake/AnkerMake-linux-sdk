## module_driver/package/soc/x2000_510/fb/Config.in
```kconfig
array MD_X2000_510_FB_ROTATOR_ANGLE_LIST
    int "rotator 旋转角度"
    item "旋转0°" 0
    item "旋转90°" 1
    item "旋转180°" 2
    item "旋转270°" 3

menuconfig MD_X2000_510_FB
    bool "framebuffer 驱动(lcd/dpu控制器)"
    select MD_X2000_510_FB_LAYER_MIXER
    select MD_X2000_510_ROTATOR
    select MD_RMEM_MANAGER

config MD_X2000_510_RTOS_BOOT_LOGO_FOR_KERNEL
    bool "rtos 中已初始化过 lcd (此时无需再初始化)"
    default n
    help
        rtos 中已初始化过 lcd, 无需再初始化

config MD_X2000_510_FB_PAN_DISPLAY_SYNC
    bool "pan_display 调用时等待帧刷新完成(单缓冲时选中)"
    default y

config MD_X2000_510_FB_ROTATOR
    bool "旋转"
    select MD_X2000_510_FB_MIXER_ENABLE

config MD_X2000_510_FB_ROTATOR_ANGLE
    int "旋转角度"
    default 0
    choice from MD_X2000_510_FB_ROTATOR_ANGLE_LIST
    depends on MD_X2000_510_FB_ROTATOR

config MD_X2000_510_FB_USE_DEFAULT_ORDER
    bool "强制使用默认的层级配置（fb0为最低层，fb3为最顶层，应用配置无效）"

config MD_X2000_510_FB_LAYER0_ENABLE
    bool "使能fb0"

config MD_X2000_510_FB_LAYER0_FRAMES
    int "fb0 的帧缓冲数"
    default 1

config MD_X2000_510_FB_LAYER0_ALPHA
    int "fb0 的透明度(0-255)"
    default 128

config MD_X2000_510_FB_LAYER1_ENABLE
    bool "使能fb1"

config MD_X2000_510_FB_LAYER1_FRAMES
    int "fb1 的帧缓冲数"
    default 1

config MD_X2000_510_FB_LAYER1_ALPHA
    int "fb1 的透明度(0-255)"
    default 128

config MD_X2000_510_FB_LAYER2_ENABLE
    bool "使能fb2"

config MD_X2000_510_FB_LAYER2_FRAMES
    int "fb2 的帧缓冲数"
    default 1

config MD_X2000_510_FB_LAYER2_ALPHA
    int "fb2 的透明度(0-255)"
    default 128

config MD_X2000_510_FB_LAYER3_ENABLE
    bool "使能fb3"

config MD_X2000_510_FB_LAYER3_FRAMES
    int "fb3 的帧缓冲数"
    default 1

config MD_X2000_510_FB_LAYER3_ALPHA
    int "fb3 的透明度(0-255)"
    default 128

config MD_X2000_510_FB_MIXER_ENABLE
    bool "图像叠加到内存并显示到lcd"
    help
        使用fb_layer_mixer驱动接口叠加fb0～fb3数据到内存，
        然后通过fb_srdma输出到lcd上，可通过最后一个fb节点获取叠加后的图像数据

config MD_X2000_510_FB_SRDMA_FRAMES
    int "叠加后输出的帧缓冲数"
    default 2
    depends on MD_X2000_510_FB_MIXER_ENABLE

menuconfig MD_X2000_510_FB_ENABLE_USER_CONFIG
    bool "自定义fb的尺寸"

menuconfig MD_X2000_510_FB_LAYER0_USER_ENABLE
    bool "使能fb0自定义"
    default n

config MD_X2000_510_FB_LAYER0_USER_WIDTH
    int "fb0的宽"
    default -1

config MD_X2000_510_FB_LAYER0_USER_HEIGHT
    int "fb0的高"
    default -1

config MD_X2000_510_FB_LAYER0_USER_XPOS
    int "fb0的在lcd水平方向的偏移"
    default 0

config MD_X2000_510_FB_LAYER0_USER_YPOS
    int "fb0的在lcd垂直的偏移"
    default 0

config MD_X2000_510_FB_LAYER0_USER_SCALING_ENABLE
    bool "使能缩放"
    default n

config MD_X2000_510_FB_LAYER0_USER_SCALING_WIDTH
    int "缩放后在lcd显示的宽度"
    depends on MD_X2000_510_FB_LAYER0_USER_SCALING_ENABLE
    default -1

config MD_X2000_510_FB_LAYER0_USER_SCALING_HEIGHT
    int "缩放后在lcd显示的长度"
    depends on MD_X2000_510_FB_LAYER0_USER_SCALING_ENABLE
    default -1

endmenu

menuconfig MD_X2000_510_FB_LAYER1_USER_ENABLE
    bool "使能fb1自定义"
    default n

config MD_X2000_510_FB_LAYER1_USER_WIDTH
    int "fb1的宽"
    default -1

config MD_X2000_510_FB_LAYER1_USER_HEIGHT
    int "fb1的高"
    default -1

config MD_X2000_510_FB_LAYER1_USER_XPOS
    int "fb1的在lcd水平方向的偏移"
    default 0

config MD_X2000_510_FB_LAYER1_USER_YPOS
    int "fb1的在lcd垂直的偏移"
    default 0

config MD_X2000_510_FB_LAYER1_USER_SCALING_ENABLE
    bool "使能缩放"
    default n

config MD_X2000_510_FB_LAYER1_USER_SCALING_WIDTH
    int "缩放后在lcd显示的宽度"
    depends on MD_X2000_510_FB_LAYER1_USER_SCALING_ENABLE
    default -1

config MD_X2000_510_FB_LAYER1_USER_SCALING_HEIGHT
    int "缩放后在lcd显示的长度"
    depends on MD_X2000_510_FB_LAYER1_USER_SCALING_ENABLE
    default -1

endmenu

menuconfig MD_X2000_510_FB_LAYER2_USER_ENABLE
    bool "使能fb2自定义"
    default n

config MD_X2000_510_FB_LAYER2_USER_WIDTH
    int "fb2的宽"
    default -1

config MD_X2000_510_FB_LAYER2_USER_HEIGHT
    int "fb2的高"
    default -1

config MD_X2000_510_FB_LAYER2_USER_XPOS
    int "fb2的在lcd水平方向的偏移"
    default 0

config MD_X2000_510_FB_LAYER2_USER_YPOS
    int "fb2的在lcd垂直的偏移"
    default 0

config MD_X2000_510_FB_LAYER2_USER_SCALING_ENABLE
    bool "使能缩放"
    default n

config MD_X2000_510_FB_LAYER2_USER_SCALING_WIDTH
    int "缩放后在lcd显示的宽度"
    depends on MD_X2000_510_FB_LAYER2_USER_SCALING_ENABLE
    default -1

config MD_X2000_510_FB_LAYER2_USER_SCALING_HEIGHT
    int "缩放后在lcd显示的长度"
    depends on MD_X2000_510_FB_LAYER2_USER_SCALING_ENABLE
    default -1

endmenu

menuconfig MD_X2000_510_FB_LAYER3_USER_ENABLE
    bool "使能fb3自定义"
    default n

config MD_X2000_510_FB_LAYER3_USER_WIDTH
    int "fb3的宽"
    default -1

config MD_X2000_510_FB_LAYER3_USER_HEIGHT
    int "fb3的高"
    default -1

config MD_X2000_510_FB_LAYER3_USER_XPOS
    int "fb3的在lcd水平方向的偏移"
    default 0

config MD_X2000_510_FB_LAYER3_USER_YPOS
    int "fb3的在lcd垂直的偏移"
    default 0

config MD_X2000_510_FB_LAYER3_USER_SCALING_ENABLE
    bool "使能缩放"
    default n

config MD_X2000_510_FB_LAYER3_USER_SCALING_WIDTH
    int "缩放后在lcd显示的宽度"
    depends on MD_X2000_510_FB_LAYER3_USER_SCALING_ENABLE
    default -1

config MD_X2000_510_FB_LAYER3_USER_SCALING_HEIGHT
    int "缩放后在lcd显示的长度"
    depends on MD_X2000_510_FB_LAYER3_USER_SCALING_ENABLE
    default -1

endmenu

endmenu

endmenu
```

## module_driver/package/soc/x2000_510/i2c/Config.in
```kconfig
menuconfig MD_X2000_510_I2C
    bool "i2c 控制器驱动"


config MD_X2000_510_I2C0_BUS
    bool "选择I2C0"

choice "              选择I2C0 GPIO"
    default MD_X2000_510_I2C0_PC
    depends on MD_X2000_510_I2C0_BUS

config MD_X2000_510_I2C0_PC
    bool "SCL:GPIO_PC(13) SDA:GPIO_PC(14)"

endchoice

config MD_X2000_510_I2C0_RATE
    int "       I2C0 速度 "
    default 400000
    depends on MD_X2000_510_I2C0_BUS



config MD_X2000_510_I2C1_BUS
    bool "选择I2C1"

choice "              选择I2C1 GPIO"
    default MD_X2000_510_I2C1_PC
    depends on MD_X2000_510_I2C1_BUS

config MD_X2000_510_I2C1_PC
    bool "SCL:GPIO_PC(23) SDA:GPIO_PC(24)"

config MD_X2000_510_I2C1_PD
    bool "SCL:GPIO_PD(11) SDA:GPIO_PD(12)"

endchoice

config MD_X2000_510_I2C1_RATE
    int "        I2C1 速度 "
    default 400000
    depends on MD_X2000_510_I2C1_BUS



config MD_X2000_510_I2C2_BUS
    bool "选择I2C2"

choice "              选择I2C2 GPIO"
    default MD_X2000_510_I2C2_PB
    depends on MD_X2000_510_I2C2_BUS

config MD_X2000_510_I2C2_PB
    bool "SCL:GPIO_PB(22) SDA:GPIO_PB(23)"

config MD_X2000_510_I2C2_PD
    bool "SCL:GPIO_PD(20) SDA:GPIO_PD(21)"

config MD_X2000_510_I2C2_PE
    bool "SCL:GPIO_PE(19) SDA:GPIO_PE(20)"

endchoice

config MD_X2000_510_I2C2_RATE
    int "       I2C2 速度 "
    default 400000
    depends on MD_X2000_510_I2C2_BUS



config MD_X2000_510_I2C3_BUS
    bool "选择I2C3"

choice "              选择I2C3 GPIO"
    default MD_X2000_510_I2C3_PA
    depends on MD_X2000_510_I2C3_BUS

config MD_X2000_510_I2C3_PA
    bool "SCL:GPIO_PA(16) SDA:GPIO_PA(17)"

config MD_X2000_510_I2C3_PD
    bool "SCL:GPIO_PD(30) SDA:GPIO_PD(31)"

endchoice

config MD_X2000_510_I2C3_RATE
    int "        I2C3 速度 "
    default 400000
    depends on MD_X2000_510_I2C3_BUS



config MD_X2000_510_I2C4_BUS
    bool "选择I2C4"

choice "              选择I2C4 GPIO"
    default MD_X2000_510_I2C4_PC
    depends on MD_X2000_510_I2C4_BUS

config MD_X2000_510_I2C4_PC
    bool "SCL:GPIO_PC(25) SDA:GPIO_PC(26)"

config MD_X2000_510_I2C4_PD
    bool "SCL:GPIO_PD(0) SDA:GPIO_PD(1)"

endchoice

config MD_X2000_510_I2C4_RATE
    int "        I2C4 速度 "
    default 400000
    depends on MD_X2000_510_I2C4_BUS



config MD_X2000_510_I2C5_BUS
    bool "选择I2C5"

choice "              选择I2C5 GPIO"
    default MD_X2000_510_I2C5_PC
    depends on MD_X2000_510_I2C5_BUS

config MD_X2000_510_I2C5_PC
    bool "SCL:GPIO_PC(27) SDA:GPIO_PC(28)"

config MD_X2000_510_I2C5_PD
    bool "SCL:GPIO_PD(4) SDA:GPIO_PD(5)"

endchoice

config MD_X2000_510_I2C5_RATE
    int "        I2C5 速度 "
    default 400000
    depends on MD_X2000_510_I2C5_BUS
endmenu
```

## module_driver/package/soc/x2000_510/icodec/Config.in
```kconfig
menuconfig MD_X2000_510_ICODEC
    bool "icodec(内部codec)"
    select MD_X2000_510_AIC

config MD_X2000_510_ICODEC_BAIS_ON
    bool "开启偏置电压（录音时打开）"
    default y
    help
        对于外接的模拟mic,内部codec需要提前打开偏置电压
        对于回采电路，则不需要打开偏置电压

config MD_X2000_510_ICODEC_BAIS_LEVEL
    int "偏置电压的寄存器数值(范围0-7)"
    default 7

config MD_X2000_510_ICODEC_SPK_GPIO1
    string "功放引脚1"
    choice from SOC_GPIO_PINS
    default -1

config MD_X2000_510_ICODEC_SPK_GPIO1_LEVEL
    string "功放引脚1使能电平"
    choice from MD_GPIO_ACTIVE_LEVEL
    default 1

config MD_X2000_510_ICODEC_SPK_GPIO2
    string "功放引脚2"
    choice from SOC_GPIO_PINS
    default -1

config MD_X2000_510_ICODEC_SPK_GPIO2_LEVEL
    string "功放引脚2使能电平"
    choice from MD_GPIO_ACTIVE_LEVEL
    default 1

config MD_X2000_510_ICODEC_SPK_NEED_DELAY_MS
    int "功放引脚使能后需要的延时时间(ms)"
    default 20
    help
        部分功放芯片的时序需要在使能功放引脚后加一定的延时

config MD_X2000_510_ICODEC_MAX_HPOUT_VAL
    int "外放音量最大值(对应寄存器GCR_DACL的[0,4],可填范围是0到31)"
    default 31
    help
        其中0代表-31dB，26代表5dB,31代表0dB.增加1，音量增加1.0dB

config MD_X2000_510_ICODEC_MIN_HPOUT_VAL
    int "外放音量最小值(对应寄存器GCR_ADCL的[0,4],可填范围是0到31)"
    default 0
    help
        其中0代表-31dB，26代表5dB,31代表0dB.增加1，音量增加1.0dB

endmenu
```

## module_driver/package/soc/x2000_510/msc/Config.in
```kconfig
menuconfig MD_X2000_510_MSC
    bool "msc 控制器驱动"

config MD_X2000_510_WIFI_POWER_ON
    string "    wifi 模块供电引脚"
    choice from SOC_GPIO_PINS
    default -1

config MD_X2000_510_WIFI_POWER_LEVEL
	string "wifi_power_on_level (msc 模块加载前设置 wifi 供电引脚的电平,使 wifi 断电)"
	default 0
	choice from MD_GPIO_ACTIVE_LEVEL

config MD_X2000_510_WIFI_REG_ON
    string "    wifi 使能引脚"
    choice from SOC_GPIO_PINS
    default -1

config MD_X2000_510_WIFI_REG_LEVEL
	string "wifi_reg_on_level (msc 模块加载前设置 wifi 使能引脚的电平,使 wifi 断电)"
	default 0
	choice from MD_GPIO_ACTIVE_LEVEL

source package/soc/x2000_510/msc/msc0.in
source package/soc/x2000_510/msc/msc1.in
source package/soc/x2000_510/msc/msc2.in
endmenu # MSC 总线
```

## module_driver/package/vendor/Config.in
```kconfig
menu "客户的驱动"
    help
        客户的驱动请自行定义在vendor 目录下,自行管理目录结构
        所有的配置项请以 MD_VENDOR_ 或者 MDV_ 打头，以免和君正定义的宏定义冲突

endmenu
```
