## module_driver/package/soc/x1830/icodec/Config.in
```kconfig
menuconfig MD_X1830_ICODEC
    bool "icodec(内部codec)"
    select MD_X1830_AIC

config MD_X1830_ICODEC_BAIS_ON
    bool "开启偏置电压 (bias_on)"
    default n
    help
        对于外接的模拟mic,内部codec需要提前打开偏置电压
        对于回采电路，则不需要打开偏置电压

config MD_X1830_ICODEC_KEEP_BIAS_ON
    bool "模块加载时 偏置电压 (bias_on) 直接输出电压并保持"
    default n
    depends on MD_X1830_ICODEC_BAIS_ON

config MD_X1830_SET_BIAS_ON_VOLTAGE_LEVEL
    int "       偏置电压 (bias_on) 输出电压增益,数值 0～7 对应 1.0～1.7 倍电压"
    default 0
    depends on MD_X1830_ICODEC_KEEP_BIAS_ON
    help
        "增益可填 0～7, 对应 1.0～1.7 倍电压"

config MD_X1830_ICODEC_SPK_GPIO
    string "功放引脚"
    choice from SOC_GPIO_PINS
    default -1

config MD_X1830_ICODEC_MAX_HPOUT_VAL
    int "外放音量最大值(对应寄存器CHCR的[0,4],可填范围是0到31)"
    default 31
    help
        其中0代表-39dB，26代表0dB,31代表6dB.增加1，音量增加1.5dB

config MD_X1830_ICODEC_MIN_HPOUT_VAL
    int "外放音量最小值(对应寄存器CHCR的[0,4],可填范围是0到31)"
    default 0
    help
        其中0代表-39dB，26代表0dB,31代表6dB.增加1，音量增加1.5dB

endmenu
```

## module_driver/package/soc/x1830/mscaler/Config.in
```kconfig
menuconfig MD_X1830_MSCALER
    bool "mscaler 驱动(图像缩放功能)"

config MD_X1830_MSCALER_DETAIL
    int "mscaler 清晰度调试（0-100）"
    default 50

endmenu
```

## module_driver/package/soc/x1830/spi/Config.in
```kconfig
array SOC_X1830_SPI0_MISO_IO
    string "SPI0 MISO(DR) 引脚"
    item "GPIO_NULL  " -1
    item "PC11" PC11

array SOC_X1830_SPI0_MOSI_IO
    string "SPI0 MOSI(DT) 引脚"
    item "GPIO_NULL  " -1
    item "PC12" PC12

array SOC_X1830_SPI0_CLK_IO
    string "SPI0 CLK 引脚"
    item "GPIO_NULL  " -1
    item "PC15" PC15



array SOC_X1830_SPI1_MISO_IO
    string "SPI1 MISO(DR) 引脚"
    item "GPIO_NULL  " -1
    item "PC20" PC20

array SOC_X1830_SPI1_MOSI_IO
    string "SPI1 MOSI(DT) 引脚"
    item "GPIO_NULL  " -1
    item "PC19" PC19

array SOC_X1830_SPI1_CLK_IO
    string "SPI1 CLK 引脚"
    item "GPIO_NULL  " -1
    item "PC23" PC23



menu "SPI 总线"
    help
        "依赖于 SPI 驱动"

config MD_X1830_SPI
    bool



config MD_X1830_SPI0
    bool "选择 SPI0"
    select MD_X1830_SPI

config MD_X1830_SPI0_MISO
    string "        MISO(输入引脚)"
    default PC11
    choice from SOC_X1830_SPI0_MISO_IO
    depends on MD_X1830_SPI0
    help
        "MISO= -1,表示不使用MISO引脚"

config MD_X1830_SPI0_MOSI
    string "        MOSI(输出引脚)"
    default PC12
    choice from SOC_X1830_SPI0_MOSI_IO
    depends on MD_X1830_SPI0
    help
        "MOSI= -1,表示不使用MOSI引脚"

config MD_X1830_SPI0_CLK
    string "        CLK(时钟引脚)"
    default PC15
    choice from SOC_X1830_SPI0_CLK_IO
    depends on MD_X1830_SPI0



config MD_X1830_SPI1
    bool "选择 SPI1"
    select MD_X1830_SPI

config MD_X1830_SPI1_MISO
    string "        MISO(输入引脚)"
    default PC20
    choice from SOC_X1830_SPI1_MISO_IO
    depends on MD_X1830_SPI1
    help
        "MISO= -1,表示不使用MISO引脚"

config MD_X1830_SPI1_MOSI
    string "        MOSI(输出引脚)"
    default PC19
    choice from SOC_X1830_SPI1_MOSI_IO
    depends on MD_X1830_SPI1
    help
        "MOSI= -1,表示不使用MOSI引脚"

config MD_X1830_SPI1_CLK
    string "        CLK(时钟引脚)"
    default PC23
    choice from SOC_X1830_SPI1_CLK_IO
    depends on MD_X1830_SPI1

endmenu # SPI 总线
```

## module_driver/package/soc/x1830/utils/Config.in
```kconfig
menuconfig MD_X1830_UTILS
    bool "utils 驱动(芯片的一些小功能)"

config MD_X1830_UTILS_RTC32K
    bool "rtc32k 时钟bypas输出(PB18)"
    default y

config MD_X1830_UTILS_RTC32K_INIT_ON
    bool "        初始化即使能rtc32k输出"
    depends on MD_X1830_UTILS_RTC32K

endmenu
```

## module_driver/package/soc/x2000/Config.in
```kconfig
menuconfig MD_SOC_X2000
    bool "x2000驱动列表"
    depends on MD_CHOICE_SOC_X2000

config MD_SOC_DIR
    string
    default soc/x2000

source package/soc/x2000/adc/Config.in
source package/soc/x2000/gpio/Config.in
source package/soc/x2000/watchdog/Config.in
source package/soc/x2000/dtrng/Config.in
source package/soc/x2000/i2c/Config.in
source package/soc/x2000/dmic/Config.in
source package/soc/x2000/spi/Config.in
source package/soc/x2000/pwm/Config.in
source package/soc/x2000/fb/Config.in
source package/soc/x2000/fb_layer_mixer/Config.in
source package/soc/x2000/camera/Config.in
source package/soc/x2000/audio_dma/Config.in
source package/soc/x2000/mac/Config.in
source package/soc/x2000/aic/Config.in
source package/soc/x2000/icodec/Config.in
source package/soc/x2000/hash/Config.in

source package/soc/x2000/def_gpio_pins.in

source package/soc/x2000/efuse/Config.in
source package/soc/x2000/utils/Config.in
source package/soc/x2000/msc/Config.in
source package/soc/x2000/uart/Config.in
source package/soc/x2000/spdif/Config.in
source package/soc/x2000/mcu/Config.in
source package/soc/x2000/tcu/Config.in
source package/soc/x2000/conn/Config.in
source package/soc/x2000/rotator/Config.in
source package/soc/x2000/conn_vic/Config.in
source package/soc/x2000/conn_fb/Config.in
source package/soc/x2000/conn_isp/Config.in
source package/soc/x2000/conn_pcm/Config.in
source package/soc/x2000/conn_fs/Config.in

source package/soc/x2000/aes/Config.in
endmenu
```

## module_driver/package/soc/x2000/adc/Config.in
```kconfig
menuconfig MD_X2000_ADC
    bool "adc 驱动(电压采样功能)"

config MD_X2000_ADC_VREF
    int "参考电压mv"
    default 1800

endmenu
```

## module_driver/package/soc/x2000/conn/Config.in
```kconfig
menuconfig MD_X2000_CONN
    bool "conn(核间通信功能)"

config MD_X2000_CONN_MAX_LINK_COUNT
    int "conn 可用的最大连接数"
    default 16

endmenu
```

## module_driver/package/soc/x2000/conn_fs/Config.in
```kconfig
menuconfig MD_X2000_CONN_FS
    bool "接收RTOS端的FS驱动操作(核间通信)"
    help
        "使用核间通讯接收RTOS读/写相关操作,将操作内容同步到文件系统中"

endmenu
```

## module_driver/package/soc/x2000/conn_pcm/Config.in
```kconfig
menuconfig MD_X2000_CONN_PCM
    bool "使用RTOS端的PCM驱动(核间通信)"

source package/soc/x2000/conn_pcm/conn_pcm_playback/Config.in
endmenu
```

## module_driver/package/soc/x2000/mac/Config.in
```kconfig
menuconfig MD_X2000_MAC
    bool "mac 以太网控制器驱动"

config MD_X2000_PHY_CLK_RATE
    int "PHY CLK 速率"
    default 0
    help
        PHY_CLK引脚时钟,可以提供給外部phy作为时钟源
        如果不需要请配置成0

config MD_X2000_PHY_CLK_DELAY_US
    int "PHY CLK 使能后延迟时间再通讯(单位：us)"
    default 0

config MD_X2000_MAC0
    bool "mac0"

choice "选择MAC支持模式"
    default MD_X2000_MAC0_RMII_MODE
    depends on MD_X2000_MAC0

config MD_X2000_MAC0_RMII_MODE
    bool "  RMII_MODE（简化的百兆媒体独立接口）"

config MD_X2000_MAC0_RGMII_MODE
    bool "  RGMII_MODE（简化的千兆媒体独立接口）"

endchoice

config MD_X2000_MAC0_PHY_PROBE_MASK
    int "PHY探测屏蔽(范围：0x0～0xffffffff)"
    default 0x0
    depends on MD_X2000_MAC0
    help
        phy探测屏蔽为32位代表32个地址(0:使能探测 1:屏蔽探测)
        例如：0xfffffff0(探测前4个地址)

config MD_X2000_MAC0_PHY_RESET_TIME_US
    int "PHY复位时间(单位：us)"
    default 100000
    depends on MD_X2000_MAC0

config MD_X2000_MAC0_PHY_RESET_GPIO
    string "PHY 复位引脚"
    choice from SOC_GPIO_PINS
    default -1
    depends on MD_X2000_MAC0

config MD_X2000_MAC0_PHY_VALID_LEVEL
    string "PHY 复位电平"
    choice from MD_GPIO_ACTIVE_LEVEL
    default 0
    depends on MD_X2000_MAC0

config MD_X2000_MAC0_RX_CLK_DELAY_UNIT
    int "RX CLK延时时间(范围：0~128)"
    default 0
    depends on MD_X2000_MAC0
    depends on MD_X2000_MAC0_RGMII_MODE
    help
        例如：delay_time = X * 19.5(ps);
        配置值范围0-128,RXCLK延时的时间范围0-2.5ns
        具体配置值需要由phy来确定,TXCLK和RXCLK和data保证2ns左右的delay.
        如果phy端已经做了delay,mac控制器端就不需要设置或补足差值.

config MD_X2000_MAC0_TX_CLK_DELAY_UNIT
    int "TX CLK延时时间(范围：0~128)"
    default 0
    depends on MD_X2000_MAC0
    depends on MD_X2000_MAC0_RGMII_MODE
    help
        例如：delay_time = X * 19.5(ps);
        配置值范围0-128,RXCLK延时的时间范围0-2.5ns
        具体配置值需要由phy来确定,TXCLK和RXCLK和data保证2ns左右的delay.
        如果phy端已经做了delay,mac控制器端就不需要设置或补足差值.

config MD_X2000_MAC0_TX_CLK
    bool "MAC0以TX_CLK引脚提供给外部PHY作为时钟源(申请TX_CLK引脚)"
    depends on MD_X2000_MAC0
    depends on MD_X2000_MAC0_RMII_MODE

config MD_X2000_MAC0_TX_CLK_RATE
    int "MAC0 TX CLK速率"
    default 50000000
    depends on MD_X2000_MAC0_TX_CLK

config MD_X2000_MAC0_TX_CLK_DELAY_US
    int "MAC0 TX CLK 使能后延迟时间再通讯(单位：us)"
    default 0
    depends on MD_X2000_MAC0_TX_CLK

config MD_X2000_MAC0_CRYSTAL_CLK
    bool "MAC0以晶振提供给外部PHY作为时钟源(不申请PHY_CLK引脚)"
    depends on MD_X2000_MAC0

config MD_X2000_MAC0_VIRTUAL_PHY
    bool "MAC0外接虚拟phy设备，RGMII/RMII直接通讯，用于两个gmac互接省略phy芯片或用于直接与FPGA芯片通讯"
    depends on MD_X2000_MAC0

config MD_X2000_MAC1
    bool "mac1"

choice "选择MAC支持模式"
    default MD_X2000_MAC1_RMII_MODE
    depends on MD_X2000_MAC1

config MD_X2000_MAC1_RMII_MODE
    bool "  RMII_MODE（简化的百兆媒体独立接口）"

config MD_X2000_MAC1_RGMII_MODE
    bool "  RGMII_MODE（简化的千兆媒体独立接口）"

endchoice

config MD_X2000_MAC1_PHY_PROBE_MASK
    int "PHY探测屏蔽(范围：0x0～0xffffffff)"
    default 0x0
    depends on MD_X2000_MAC1
    help
        phy探测屏蔽为32位代表32个地址(0:使能探测 1:屏蔽探测)
        例如：0xfffffff0(探测前4个地址)

config MD_X2000_MAC1_PHY_RESET_TIME_US
    int "PHY复位时间(单位：us)"
    default 100000
    depends on MD_X2000_MAC1

config MD_X2000_MAC1_PHY_RESET_GPIO
    string "PHY 复位引脚"
    choice from SOC_GPIO_PINS
    default -1
    depends on MD_X2000_MAC1

config MD_X2000_MAC1_PHY_VALID_LEVEL
    string "PHY 复位电平"
    choice from MD_GPIO_ACTIVE_LEVEL
    default 0
    depends on MD_X2000_MAC1

config MD_X2000_MAC1_RX_CLK_DELAY_UNIT
    int "RX CLK延时时间(范围：0~128)"
    default 0
    depends on MD_X2000_MAC1
    depends on MD_X2000_MAC1_RGMII_MODE
    help
        例如：delay_time = X * 19.5(ps);
        配置值范围0-128,RXCLK延时的时间范围0-2.5ns
        具体配置值需要由phy来确定,TXCLK和RXCLK和data保证2ns左右的delay.
        如果phy端已经做了delay,mac控制器端就不需要设置或补足差值.

config MD_X2000_MAC1_TX_CLK_DELAY_UNIT
    int "TX CLK延时时间(范围：0~128)"
    default 0
    depends on MD_X2000_MAC1
    depends on MD_X2000_MAC1_RGMII_MODE
    help
        例如：delay_time = X * 19.5(ps);
        配置值范围0-128,RXCLK延时的时间范围0-2.5ns
        具体配置值需要由phy来确定,TXCLK和RXCLK和data保证2ns左右的delay.
        如果phy端已经做了delay,mac控制器端就不需要设置或补足差值.

config MD_X2000_MAC1_TX_CLK
    bool "MAC1以TX_CLK引脚提供给外部PHY作为时钟源(申请TX_CLK引脚)"
    depends on MD_X2000_MAC1
    depends on MD_X2000_MAC1_RMII_MODE

config MD_X2000_MAC1_TX_CLK_RATE
    int "MAC1 TX CLK速率"
    default 50000000
    depends on MD_X2000_MAC1_TX_CLK

config MD_X2000_MAC1_TX_CLK_DELAY_US
    int "MAC1 TX CLK 使能后延迟时间再通讯(单位：us)"
    default 0
    depends on MD_X2000_MAC1_TX_CLK

config MD_X2000_MAC1_CRYSTAL_CLK
    bool "MAC1以晶振提供给外部PHY作为时钟源(不申请PHY_CLK引脚)"
    depends on MD_X2000_MAC1

config MD_X2000_MAC1_VIRTUAL_PHY
    bool "MAC1外接虚拟phy设备，RGMII/RMII直接通讯，用于两个gmac互接省略phy芯片或用于直接与FPGA芯片通讯"
    depends on MD_X2000_MAC1

endmenu
```

## module_driver/package/soc/x2000/msc/Config.in
```kconfig
menuconfig MD_X2000_MSC
    bool "msc 控制器驱动"

config MD_X2000_WIFI_POWER_ON
    string "    wifi 模块供电引脚"
    choice from SOC_GPIO_PINS
    default -1

config MD_X2000_WIFI_POWER_LEVEL
	string "wifi 初始化电平 (msc 模块加载前设置 wifi 供电引脚的电平,使 wifi 断电)"
	default 0
	choice from MD_GPIO_ACTIVE_LEVEL

config MD_X2000_WIFI_REG_ON
    string "    wifi 使能引脚"
    choice from SOC_GPIO_PINS
    default -1

config MD_X2000_WIFI_REG_LEVEL
	string "wifi 初始化电平 (msc 模块加载前设置 wifi 使能引脚的电平,使 wifi 失能)"
	default 0
	choice from MD_GPIO_ACTIVE_LEVEL

source package/soc/x2000/msc/msc0.in
source package/soc/x2000/msc/msc1.in
source package/soc/x2000/msc/msc2.in
endmenu # MSC 总线
```

## module_driver/package/soc/x2000/pwm/Config.in
```kconfig
menuconfig MD_X2000_PWM
    bool "pwm 驱动(脉冲宽度调制功能)"

config MD_X2000_PWM_CHECK_DMA_DATA
    bool "检查PWM DMA数据正确性"
    default n
    help
        内部需要判断每个数据,影响效率.建议调用函数前确保数据正确性,不要使能内部校验.

endmenu
```
