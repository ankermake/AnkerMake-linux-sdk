## module_driver/package/soc/x1000/mac/Config.in
```kconfig
menuconfig MD_X1000_MAC
    bool "mac 以太网控制器驱动"

config MD_X1000_PHY_PROBE_MASK
    int "PHY探测屏蔽(范围：0x0～0xffffffff)"
    default 0x0
    help
        phy探测屏蔽为32位代表32个地址(0:使能探测 1:屏蔽探测)
        例如：0xfffffff0(探测前4个地址)

config MD_X1000_PHY_CLK_DELAY_US
    int "PHY CLK 使能后延迟时间再通讯(单位：us)"
    default 0

config MD_X1000_PHY_RESET_TIME_US
    int "PHY复位时间(单位：us)"
    default 10000

config MD_X1000_PHY_RESET_GPIO
    string "PHY 复位引脚"
    choice from SOC_GPIO_PINS
    default -1

config MD_X1000_PHY_VALID_LEVEL
    string "PHY 复位电平"
    choice from PHY_RESET_LEVEL
    default 0

endmenu

array PHY_RESET_LEVEL
    string "RESET_LEVEL"
    item "RESET_LEVEL" 0
    item "RESET_LEVEL" 1
```

## module_driver/package/soc/x1000/spi/Config.in
```kconfig
array SOC_X1000_SPI0_MISO_IO
    string "SPI MISO(DR) 引脚"
    item "GPIO_NULL  " -1
    item "PA23" PA23
    item "PA28" PA28
    item "PD3" PD3

array SOC_X1000_SPI0_MOSI_IO
    string "SPI MOSI(DT) 引脚"
    item "GPIO_NULL  " -1
    item "PA22" PA22
    item "PA29" PA29
    item "PD2" PD2

array SOC_X1000_SPI0_CLK_IO
    string "SPI CLK 引脚"
    item "GPIO_NULL  " -1
    item "PA24" PA24
    item "PA26" PA26
    item "PD0" PD0

menu "SPI 总线"
    help
        "依赖于 SPI 驱动"

config MD_X1000_SPI
    bool "选择 SPI0"

config MD_X1000_SPI0_MISO
    string "        MISO(输入引脚)"
    default PA23
    choice from SOC_X1000_SPI0_MISO_IO
    depends on MD_X1000_SPI
    help
        "MISO= -1,表示不使用MISO引脚"

config MD_X1000_SPI0_MOSI
    string "        MOSI(输出引脚)"
    default PA22
    choice from SOC_X1000_SPI0_MOSI_IO
    depends on MD_X1000_SPI
    help
        "MOSI= -1,表示不使用MOSI引脚"

config MD_X1000_SPI0_CLK
    string "        CLK(时钟引脚)"
    default PA24
    choice from SOC_X1000_SPI0_CLK_IO
    depends on MD_X1000_SPI

endmenu # SPI 总线
```

## module_driver/package/soc/x1000/utils/Config.in
```kconfig
menuconfig MD_X1000_UTILS
    bool "utils 驱动(芯片的一些小功能)"

config MD_X1000_UTILS_RTC32K
    bool "rtc32k 时钟bypas输出(PB26)"
    default y

config MD_X1000_UTILS_RTC32K_INIT_ON
    bool "        初始化即使能rtc32k输出"
    depends on MD_X1000_UTILS_RTC32K



config MD_X1000_UTILS_CLK24M
    bool "clk24m 时钟bypas输出(PB27)"
    default y

config MD_X1000_UTILS_CLK24M_INIT_ON
    bool "        初始化即使能clk24m输出"
    depends on MD_X1000_UTILS_CLK24M

endmenu
```

## module_driver/package/soc/x1021/Config.in
```kconfig
menuconfig MD_SOC_X1021
    bool "x1021 驱动列表"
    depends on MD_CHOICE_SOC_X1021

config MD_SOC_DIR
    string
    default soc/x1021

source package/soc/x1021/def_gpio_pins.in

source package/soc/x1021/spi/Config.in

source package/soc/x1021/adc/Config.in

source package/soc/x1021/efuse/Config.in

source package/soc/x1021/pwm/Config.in

source package/soc/x1021/watchdog/Config.in

source package/soc/x1021/i2c/Config.in

source package/soc/x1021/utils/Config.in

source package/soc/x1021/mac/Config.in

source package/soc/x1021/fb/Config.in

source package/soc/x1021/camera/Config.in

source package/soc/x1021/gpio/Config.in

source package/soc/x1021/icodec/Config.in

source package/soc/x1021/aic/Config.in

endmenu
```

## module_driver/package/soc/x1021/fb/Config.in
```kconfig
menuconfig MD_X1021_FB
    bool "fb 显示驱动"
    help
        Framebuffer support for the x1000 SoC.
        kernel must select those options
        select FB
        select FB_CFB_FILLRECT
        select FB_CFB_COPYAREA
        select FB_CFB_IMAGEBLIT


config MD_X1021_FB_FRAME_NUM
    int "帧缓冲数量"
    default 1

config MD_X1021_FB_PAN_DISPLAY_SYNC
    bool "pan_display 调用时等待帧刷新完成(单缓冲时选中)"
    default y

choice "       选择LCD接口的引脚定义"
    default MD_X1021_SLCD_GPIOB

config MD_X1021_SLCD_GPIOB
    bool "1.使用GPIO_PB中的相关引脚"
    help
        D0:PB06  D1:PB07  D2:PB08
        D3:PB09  D4:PB10  D5:PB11
        D6:PB13  D7:PB14  WR:PB15
        TE:PB16  CS:PB17  DC:PB18

config MD_X1021_SLCD_GPIOC
    bool "2.使用GPIO_PC中的相关引脚"
    help
        D0:PC02  D1:PC03  D2:PC04
        D3:PC05  D4:PC06  D5:PC07
        D6:PC17  D7:PC18  WR:PC15
        TE:PC16  CS:PC09  DC:PC08

endchoice

endmenu
```

## module_driver/package/soc/x1021/i2c/Config.in
```kconfig
menuconfig MD_X1021_I2C
    bool "i2c 控制器驱动"


config MD_X1021_I2C0_BUS
    bool "选择I2C0"

choice "              选择I2C0 GPIO"
    default MD_X1021_I2C0_PA
    depends on MD_X1021_I2C0_BUS

config MD_X1021_I2C0_PA
    bool "SCL:GPIO_PA(13) SDA:GPIO_PA(12)"

endchoice

config MD_X1021_I2C0_RATE
    int "       I2C0 速度 "
    default 400000
    depends on MD_X1021_I2C0_BUS



config MD_X1021_I2C1_BUS
    bool "选择I2C1"

choice "              选择I2C1 GPIO"
    default MD_X1021_I2C1_PB
    depends on MD_X1021_I2C1_BUS

config MD_X1021_I2C1_PB
    bool "SCL:GPIO_PB(26) SDA:GPIO_PB(25)"

config MD_X1021_I2C1_PC
    bool "SCL:GPIO_PC(9) SDA:GPIO_PC(8)"

endchoice

config MD_X1021_I2C1_RATE
    int "        I2C1 速度 "
    default 400000
    depends on MD_X1021_I2C1_BUS

endmenu
```

## module_driver/package/soc/x1021/mac/Config.in
```kconfig
menuconfig MD_X1021_MAC
    bool "mac 以太网控制器驱动"

choice "选择使用的phy"
    default MD_X1021_MAC_INNERAL_PHY

config MD_X1021_MAC_INNERAL_PHY
    bool " 使用内部phy"

config MD_X1021_MAC_EXTERNAL_PHY
    bool " 使用外部phy"

endchoice

config MD_X1021_MAC_10M_SPEED_LED
    bool " 打开link成功10M指示灯(引脚:PB6)"
    depends on MD_X1021_MAC_INNERAL_PHY

config MD_X1021_MAC_100M_SPEED_LED
    bool " 打开link成功100M指示灯(引脚:PB13)"
    depends on MD_X1021_MAC_INNERAL_PHY

config MD_X1021_MAC_LINK_LED
    bool " 打开link成功指示灯(引脚:PB15)"
    depends on MD_X1021_MAC_INNERAL_PHY

config MD_X1021_MAC_DUPLEX_LED
    bool " 打开全双工数据传输指示灯(引脚:PB14)"
    depends on MD_X1021_MAC_INNERAL_PHY

config MD_X1021_MAC_TX_LED
    bool " 打开发送数据指示灯(引脚:PB7)"
    depends on MD_X1021_MAC_INNERAL_PHY

config MD_X1021_MAC_RX_LED
    bool " 打开接收数据指示灯(引脚:PB16)"
    depends on MD_X1021_MAC_INNERAL_PHY

config MD_X1021_PHY_PROBE_MASK
    int "PHY探测屏蔽(范围：0x0～0xffffffff)"
    depends on MD_X1021_MAC_EXTERNAL_PHY
    default 0x0
    help
        phy探测屏蔽为32位代表32个地址(0:使能探测 1:屏蔽探测)
        例如：0xfffffff0(探测前4个地址)

config MD_X1021_PHY_CLK_DELAY_US
    int "PHY CLK 使能后延迟时间再通讯(单位：us)"
    depends on MD_X1021_MAC_EXTERNAL_PHY
    default 0

config MD_X1021_PHY_RESET_TIME_US
    int "PHY复位时间(单位：us)"
    depends on MD_X1021_MAC_EXTERNAL_PHY
    default 1000

config MD_X1021_PHY_RESET_GPIO
    string "PHY 复位引脚"
    choice from SOC_GPIO_PINS
    depends on MD_X1021_MAC_EXTERNAL_PHY
    default -1

config MD_X1021_PHY_VALID_LEVEL
    string "PHY 复位电平"
    choice from PHY_RESET_LEVEL
    depends on MD_X1021_MAC_EXTERNAL_PHY
    default 0

endmenu

array PHY_RESET_LEVEL
    string "RESET_LEVEL"
    item "RESET_LEVEL" 0
    item "RESET_LEVEL" 1
```

## module_driver/package/soc/x1021/spi/Config.in
```kconfig
array SOC_X1021_SPI0_MISO_IO
    string "SPI0 MISO(DR) 引脚"
    item "GPIO_NULL  " -1
    item "PC11" PC11

array SOC_X1021_SPI0_MOSI_IO
    string "SPI0 MOSI(DT) 引脚"
    item "GPIO_NULL  " -1
    item "PC12" PC12

array SOC_X1021_SPI0_CLK_IO
    string "SPI0 CLK 引脚"
    item "GPIO_NULL  " -1
    item "PC13" PC13



array SOC_X1021_SPI1_MISO_IO
    string "SPI1 MISO(DR) 引脚"
    item "GPIO_NULL  " -1
    item "PB9" PB9

array SOC_X1021_SPI1_MOSI_IO
    string "SPI1 MOSI(DT) 引脚"
    item "GPIO_NULL  " -1
    item "PB8" PB8

array SOC_X1021_SPI1_CLK_IO
    string "SPI1 CLK 引脚"
    item "GPIO_NULL  " -1
    item "PB10" PB10



menu "SPI 总线"
    help
        "依赖于 SPI 驱动"

config MD_X1021_SPI
    bool



config MD_X1021_SPI0
    bool "选择 SPI0"
    select MD_X1021_SPI

config MD_X1021_SPI0_MISO
    string "        MISO(输入引脚)"
    default PC11
    choice from SOC_X1021_SPI0_MISO_IO
    depends on MD_X1021_SPI0
    help
        "MISO= -1,表示不使用MISO引脚"

config MD_X1021_SPI0_MOSI
    string "        MOSI(输出引脚)"
    default PC12
    choice from SOC_X1021_SPI0_MOSI_IO
    depends on MD_X1021_SPI0
    help
        "MOSI= -1,表示不使用MOSI引脚"

config MD_X1021_SPI0_CLK
    string "        CLK(时钟引脚)"
    default PC13
    choice from SOC_X1021_SPI0_CLK_IO
    depends on MD_X1021_SPI0



config MD_X1021_SPI1
    bool "选择 SPI1"
    select MD_X1021_SPI

config MD_X1021_SPI1_MISO
    string "        MISO(输入引脚)"
    default PB9
    choice from SOC_X1021_SPI1_MISO_IO
    depends on MD_X1021_SPI1
    help
        "MISO= -1,表示不使用MISO引脚"

config MD_X1021_SPI1_MOSI
    string "        MOSI(输出引脚)"
    default PB8
    choice from SOC_X1021_SPI1_MOSI_IO
    depends on MD_X1021_SPI1
    help
        "MOSI= -1,表示不使用MOSI引脚"

config MD_X1021_SPI1_CLK
    string "        CLK(时钟引脚)"
    default PB10
    choice from SOC_X1021_SPI1_CLK_IO
    depends on MD_X1021_SPI1

endmenu # SPI 总线
```

## module_driver/package/soc/x1520/Config.in
```kconfig
menuconfig MD_SOC_X1520
    bool "x1520 驱动列表"
    depends on MD_CHOICE_SOC_X1520

config MD_SOC_DIR
    string
    default soc/x1520

source package/soc/x1520/def_gpio_pins.in

source package/soc/x1520/spi/Config.in

source package/soc/x1520/adc/Config.in

source package/soc/x1520/efuse/Config.in

source package/soc/x1520/pwm/Config.in

source package/soc/x1520/watchdog/Config.in

source package/soc/x1520/i2c/Config.in

source package/soc/x1520/utils/Config.in

source package/soc/x1520/camera/Config.in

source package/soc/x1520/gpio/Config.in

source package/soc/x1520/icodec/Config.in

source package/soc/x1520/aic/Config.in

endmenu
```

## module_driver/package/soc/x1520/camera/Config.in
```kconfig
menuconfig MD_X1520_CAMERA
    bool "camera 驱动(vic控制器,不使用isp)"

config MD_X1520_CAMERA_FRAME_NUMS
    int "camera帧缓冲数"
    default 2

endmenu
```

## module_driver/package/soc/x1520/spi/Config.in
```kconfig
array SOC_X1520_SPI0_MISO_IO
    string "SPI MISO(DR) 引脚"
    item "GPIO_NULL  " -1
    item "PC11" PC11

array SOC_X1520_SPI0_MOSI_IO
    string "SPI MOSI(DT) 引脚"
    item "GPIO_NULL  " -1
    item "PC12" PC12

array SOC_X1520_SPI0_CLK_IO
    string "SPI CLK 引脚"
    item "GPIO_NULL  " -1
    item "PC15" PC15

menu "SPI 总线"
    help
        "依赖于 SPI 驱动"

config MD_X1520_SPI
    bool

config MD_X1520_SPI0
    bool "选择 SPI0"
    select MD_X1520_SPI

config MD_X1520_SPI0_MISO
    string "        MISO(输入引脚)"
    default PC11
    choice from SOC_X1520_SPI0_MISO_IO
    depends on MD_X1520_SPI0
    help
        "MISO= -1,表示不使用MISO引脚"

config MD_X1520_SPI0_MOSI
    string "        MOSI(输出引脚)"
    default PC12
    choice from SOC_X1520_SPI0_MOSI_IO
    depends on MD_X1520_SPI0
    help
        "MOSI= -1,表示不使用MOSI引脚"

config MD_X1520_SPI0_CLK
    string "        CLK(时钟引脚)"
    default PC15
    choice from SOC_X1520_SPI0_CLK_IO
    depends on MD_X1520_SPI0

endmenu # SPI 总线
```

## module_driver/package/soc/x1600/Config.in
```kconfig
menuconfig MD_SOC_X1600
    bool "x1600驱动列表"
    depends on MD_CHOICE_SOC_X1600_BASE

config MD_SOC_DIR
    string
    default soc/x1600

source package/soc/x1600/def_gpio_pins.in

source package/soc/x1600/gpio/Config.in

source package/soc/x1600/watchdog/Config.in

source package/soc/x1600/utils/Config.in

source package/soc/x1600/i2c/Config.in

source package/soc/x1600/spi/Config.in

source package/soc/x1600/sslv/Config.in

source package/soc/x1600/camera/Config.in

source package/soc/x1600/adc/Config.in

source package/soc/x1600/fb/Config.in

source package/soc/x1600/mac/Config.in

source package/soc/x1600/pwm/Config.in

source package/soc/x1600/aic/Config.in

source package/soc/x1600/msc/Config.in

source package/soc/x1600/uart/Config.in

source package/soc/x1600/dtrng/Config.in

source package/soc/x1600/hash/Config.in

source package/soc/x1600/aes/Config.in

source package/soc/x1600/efuse/Config.in

endmenu
```

## module_driver/package/soc/x1600/adc/Config.in
```kconfig
menuconfig MD_X1600_ADC
    bool "adc 驱动(电压采样功能)"

config MD_X1600_ADC_VREF
    int "参考电压mv"
    default 3300

endmenu
```
