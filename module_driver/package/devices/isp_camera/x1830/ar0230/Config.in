## module_driver/package/devices/isp_camera/x1830/ar0230/Config.in
```kconfig
menuconfig MD_X1830_SENSOR_ISP_AR0230
    bool "sensor ar0230 (dvp,raw12)"
    depends on MD_SOC_X1830

config MD_X1830_AR0230_HDR
    bool "sensor ar0230 HDR (高动态渲染)"

choice "        ar0230 dvp 分辨率选择"
    default MD_X1830_AR0230_1920X1080

config MD_X1830_AR0230_640X1072
    bool "640*1072"

config MD_X1830_AR0230_1920X1080
    bool "1920*1080"

endchoice

config MD_X1830_AR0230_GPIO_RESET
    string "gpio reset(sensor 复位脚)"
    choice from SOC_GPIO_PINS
    default -1

config MD_X1830_AR0230_GPIO_PWDN
    string "gpio pwdn(sensor 电源控制引脚, 低有效)"
    choice from SOC_GPIO_PINS
    default -1

config MD_X1830_AR0230_GPIO_POWER
    string "gpio power(sensor 电源控制引脚, 高有效)"
    choice from SOC_GPIO_PINS
    default -1

config MD_X1830_AR0230_GPIO_I2C_SEL
    string "gpio i2c select(sensor i2c 使能脚)"
    choice from SOC_GPIO_PINS
    default -1

config MD_X1830_AR0230_I2C_BUSNUM
    int "i2c bus num (sensor 挂接的i2c总线号)"
    default -1

source soc/x1830/camera/dvp_gpio_func.in

config MD_X1830_AR0230_DVP_GPIO_FUNC
    string "dvp_gpio_func(dvp 接口选择使用的位数)"
    choice from SENSOR_DVP_GPIO_FUNC
    default -1

config MD_X1830_AR0230_ISPCLK
    int "isp clk (isp 时钟频率)"
    default 90000000

endmenu # MD_X1830_SENSOR_AR0230
```

## module_driver/package/devices/isp_camera/x1830/ar0522/Config.in
```kconfig
menuconfig MD_X1830_SENSOR_ISP_AR0522
    bool "sensor ar0522 (mipi,raw8)"
    depends on MD_SOC_X1830

choice "        ar0522 mipi 分辨率选择"
    default MD_X1830_AR0522_2560X1080

config MD_X1830_AR0522_2560X1080
    bool "2560*1080"

config MD_X1830_AR0522_2592X1944
    bool "2592*1944"

endchoice

config MD_X1830_AR0522_GPIO_RESET
    string "gpio reset(sensor 复位脚)"
    choice from SOC_GPIO_PINS
    default -1

config MD_X1830_AR0522_GPIO_PWDN
    string "gpio pwdn(sensor 电源控制引脚, 低有效)"
    choice from SOC_GPIO_PINS
    default -1

config MD_X1830_AR0522_GPIO_POWER
    string "gpio power(sensor 电源控制引脚, 高有效)"
    choice from SOC_GPIO_PINS
    default -1

config MD_X1830_AR0522_GPIO_I2C_SEL
    string "gpio i2c select(sensor i2c 使能脚)"
    choice from SOC_GPIO_PINS
    default -1

config MD_X1830_AR0522_I2C_BUSNUM
    int "i2c bus num (sensor 挂接的i2c总线号)"
    default -1

config MD_X1830_AR0522_ISPCLK
    int "isp clk (isp 时钟频率)"
    default 150000000

endmenu # MD_X1830_SENSOR_AR0522
```

## module_driver/package/devices/isp_camera/x1830/bf2253l/Config.in
```kconfig
menuconfig MD_X1830_SENSOR_ISP_BF2253L
    bool "sensor bf2253l (mipi,raw10)"
    depends on MD_SOC_X1830

config MD_X1830_BF2253L_GPIO_RESET
    string "gpio reset(sensor 复位脚)"
    choice from SOC_GPIO_PINS
    default -1

config MD_X1830_BF2253L_GPIO_PWDN
    string "gpio pwdn(sensor 电源控制引脚, 低有效)"
    choice from SOC_GPIO_PINS
    default -1

config MD_X1830_BF2253L_GPIO_POWER
    string "gpio power(sensor 电源控制引脚, 高有效)"
    choice from SOC_GPIO_PINS
    default -1

config MD_X1830_BF2253L_GPIO_I2C_SEL
    string "gpio i2c select(sensor i2c 使能脚)"
    choice from SOC_GPIO_PINS
    default -1

config MD_X1830_BF2253L_I2C_BUSNUM
    int "i2c bus num (sensor 挂接的i2c总线号)"
    default -1

config MD_X1830_BF2253L_ISPCLK
    int "isp clk (isp 时钟频率)"
    default 90000000

endmenu # MD_X1830_SENSOR_BF2253L
```

## module_driver/package/devices/isp_camera/x1830/gc2375/Config.in
```kconfig
menuconfig MD_X1830_SENSOR_ISP_GC2375A
    bool "sensor gc2375a (mipi,raw10)"
    depends on MD_SOC_X1830

choice "        gc2375a dvp 分辨率选择"
    default MD_X1830_GC2375A_1600X1200

config MD_X1830_GC2375A_480X800
    bool "640*1072"

config MD_X1830_GC2375A_720X1200
    bool "1280*1080"

config MD_X1830_GC2375A_1600X1200
    bool "1440*1080"

endchoice

config MD_X1830_GC2375A_GPIO_RESET
    string "gpio reset(sensor 复位脚)"
    choice from SOC_GPIO_PINS
    default -1

config MD_X1830_GC2375A_GPIO_PWDN
    string "gpio pwdn(sensor 电源控制引脚, 低有效)"
    choice from SOC_GPIO_PINS
    default -1

config MD_X1830_GC2375A_GPIO_POWER
    string "gpio power(sensor 电源控制引脚, 高有效)"
    choice from SOC_GPIO_PINS
    default -1

config MD_X1830_GC2375A_GPIO_I2C_SEL
    string "gpio i2c select(sensor i2c 使能脚)"
    choice from SOC_GPIO_PINS
    default -1

config MD_X1830_GC2375A_I2C_BUSNUM
    int "i2c bus num (sensor 挂接的i2c总线号)"
    default -1

config MD_X1830_GC2375A_ISPCLK
    int "isp clk (isp 时钟频率)"
    default 90000000

endmenu # MD_X1830_SENSOR_GC2375A
```

## module_driver/package/devices/isp_camera/x1830/imx307/Config.in
```kconfig
menuconfig MD_X1830_SENSOR_ISP_IMX307
    bool "sensor imx307 (mipi,raw12)"
    depends on MD_SOC_X1830

config MD_X1830_IMX307_GPIO_RESET
    string "gpio reset(sensor 复位脚)"
    choice from SOC_GPIO_PINS
    default -1

config MD_X1830_IMX307_GPIO_PWDN
    string "gpio pwdn(sensor 电源控制引脚, 低有效)"
    choice from SOC_GPIO_PINS
    default -1

config MD_X1830_IMX307_GPIO_POWER
    string "gpio power(sensor 电源控制引脚, 高有效)"
    choice from SOC_GPIO_PINS
    default -1

config MD_X1830_IMX307_GPIO_I2C_SEL
    string "gpio i2c select(sensor i2c 使能脚)"
    choice from SOC_GPIO_PINS
    default -1

config MD_X1830_IMX307_I2C_BUSNUM
    int "i2c bus num (sensor 挂接的i2c总线号)"
    default -1

config MD_X1830_IMX307_ISPCLK
    int "isp clk (isp 时钟频率)"
    default 90000000

endmenu # MD_X1830_SENSOR_IMX307
```

## module_driver/package/devices/isp_camera/x1830/ov9732/Config.in
```kconfig
menuconfig MD_X1830_SENSOR_ISP_OV9732
    bool "sensor ov9732 (dvp,raw10)"
    depends on MD_SOC_X1830

config MD_X1830_OV9732_USE_AGAIN_ONLY
    bool "sensor ov9732 use again only (仅使用again)"

choice "        ov9732 dvp 分辨率选择"
    default MD_X1830_OV9732_1280X720

config MD_X1830_OV9732_640X480
    bool "640*480"

config MD_X1830_OV9732_1280X720
    bool "1280*720"

endchoice

config MD_X1830_OV9732_GPIO_RESET
    string "gpio reset(sensor 复位脚)"
    choice from SOC_GPIO_PINS
    default -1

config MD_X1830_OV9732_GPIO_PWDN
    string "gpio pwdn(sensor 电源控制引脚, 低有效)"
    choice from SOC_GPIO_PINS
    default -1

config MD_X1830_OV9732_GPIO_POWER
    string "gpio power(sensor 电源控制引脚, 高有效)"
    choice from SOC_GPIO_PINS
    default -1

config MD_X1830_OV9732_GPIO_I2C_SEL
    string "gpio i2c select(sensor i2c 使能脚)"
    choice from SOC_GPIO_PINS
    default -1

config MD_X1830_OV9732_I2C_BUSNUM
    int "i2c bus num (sensor 挂接的i2c总线号)"
    default -1

source soc/x1830/camera/dvp_gpio_func.in

config MD_X1830_OV9732_DVP_GPIO_FUNC
    string "dvp_gpio_func(dvp 接口选择使用的位数)"
    choice from SENSOR_DVP_GPIO_FUNC
    default -1

config MD_X1830_OV9732_ISPCLK
    int "isp clk (isp 时钟频率)"
    default 90000000

endmenu # MD_X1830_SENSOR_OV9732
```

## module_driver/package/devices/isp_camera/x1830/s5k6a1/Config.in
```kconfig
menuconfig MD_X1830_SENSOR_ISP_S5K6A1
    bool "sensor s5k6a1 (mipi,raw10)"
    depends on MD_SOC_X1830

config MD_X1830_S5K6A1_GPIO_RESET
    string "gpio reset(sensor 复位脚)"
    choice from SOC_GPIO_PINS
    default -1

config MD_X1830_S5K6A1_GPIO_PWDN
    string "gpio pwdn(sensor 电源控制引脚, 低有效)"
    choice from SOC_GPIO_PINS
    default -1

config MD_X1830_S5K6A1_GPIO_POWER
    string "gpio power(sensor 电源控制引脚, 高有效)"
    choice from SOC_GPIO_PINS
    default -1

config MD_X1830_S5K6A1_GPIO_I2C_SEL
    string "gpio i2c select(sensor i2c 使能脚)"
    choice from SOC_GPIO_PINS
    default -1

config MD_X1830_S5K6A1_I2C_BUSNUM
    int "i2c bus num (sensor 挂接的i2c总线号)"
    default -1

config MD_X1830_S5K6A1_ISPCLK
    int "isp clk (isp 时钟频率)"
    default 90000000

endmenu # MD_X1830_SENSOR_S5K6A1
```

## module_driver/package/devices/keyboard/Config.in
```kconfig
menu "按键设备列表"

source package/devices/keyboard/keyboard_gpio/Config.in
source package/devices/keyboard/keyboard_adc/Config.in

endmenu
```

## module_driver/package/devices/keyboard/keyboard_adc/Config.in
```kconfig
menuconfig MD_KEYBOARD_ADC
    bool "ADC按键驱动"

config MD_ADC_DEVIATION
    int "ADC允许误差范围"
    default 50
    help
        "例如：误差范围为正负50,这里就填50,单位 mv"

config MD_ADC_CHANNEL
    int "ADC输入通道号"
    default 0
    help
        "填写adc按键使用的adc通道，如使用的是adc通道0这里就填0"

config MD_ADC_INIT_VALUE
    int "没有按键按下时的电压值"
    default 1800
    help
        "没有按键按下时获取到的电压值,单位 mv"

config MD_ADC_KEY_DETECTIME
    int "按键检测间隔"
    default 100
    help
        "按键检测的间隔，单位ms"

config MD_ADC_KEY_DEBUG
    int "开启ADC按鍵DEBUG打印"
    default 0
    help
        "是否开启DEBUG打印 0:不打印 1:打印"



config MD_ADC_KEY1
    bool "ADC按键1"
    default n

config MD_ADC_KEY1_CODE
    string "  按键值"
    default -1
    choice from MD_KEYBOARD_GPIO_KEYS
    depends on MD_ADC_KEY1

config MD_ADC_KEY1_VALUE
    int "  按键电压值"
    default 0
    depends on MD_ADC_KEY1


config MD_ADC_KEY2
    bool "ADC按键2"
    default n

config MD_ADC_KEY2_CODE
    string "  按键值"
    default -1
    choice from MD_KEYBOARD_GPIO_KEYS
    depends on MD_ADC_KEY2

config MD_ADC_KEY2_VALUE
    int "  按键电压值"
    default 300
    depends on MD_ADC_KEY2


config MD_ADC_KEY3
    bool "ADC按键3"
    default n

config MD_ADC_KEY3_CODE
    string "  按键值"
    default -1
    choice from MD_KEYBOARD_GPIO_KEYS
    depends on MD_ADC_KEY3

config MD_ADC_KEY3_VALUE
    int "  按键电压值"
    default 600
    depends on MD_ADC_KEY3


config MD_ADC_KEY4
    bool "ADC按键4"
    default n

config MD_ADC_KEY4_CODE
    string "  按键值"
    default -1
    choice from MD_KEYBOARD_GPIO_KEYS
    depends on MD_ADC_KEY4

config MD_ADC_KEY4_VALUE
    int "  按键电压值"
    default 900
    depends on MD_ADC_KEY4


config MD_ADC_KEY5
    bool "ADC按键5"
    default n

config MD_ADC_KEY5_CODE
    string "  按键值"
    default -1
    choice from MD_KEYBOARD_GPIO_KEYS
    depends on MD_ADC_KEY5

config MD_ADC_KEY5_VALUE
    int "  按键电压值"
    default 1200
    depends on MD_ADC_KEY5


config MD_ADC_KEY6
    bool "ADC按键6"
    default n

config MD_ADC_KEY6_CODE
    string "  按键值"
    default -1
    choice from MD_KEYBOARD_GPIO_KEYS
    depends on MD_ADC_KEY6

config MD_ADC_KEY6_VALUE
    int "  按键电压值"
    default 1500
    depends on MD_ADC_KEY6


config MD_ADC_KEY7
    bool "ADC按键7"
    default n

config MD_ADC_KEY7_CODE
    string "  按键值"
    default -1
    choice from MD_KEYBOARD_GPIO_KEYS
    depends on MD_ADC_KEY7

config MD_ADC_KEY7_VALUE
    int "  按键电压值"
    default -1
    depends on MD_ADC_KEY7


config MD_ADC_KEY8
    bool "ADC按键8"
    default n

config MD_ADC_KEY8_CODE
    string "  按键值"
    default -1
    choice from MD_KEYBOARD_GPIO_KEYS
    depends on MD_ADC_KEY8

config MD_ADC_KEY8_VALUE
    int "  按键电压值"
    default -1
    depends on MD_ADC_KEY8

endmenu # MD_KEYBOARD_ADC
```

## module_driver/package/devices/keyboard/keyboard_gpio/Config.in
```kconfig
menuconfig MD_KEYBOARD_GPIO
    bool "gpio 按键 驱动/设备"


source "package/devices/keyboard/keyboard_gpio/keyboard_gpio0.in"
source "package/devices/keyboard/keyboard_gpio/keyboard_gpio1.in"
source "package/devices/keyboard/keyboard_gpio/keyboard_gpio2.in"
source "package/devices/keyboard/keyboard_gpio/keyboard_gpio3.in"
source "package/devices/keyboard/keyboard_gpio/keyboard_gpio4.in"
source "package/devices/keyboard/keyboard_gpio/keyboard_gpio5.in"
source "package/devices/keyboard/keyboard_gpio/keyboard_gpio6.in"
source "package/devices/keyboard/keyboard_gpio/keyboard_gpio7.in"
source "package/devices/keyboard/keyboard_gpio/keyboard_gpio8.in"
source "package/devices/keyboard/keyboard_gpio/keyboard_gpio9.in"
source "package/devices/keyboard/keyboard_gpio/keyboard_gpio10.in"
source "package/devices/keyboard/keyboard_gpio/keyboard_gpio11.in"
source "package/devices/keyboard/keyboard_gpio/keyboard_gpio12.in"
source "package/devices/keyboard/keyboard_gpio/keyboard_gpio13.in"
source "package/devices/keyboard/keyboard_gpio/keyboard_gpio14.in"
source "package/devices/keyboard/keyboard_gpio/keyboard_gpio15.in"

endmenu
```

## module_driver/package/devices/lcd/Config.in
```kconfig
menu "lcd设备列表"

source package/devices/lcd/x1830/lcd_kwh035/Config.in
source package/devices/lcd/x1830/lcd_st7701/Config.in
source package/devices/lcd/x1830/lcd_st7701_9bit_spi/Config.in
source package/devices/lcd/x1000/lcd_truly240240/Config.in
source package/devices/lcd/x1021/lcd_kwh035/Config.in
source package/devices/lcd/x2000/lcd_kwh035/Config.in
source package/devices/lcd/x2000/lcd_kd070d57/Config.in
source package/devices/lcd/x2000/lcd_fw050/Config.in
source package/devices/lcd/x2000/lcd_ma0060/Config.in
source package/devices/lcd/x2000/lcd_m1700/Config.in
source package/devices/lcd/x2000/lcd_st7789/Config.in
source package/devices/lcd/x2000/lcd_st7701s/Config.in
source package/devices/lcd/x2000/lcd_jd9851/Config.in
source package/devices/lcd/x2000/lcd_s6d04d1/Config.in
source package/devices/lcd/x2000/lcd_cc0702/Config.in
source package/devices/lcd/x2000/lcd_gc9106/Config.in
source package/devices/lcd/spi/lcd_gc9106/Config.in
source package/devices/lcd/x2000/lcd_jd9366/Config.in
source package/devices/lcd/x2000/lcd_gl0700/Config.in
source package/devices/lcd/x2000/lcd_ili9881d/Config.in
source package/devices/lcd/x2000/lcd_otm8018b/Config.in
source package/devices/lcd/x2000/lcd_st7785m/Config.in

source package/devices/lcd/x1600/lcd_st7701/Config.in
source package/devices/lcd/x1600/lcd_kwh035/Config.in



endmenu
```

## module_driver/package/devices/lcd/spi/lcd_gc9106/Config.in
```kconfig
menuconfig MD_X2000_LCD_GC9106
    bool "TFT GC9106 (128x160)"
    select MD_SPI_FB

config MD_X2000_GC9106_RST
    string "gpio reset(lcd 复位引脚)"
    choice from SOC_GPIO_PINS
    default -1

config MD_X2000_GC9106_POWER_EN
    string "gpio power enable(lcd power使能引脚)"
    choice from SOC_GPIO_PINS
    default -1

config MD_X2000_GC9106_SPI_BUS_NUM
    int "spi bus num(挂接的spi总线号)"
    default -1

config MD_X2000_GC9106_SPI_CS
    string "spi cs pin(片选脚)"
    choice from SOC_GPIO_PINS
    default -1

config MD_X2000_GC9106_SPI_RS
    string "spi rs pin(数据/命令脚)"
    choice from SOC_GPIO_PINS
    default -1

endmenu # MD_X2000_LCD_GC9106
```

## module_driver/package/devices/lcd/x1000/lcd_truly240240/Config.in
```kconfig
menuconfig MD_X1000_SLCD_TRULY240240
    bool "truly240240 (X1000)"
    select MD_X1000_FB
    depends on MD_SOC_X1000

config MD_X1000_TRULY240240_TE
    string "gpio tearing effect(lcd 图像防裂屏引脚)"
    choice from SOC_GPIO_PINS
    default -1

config MD_X1000_TRULY240240_CS
    string "gpio chip select(lcd 片选引脚)"
    choice from SOC_GPIO_PINS
    default -1

config MD_X1000_TRULY240240_RD
    string "gpio lcd read signal(lcd 读引脚)"
    choice from SOC_GPIO_PINS
    default -1

config MD_X1000_TRULY240240_RST
    string "gpio reset(lcd 复位引脚)"
    choice from SOC_GPIO_PINS
    default -1



endmenu
```

## module_driver/package/devices/lcd/x1021/lcd_kwh035/Config.in
```kconfig
menuconfig MD_X1021_SLCD_KWH035
    bool "SLCD KWH035 (320x480) (X1021)"
    select MD_X1021_FB
    depends on MD_SOC_X1021

config MD_X1021_KWH035_TE
    string "gpio tearing effect(lcd 图像防裂屏引脚)"
    choice from SOC_GPIO_PINS
    default -1


config MD_X1021_KWH035_CS
    string "gpio chip select(lcd 片选引脚)"
    choice from SOC_GPIO_PINS
    default -1

config MD_X1021_KWH035_RD
    string "gpio lcd read signal(lcd 读引脚)"
    choice from SOC_GPIO_PINS
    default -1

config MD_X1021_KWH035_RST
    string "gpio reset(lcd 复位引脚)"
    choice from SOC_GPIO_PINS
    default -1

config MD_X1021_KWH035_POWER_EN
    string "gpio power enable(lcd power使能引脚)"
    choice from SOC_GPIO_PINS
    default -1

endmenu # MD_X1021_LCD_KWH035
```
