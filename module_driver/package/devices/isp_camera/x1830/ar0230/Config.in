## module_driver/package/devices/lcd/x1600/lcd_kwh035/Config.in
```kconfig
menuconfig MD_X1600_LCD_KWH035
    bool "SLCD KWH035 (320x480) (X1600)"
    select MD_X1600_FB
    depends on MD_SOC_X1600_BASE

config MD_X1600_LCD_REGULATOR_NAME
    string "regulator name(通过名字获取 lcd module 电源管理器)"
    default "GPIO-POWER0"

config MD_X1600_KWH035_CS
    string "gpio chip select(lcd 片选引脚)"
    choice from SOC_GPIO_PINS
    default -1

config MD_X1600_KWH035_RD
    string "gpio lcd read signal(lcd 读引脚)"
    choice from SOC_GPIO_PINS
    default -1

config MD_X1600_KWH035_RST
    string "gpio reset(lcd 复位引脚)"
    choice from SOC_GPIO_PINS
    default -1

config MD_X1600_KWH035_POWER_EN
    string "gpio power enable(lcd power使能引脚)"
    choice from SOC_GPIO_PINS
    default -1

endmenu # MD_X1600_LCD_KWH035
```

## module_driver/package/devices/lcd/x1600/lcd_st7701/Config.in
```kconfig
menuconfig MD_X1600_LCD_ST7701
    bool "TFT ST7701 (480x800) (X1600)"
    select MD_X1600_FB
    depends on MD_SOC_X1600_BASE

config MD_X1600_ST7701_RST
    string "gpio reset(lcd 复位引脚)"
    choice from SOC_GPIO_PINS
    default -1

config MD_X1600_ST7701_POWER_EN
    string "gpio power enable(lcd power使能引脚)"
    choice from SOC_GPIO_PINS
    default -1

config MD_X1600_ST7701_SPI_BUS_NUM
    int "spi bus num(挂接的spi总线号)"
    default -1

config MD_X1600_ST7701_SPI_CS
    string "spi cs pin(片选脚)"
    choice from SOC_GPIO_PINS
    default -1

endmenu # MD_X1600_LCD_ST7701
```

## module_driver/package/devices/lcd/x1830/lcd_kwh035/Config.in
```kconfig
menuconfig MD_X1830_LCD_KWH035
    bool "SLCD KWH035 (320x480) (X1830)"
    select MD_X1830_FB
    depends on MD_SOC_X1830

config MD_X1830_KWH035_CS
    string "gpio chip select(lcd 片选引脚)"
    choice from SOC_GPIO_PINS
    default -1

config MD_X1830_KWH035_RD
    string "gpio lcd read signal(lcd 读引脚)"
    choice from SOC_GPIO_PINS
    default -1

config MD_X1830_KWH035_RST
    string "gpio reset(lcd 复位引脚)"
    choice from SOC_GPIO_PINS
    default -1

config MD_X1830_KWH035_POWER_EN
    string "gpio power enable(lcd power使能引脚)"
    choice from SOC_GPIO_PINS
    default -1

endmenu # MD_X1830_LCD_KWH035
```

## module_driver/package/devices/lcd/x1830/lcd_st7701/Config.in
```kconfig
menuconfig MD_X1830_LCD_ST7701
    bool "TFT ST7701 (480x854) (X1830)"
    select MD_X1830_FB
    depends on MD_SOC_X1830

config MD_X1830_ST7701_RST
    string "gpio reset(lcd 复位引脚)"
    choice from SOC_GPIO_PINS
    default -1

config MD_X1830_ST7701_POWER_EN
    string "gpio power enable(lcd power使能引脚)"
    choice from SOC_GPIO_PINS
    default -1

config MD_X1830_ST7701_SPI_BUS_NUM
    int "spi bus num(挂接的spi总线号)"
    default -1

config MD_X1830_ST7701_SPI_CS
    string "spi cs pin(片选脚)"
    choice from SOC_GPIO_PINS
    default -1

endmenu # MD_X1830_LCD_ST7701
```

## module_driver/package/devices/lcd/x1830/lcd_st7701_9bit_spi/Config.in
```kconfig
menuconfig MD_X1830_LCD_ST7701_9BIT_SPI
    bool "TFT ST7701 9BIT_SPI (480x800) (X1830)"
    select MD_X1830_FB
    depends on MD_SOC_X1830

config MD_X1830_ST7701_9BIT_SPI_RST
    string "gpio reset(lcd 复位引脚)"
    choice from SOC_GPIO_PINS
    default -1

config MD_X1830_ST7701_9BIT_SPI_POWER_EN
    string "gpio power enable(lcd power使能引脚)"
    choice from SOC_GPIO_PINS
    default -1

config MD_X1830_ST7701_9BIT_SPI_SCL
    string "spi clk(时钟引脚)"
    choice from SOC_GPIO_PINS
    default -1

config MD_X1830_ST7701_9BIT_SPI_SDA
    string "spi sda(mosi 输出引脚)"
    choice from SOC_GPIO_PINS
    default -1

config MD_X1830_ST7701_9BIT_SPI_CS
    string "spi cs(片选脚)"
    choice from SOC_GPIO_PINS
    default -1

endmenu # MD_X1830_LCD_ST7701_9BIT_SPI
```

## module_driver/package/devices/lcd/x2000/lcd_cc0702/Config.in
```kconfig
menuconfig MD_X2000_LCD_CC0702
    bool "TFT CC0702 (600x1024) (X2000) (mipi接口)"
    select MD_X2000_FB
    depends on MD_SOC_X2000_BASE

config MD_X2000_CC0702_BACKLIGHT_EN
    string "gpio backlight enable(lcd backlight使能引脚)"
    choice from SOC_GPIO_PINS
    default -1

config MD_X2000_CC0702_RST
    string "gpio reset(lcd 复位引脚)"
    choice from SOC_GPIO_PINS
    default -1

config MD_X2000_CC0702_POWER_EN
    string "gpio power(lcd power使能引脚)"
    choice from SOC_GPIO_PINS
    default -1


endmenu # MD_X2000_LCD_CC0702
```

## module_driver/package/devices/lcd/x2000/lcd_fw050/Config.in
```kconfig
menuconfig MD_X2000_LCD_FW050
    bool "TFT FW050 (720x1280) (X2000) (mipi接口)"
    select MD_X2000_FB
    depends on MD_SOC_X2000_BASE

config MD_X2000_FW050_BACKLIGHT_EN
    string "gpio backlight enable(lcd backlight使能引脚)"
    choice from SOC_GPIO_PINS
    default -1

config MD_X2000_FW050_RST
    string "gpio reset(lcd 复位引脚)"
    choice from SOC_GPIO_PINS
    default -1

config MD_X2000_FW050_POWER_EN
    string "gpio power(lcd power使能引脚)"
    choice from SOC_GPIO_PINS
    default -1

config MD_X2000_FW050_REGULATOR_NAME
    string "regulator name(通过名字获取 lcd module 电源管理器)"
    default -1


endmenu # MD_X2000_LCD_FW050
```

## module_driver/package/devices/lcd/x2000/lcd_gc9106/Config.in
```kconfig
menuconfig MD_X2000_LCD_SPI_GC9106
    bool "LCD SPI GC9106 (128*160) (x2000) (MCU-16/24bit串行模式)"
    select MD_X2000_FB
    depends on MD_SOC_X2000_BASE

config MD_X2000_LCD_SPI_GC9106_RST
    string "RST pin(复位)"
    choice from SOC_GPIO_PINS
    default -1

config MD_X2000_LCD_SPI_GC9106_POWER_EN
    string "POWER_EN pin(电源)"
    choice from SOC_GPIO_PINS
    default -1

config MD_X2000_LCD_SPI_GC9106_CE
    string "CE pin(片选)"
    choice from SOC_GPIO_PINS
    default -1

endmenu # MD_X2000_LCD_SPI_GC9106
```

## module_driver/package/devices/lcd/x2000/lcd_gl0700/Config.in
```kconfig
menuconfig MD_X2000_LCD_GL0700
    bool "TFT GL0700 (800x480) (X2000)"
    select MD_X2000_FB
    depends on MD_SOC_X2000_BASE

config MD_X2000_GL0700_POWER_EN
    string "gpio power enable(lcd power使能引脚)"
    choice from SOC_GPIO_PINS
    default -1

endmenu # MD_X2000_LCD_GL0700
```

## module_driver/package/devices/lcd/x2000/lcd_jd9366/Config.in
```kconfig
menuconfig MD_X2000_LCD_JD9366
    bool "TFT JD9366 (800*1280) (X2000) (mipi接口)"
    select MD_X2000_FB
    depends on MD_SOC_X2000_BASE

config MD_X2000_JD9366_BACKLIGHT_EN
    string "gpio backlight enable(lcd backlight使能引脚)"
    choice from SOC_GPIO_PINS
    default -1

config MD_X2000_JD9366_RST
    string "gpio reset(lcd 复位引脚)"
    choice from SOC_GPIO_PINS
    default -1

config MD_X2000_JD9366_POWER_EN
    string "gpio power(lcd power使能引脚)"
    choice from SOC_GPIO_PINS
    default -1


endmenu # MD_X2000_LCD_JD9366
```

## module_driver/package/devices/lcd/x2000/lcd_jd9851/Config.in
```kconfig
menuconfig MD_X2000_LCD_JD9851
    bool "SLCD JD9851 (240x320) (X2000)"
    select MD_X2000_FB
    depends on MD_SOC_X2000_BASE

config MD_X2000_LCD_REGULATOR_NAME
    string "regulator name(通过名字获取 lcd module 电源管理器)"
    default -1

config MD_X2000_JD9851_CS
    string "gpio chip select(lcd 片选引脚)"
    choice from SOC_GPIO_PINS
    default -1

config MD_X2000_JD9851_RD
    string "gpio lcd read signal(lcd 读引脚)"
    choice from SOC_GPIO_PINS
    default -1

config MD_X2000_JD9851_RST
    string "gpio reset(lcd 复位引脚)"
    choice from SOC_GPIO_PINS
    default -1

config MD_X2000_JD9851_POWER_EN
    string "gpio power enable(lcd power使能引脚)"
    choice from SOC_GPIO_PINS
    default -1

endmenu # MD_X2000_LCD_JD9851
```
