## module_driver/package/devices/alsa-sound-card/x1600_dummy_sound_card/Config.in
```kconfig
config  MD_X1600_DUMMY_SOUND_CARD
    bool "使用 X1600 创建一个虚拟外部声卡(用户没有外部声卡驱动时可以用虚拟声卡输出i2s信号)"
```

## module_driver/package/devices/alsa-sound-card/x1830_ecodec_sound_card/Config.in
```kconfig
menu "使用x1830 ecode(外部codec)创建一个声卡"

source package/devices/alsa-sound-card/x1830_ecodec_sound_card/es8388/Config.in

endmenu
```

## module_driver/package/devices/alsa-sound-card/x2000_510_ecodec_sound_card/Config.in
```kconfig
menu "使用x2000_510 ecode(外部codec)创建一个声卡"

source package/devices/alsa-sound-card/x2000_510_ecodec_sound_card/ak4493/Config.in

endmenu
```

## module_driver/package/devices/alsa-sound-card/x2000_510_ecodec_sound_card/ak4493/Config.in
```kconfig
config MD_X2000_510_AK4493_SOUND_CARD
    bool "使用 x2000_510 ak4493(外部codec) 创建一个声卡"
```

## module_driver/package/devices/alsa-sound-card/x2000_510_icodec_sound_card/Config.in
```kconfig
config MD_X2000_510_ICODEC_SOUND_CARD
    bool "使用 x2000_510 icodec(内部codec) 创建一个声卡"
```

## module_driver/package/devices/alsa-sound-card/x2000_510_spdif_sound_card/Config.in
```kconfig
menu "使用x2000_510 spdif创建一个声卡"

source package/devices/alsa-sound-card/x2000_510_spdif_sound_card/spdif/Config.in

endmenu
```

## module_driver/package/devices/alsa-sound-card/x2000_ecodec_sound_card/Config.in
```kconfig
menu "使用x2000 ecode(外部codec)创建一个声卡"

source package/devices/alsa-sound-card/x2000_ecodec_sound_card/ak4493/Config.in

endmenu
```

## module_driver/package/devices/alsa-sound-card/x2000_spdif_sound_card/Config.in
```kconfig
menu "使用x2000 spdif创建一个声卡"

source package/devices/alsa-sound-card/x2000_spdif_sound_card/spdif/Config.in

endmenu
```

## module_driver/package/devices/backlight/Config.in
```kconfig
menu "背光设备列表"

source "package/devices/backlight/pwm_backlight/pwm_backlight.in"

source "package/devices/backlight/gpio_backlight/gpio_backlight.in"

endmenu
```

## module_driver/package/devices/camera/Config.in
```kconfig
menu "camera设备列表"

# x2000 cameras
source package/devices/camera/x2000/sc031_mipi/Config.in
source package/devices/camera/x2000/sc031_dvp/Config.in
source package/devices/camera/x2000/sc035_mipi/Config.in
source package/devices/camera/x2000/sc1345_mipi/Config.in
source package/devices/camera/x2000/sc2310_mipi/Config.in
source package/devices/camera/x2000/sc2310_dvp/Config.in
source package/devices/camera/x2000/sc2355_mipi/Config.in
source package/devices/camera/x2000/sc301_mipi/Config.in
source package/devices/camera/x2000/sc4238_mipi/Config.in
source package/devices/camera/x2000/ov2735_mipi/Config.in
source package/devices/camera/x2000/ov5693_mipi/Config.in
source package/devices/camera/x2000/ov7251_mipi/Config.in
source package/devices/camera/x2000/ov9281_mipi/Config.in
source package/devices/camera/x2000/ov9282_dvp/Config.in
source package/devices/camera/x2000/ov9732_mipi/Config.in
source package/devices/camera/x2000/ov9732_dvp/Config.in
source package/devices/camera/x2000/os05a20_mipi/Config.in
source package/devices/camera/x2000/gc0308_dvp/Config.in
source package/devices/camera/x2000/gc0329/Config.in
source package/devices/camera/x2000/gc1054_dvp/Config.in
source package/devices/camera/x2000/gc2053_mipi/Config.in
source package/devices/camera/x2000/gc2053_dvp/Config.in
source package/devices/camera/x2000/gc2145_dvp/Config.in
source package/devices/camera/x2000/gc2375_mipi/Config.in
source package/devices/camera/x2000/gc5035_mipi/Config.in
source package/devices/camera/x2000/jxf37_mipi/Config.in
source package/devices/camera/x2000/jxh62_mipi/Config.in
source package/devices/camera/x2000/imx335_mipi/Config.in
source package/devices/camera/x2000/pag7930_mipi/Config.in
source package/devices/camera/x2000/ar0230/Config.in
source package/devices/camera/x2000/jz0378_dvp/Config.in
source package/devices/camera/x2000/gvm8666b_mipi/Config.in

# x1830 cameras
source package/devices/camera/x1830/ov2735/Config.in


# x1520 cameras
source package/devices/camera/x1520/ov9732/Config.in


# x1000 cameras
source package/devices/camera/x1000/gc0308/Config.in
source package/devices/camera/x1000/gc2155/Config.in
source package/devices/camera/x1000/gc0328/Config.in

# x1021 cameras
source package/devices/camera/x1021/gc0308/Config.in
source package/devices/camera/x1021/gc0328/Config.in
source package/devices/camera/x1021/ov9732/Config.in

# x1600 cameras
source package/devices/camera/x1600/sc031_mipi/Config.in
source package/devices/camera/x1600/sc031_dvp/Config.in
source package/devices/camera/x1600/sc1345_mipi/Config.in
source package/devices/camera/x1600/gc0329_dvp/Config.in
source package/devices/camera/x1600/gc0308_dvp/Config.in

endmenu
```

## module_driver/package/devices/camera/x1000/gc0308/Config.in
```kconfig
menuconfig MD_X1000_SENSOR_GC0308
    bool "sensor gc0308 (dvp,yuyv)"
    select MD_X1000_CAMERA
    depends on MD_SOC_X1000

config MD_X1000_GC0308_GPIO_RESET
    string "gpio reset(sensor 复位脚)"
    choice from SOC_GPIO_PINS
    default -1

config MD_X1000_GC0308_GPIO_PWDN
    string "gpio pwdn(sensor 电源控制引脚)"
    choice from SOC_GPIO_PINS
    default -1

config MD_X1000_GC0308_GPIO_POWER_EN
    string "gpio power_en(sensor 模块电源控制引脚)"
    choice from SOC_GPIO_PINS
    default -1

config MD_X1000_GC0308_I2C_BUSNUM
    int "i2c bus num (sensor 挂接的i2c总线号)"
    default -1

choice "    选择格式"
    default MD_X1000_SENSOR_GC0308_FMT_YUYV

config MD_X1000_SENSOR_GC0308_FMT_YUYV
    bool "fmt yuyv"

config MD_X1000_SENSOR_GC0308_FMT_Y8
    bool "fmt y8"

endchoice

endmenu # MD_X1000_SENSOR_GC0308
```

## module_driver/package/devices/camera/x1000/gc0328/Config.in
```kconfig
menuconfig MD_X1000_SENSOR_GC0328
    bool "sensor gc0328 (dvp,yuyv)"
    select MD_X1000_CAMERA
    depends on MD_SOC_X1000

config MD_X1000_GC0328_GPIO_RESET
    string "gpio reset(sensor 复位脚)"
    choice from SOC_GPIO_PINS
    default -1

config MD_X1000_GC0328_GPIO_PWDN
    string "gpio pwdn(sensor 电源控制引脚)"
    choice from SOC_GPIO_PINS
    default -1

config MD_X1000_GC0328_GPIO_POWER_EN
    string "gpio power_en(sensor 模块电源控制引脚)"
    choice from SOC_GPIO_PINS
    default -1

config MD_X1000_GC0328_I2C_BUSNUM
    int "i2c bus num (sensor 挂接的i2c总线号)"
    default -1

endmenu # MD_X1000_SENSOR_GC0328
```

## module_driver/package/devices/camera/x1021/ov9732/Config.in
```kconfig
menuconfig MD_X1021_SENSOR_OV9732
    bool "sensor ov9732 (dvp,raw10)"
    select MD_X1021_CAMERA
    depends on MD_SOC_X1021

config MD_X1021_OV9732_GPIO_RESET
    string "gpio reset(sensor 复位脚)"
    choice from SOC_GPIO_PINS
    default -1

config MD_X1021_OV9732_GPIO_POWER
    string "gpio power(sensor 模块电源控制引脚)"
    choice from SOC_GPIO_PINS
    default -1

config MD_X1021_OV9732_I2C_BUSNUM
    int "i2c bus num (sensor 挂接的i2c总线号)"
    default -1

config MD_X1021_OV9732_I2C_ADDR
    int "i2c slave address (sensor 的i2c地址)"
    default 0x36
    choice from X1021_OV9732_I2C_ADDRS

array X1021_OV9732_I2C_ADDRS
    int "ov9732 的i2c地址列表"
    item "0x10" 0x10
    item "0x36" 0x36

endmenu # MD_X1021_SENSOR_OV9732
```

## module_driver/package/devices/camera/x1520/ov9732/Config.in
```kconfig
menuconfig MD_X1520_SENSOR_OV9732
    bool "sensor ov9732 (dvp,raw10)"
    select MD_X1520_CAMERA
    depends on MD_SOC_X1520

config MD_X1520_OV9732_GPIO_RESET
    string "gpio reset(sensor 复位脚)"
    choice from SOC_GPIO_PINS
    default -1

config MD_X1520_OV9732_GPIO_PWDN
    string "gpio pwdn(sensor 电源控制引脚, 低有效)"
    choice from SOC_GPIO_PINS
    default -1

config MD_X1520_OV9732_I2C_BUSNUM
    int "i2c bus num (sensor 挂接的i2c总线号)"
    default -1

config MD_X1520_OV9732_I2C_ADDR
    int "i2c slave address (sensor 的i2c地址)"
    default 0x36
    choice from X1520_OV9732_I2C_ADDRS

array X1520_OV9732_I2C_ADDRS
    int "ov9732 的i2c地址列表"
    item "0x10" 0x10
    item "0x36" 0x36

endmenu # MD_X1520_SENSOR_OV9732
```

## module_driver/package/devices/camera/x1600/gc0308_dvp/Config.in
```kconfig
menuconfig MD_X1600_SENSOR_GC0308_DVP
    bool "sensor gc0308 (dvp,yuv422)"
    select MD_X1600_CAMERA

config MD_X1600_GC0308_DVP_GPIO_RESET
    string "gpio reset(sensor 复位脚)"
    choice from SOC_GPIO_PINS
    default -1

config MD_X1600_GC0308_DVP_GPIO_PWDN
    string "gpio pwdn(sensor 电源控制引脚, 低有效)"
    choice from SOC_GPIO_PINS
    default -1

config MD_X1600_GC0308_DVP_GPIO_POWER
    string "gpio power(sensor 电源控制引脚, 高有效)"
    choice from SOC_GPIO_PINS
    default -1

config MD_X1600_GC0308_DVP_I2C_BUSNUM
    int "i2c bus num (sensor 挂接的i2c总线号)"
    default -1

endmenu # MD_X1600_SENSOR_GC0308_DVP
```

## module_driver/package/devices/camera/x1600/gc0329_dvp/Config.in
```kconfig
menuconfig MD_X1600_SENSOR_GC0329_DVP
    bool "sensor gc0329 (dvp,yuv422)"
    select MD_X1600_CAMERA

config MD_X1600_GC0329_DVP_GPIO_RESET
    string "gpio reset(sensor 复位脚)"
    choice from SOC_GPIO_PINS
    default -1

config MD_X1600_GC0329_DVP_GPIO_PWDN
    string "gpio pwdn(sensor 电源控制引脚, 低有效)"
    choice from SOC_GPIO_PINS
    default -1

config MD_X1600_GC0329_DVP_GPIO_POWER
    string "gpio power(sensor 电源控制引脚, 高有效)"
    choice from SOC_GPIO_PINS
    default -1

config MD_X1600_GC0329_DVP_I2C_BUSNUM
    int "i2c bus num (sensor 挂接的i2c总线号)"
    default -1

array SENSOR_RESOLUTION
    string "sensor resolution"
    item "640*480 25fps" GC0329_640_480_25FPS
    item "320*240 60fps" GC0329_320_240_60FPS
    item "320*320 93fps" GC0329_320_320_93FPS_GRAY

config MD_X1600_GC0329_DVP_RESOLUTION
    string "resolution(gc0329分辨率配置)"
    choice from SENSOR_RESOLUTION
    default -1

endmenu # MD_X1600_SENSOR_GC0329_DVP
```

## module_driver/package/devices/camera/x1600/sc031_mipi/Config.in
```kconfig
menuconfig MD_X1600_SENSOR_SC031_MIPI
    bool "sensor sc031 (mipi,raw10)"
    select MD_X1600_CAMERA
    depends on MD_SOC_X1600_BASE

config MD_X1600_SC031_MIPI_GPIO_RESET
    string "gpio reset(sensor 复位脚)"
    choice from SOC_GPIO_PINS
    default -1

config MD_X1600_SC031_MIPI_GPIO_PWDN
    string "gpio pwdn(sensor 电源控制引脚, 低有效)"
    choice from SOC_GPIO_PINS
    default -1

config MD_X1600_SC031_MIPI_GPIO_POWER
    string "gpio power(sensor 电源控制引脚, 高有效)"
    choice from SOC_GPIO_PINS
    default -1

config MD_X1600_SC031_MIPI_I2C_BUSNUM
    int "i2c bus num (sensor 挂接的i2c总线号)"
    default -1

endmenu
```

## module_driver/package/devices/camera/x1830/ov2735/Config.in
```kconfig
menuconfig MD_X1830_SENSOR_OV2735
    bool "sensor ov2735 (dvp,raw10)"
    select MD_X1830_CAMERA
    depends on MD_SOC_X1830

config MD_X1830_OV2735_GPIO_RESET
    string "gpio reset(sensor 复位脚)"
    choice from SOC_GPIO_PINS
    default -1

config MD_X1830_OV2735_GPIO_PWDN
    string "gpio pwdn(sensor 电源控制引脚, 低有效)"
    choice from SOC_GPIO_PINS
    default -1

config MD_X1830_OV2735_GPIO_POWER
    string "gpio power(sensor 电源控制引脚, 高有效)"
    choice from SOC_GPIO_PINS
    default -1

config MD_X1830_OV2735_GPIO_I2C_SEL
    string "gpio i2c select(sensor i2c 使能脚)"
    choice from SOC_GPIO_PINS
    default -1

config MD_X1830_OV2735_I2C_BUSNUM
    int "i2c bus num (sensor 挂接的i2c总线号)"
    default -1

endmenu # MD_X1830_SENSOR_OV2735
```

## module_driver/package/devices/camera/x2000/ar0230/Config.in
```kconfig
menuconfig MD_X2000_SENSOR_AR0230
    bool "sensor ar0230 (dvp,raw10)"
    select MD_X2000_CAMERA_VIC
    depends on MD_SOC_X2000_BASE

source package/soc/x2000/camera/dvp_gpio_func.in

config MD_X2000_AR0230_GPIO_RESET
    string "gpio reset(sensor 复位脚)"
    choice from SOC_GPIO_PINS
    default -1

config MD_X2000_AR0230_GPIO_PWDN
    string "gpio pwdn(sensor 电源控制引脚, 低有效)"
    choice from SOC_GPIO_PINS
    default -1

config MD_X2000_AR0230_GPIO_POWER
    string "gpio power(sensor 电源控制引脚, 高有效)"
    choice from SOC_GPIO_PINS
    default -1

config MD_X2000_AR0230_I2C_BUSNUM
    int "i2c bus num (sensor 挂接的i2c总线号)"
    default -1

config MD_X2000_AR0230_DVP_DATE_FMT
    string "dvp_gpio_func(dvp 接口选择使用的位数)"
    choice from SENSOR_DVP_GPIO_FUNC
    default -1

endmenu # MD_X2000_SENSOR_AR0230
```
