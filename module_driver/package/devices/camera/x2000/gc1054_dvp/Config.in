## module_driver/package/devices/camera/x2000/gc1054_dvp/Config.in
```kconfig
menuconfig MD_X2000_SENSOR_GC1054_DVP
	bool "sensor gc1054 (dvp,raw10)"
	select MD_X2000_CAMERA_VIC
	depends on MD_SOC_X2000_BASE

source package/soc/x2000/camera/interface_type.in
source package/soc/x2000/camera/dvp_gpio_func.in

config MD_X2000_SENSOR_GC1054_DVP_NAME
	string "sensor module name"
	default "gc1054"

config MD_X2000_SENSOR_GC1054_DVP_CAM_BUSNUM
	int "cam bus num (sensor 挂接的vic/cim总线号)"
	choice from CAMERA_INTERFACE_TYPE_SELECT
	default -1

config MD_X2000_SENSOR_GC1054_DVP_GPIO_POWER
	string "gpio power(sensor 电源控制引脚, 高有效)"
	choice from SOC_GPIO_PINS
	default -1

config MD_X2000_SENSOR_GC1054_DVP_REGULATOR_NAME
	string "regulator name(通过名字获取 sensor module 电源管理器)"
	default "GPIO-POWER0"

config MD_X2000_SENSOR_GC1054_DVP_GPIO_PWDN
	string "gpio pwdn(sensor 电源控制引脚, 低有效)"
	choice from SOC_GPIO_PINS
	default -1

config MD_X2000_SENSOR_GC1054_DVP_GPIO_RESET
	string "gpio reset(sensor 复位脚)"
	choice from SOC_GPIO_PINS
	default -1

config MD_X2000_SENSOR_GC1054_DVP_I2C_BUSNUM
	int "i2c bus num (sensor 挂接的i2c总线号)"
	default -1

config MD_X2000_SENSOR_GC1054_DVP_I2C_ADDR
	int "i2c device addr (sensor的i2c地址)"
	default -1

config MD_X2000_SENSOR_GC1054_DVP_DVP_GPIO_FUNC
    string "dvp gpio func(soc控制器dvp的接口设置)"
    choice from SENSOR_DVP_GPIO_FUNC
    default -1

endmenu
```

## module_driver/package/devices/camera/x2000/gc2375_mipi/Config.in
```kconfig
menuconfig MD_X2000_SENSOR_GC2375_MIPI
    bool "sensor gc2375 (mipi,raw10)"
    select MD_X2000_CAMERA_VIC
    depends on MD_SOC_X2000_BASE

config MD_X2000_GC2375_GPIO_RESET
    string "gpio reset(sensor 复位脚)"
    choice from SOC_GPIO_PINS
    default -1

config MD_X2000_GC2375_GPIO_PWDN
    string "gpio pwdn(sensor 电源控制引脚, 低有效)"
    choice from SOC_GPIO_PINS
    default -1

config MD_X2000_GC2375_GPIO_POWER
    string "gpio power(sensor 电源控制引脚, 高有效)"
    choice from SOC_GPIO_PINS
    default -1

config MD_X2000_GC2375_I2C_BUSNUM
    int "i2c bus num (sensor 挂接的i2c总线号)"
    default -1

endmenu # MD_X2000_SENSOR_GC2375_MIPI
```

## module_driver/package/devices/camera/x2000/gc5035_mipi/Config.in
```kconfig
menuconfig MD_X2000_SENSOR_GC5035_MIPI
    bool "sensor gc5035 (mipi,raw10)"
    select MD_X2000_CAMERA_VIC
    depends on MD_SOC_X2000_BASE

config MD_X2000_GC5035_GPIO_RESET
    string "gpio reset(sensor 复位脚)"
    choice from SOC_GPIO_PINS
    default -1

config MD_X2000_GC5035_GPIO_PWDN
    string "gpio pwdn(sensor 电源控制引脚, 低有效)"
    choice from SOC_GPIO_PINS
    default -1

config MD_X2000_GC5035_GPIO_POWER
    string "gpio power(sensor 电源控制引脚, 高有效)"
    choice from SOC_GPIO_PINS
    default -1

config MD_X2000_GC5035_I2C_BUSNUM
    int "i2c bus num (sensor 挂接的i2c总线号)"
    default -1

endmenu # MD_X2000_SENSOR_GC5035_MIPI
```

## module_driver/package/devices/camera/x2000/gvm8666b_mipi/Config.in
```kconfig
menuconfig MD_X2000_SENSOR_GVM8666B_MIPI
    bool "sensor gvm8666b (mipi,raw12)"
    select MD_X2000_CAMERA_VIC
    depends on MD_SOC_X2000_BASE

config MD_X2000_GVM8666B_GPIO_RESET
    string "gpio reset(sensor 复位脚)"
    choice from SOC_GPIO_PINS
    default -1

config MD_X2000_GVM8666B_GPIO_PWDN
    string "gpio pwdn(sensor 电源控制引脚, 低有效)"
    choice from SOC_GPIO_PINS
    default -1

config MD_X2000_GVM8666B_GPIO_POWER
    string "gpio power(sensor 电源控制引脚, 高有效)"
    choice from SOC_GPIO_PINS
    default -1

config MD_X2000_GVM8666B_I2C_BUSNUM
    int "i2c bus num (sensor 挂接的i2c总线号)"
    default -1

endmenu # MD_X2000_SENSOR_GVM8666B_MIPI
```

## module_driver/package/devices/camera/x2000/imx335_mipi/Config.in
```kconfig
menuconfig MD_X2000_SENSOR_IMX335_MIPI
    bool "sensor imx335 (mipi,raw10)"
    select MD_X2000_CAMERA_VIC
    depends on MD_SOC_X2000_BASE

config MD_X2000_IMX335_SENSOR_NAME
    string "sensor module name"
    default "imx335-vis"

config MD_X2000_IMX335_GPIO_RESET
    string "gpio reset(sensor 复位脚)"
    choice from SOC_GPIO_PINS
    default -1

config MD_X2000_IMX335_GPIO_PWDN
    string "gpio pwdn(sensor 电源控制引脚, 低有效)"
    choice from SOC_GPIO_PINS
    default -1

config MD_X2000_IMX335_GPIO_POWER
    string "gpio power(sensor 电源控制引脚, 高有效)"
    choice from SOC_GPIO_PINS
    default -1

config MD_X2000_IMX335_SENSOR_REGULATOR_NAME
	string "regulator name(通过名字获取 sensor module 电源管理器)"
	default "GPIO-POWER0"

config MD_X2000_IMX335_I2C_BUSNUM
    int "i2c bus num (sensor 挂接的i2c总线号)"
    default -1

config MD_X2000_IMX335_I2C_ADDR
	int "i2c device addr (sensor的i2c地址)"
	default -1

config MD_X2000_IMX335_CAM_BUSNUM
	int "cam bus num (sensor 挂接的vic/cim总线号)"
	default -1

endmenu
```

## module_driver/package/devices/camera/x2000/jz0378_dvp/Config.in
```kconfig
menuconfig MD_X2000_SENSOR_JZ0378_DVP
    bool "sensor jz0378_dvp (dvp,grey)"
    select MD_X2000_CAMERA_VIC
    depends on MD_SOC_X2000_BASE

source package/soc/x2000/camera/interface_type.in
source package/soc/x2000/camera/dvp_gpio_func.in

config MD_X2000_JZ0378_DVP_CAMERA_INDEX
    string "选择控制器(sensor 连接soc控制器接口索引)"
    choice from CAMERA_INTERFACE_TYPE_SELECT
    default -1

config MD_X2000_JZ0378_DVP_GPIO_RESET
    string "gpio reset(sensor 复位脚)"
    choice from SOC_GPIO_PINS
    default -1

config MD_X2000_JZ0378_DVP_GPIO_PWDN
    string "gpio pwdn(sensor 电源控制引脚, 低有效)"
    choice from SOC_GPIO_PINS
    default -1

config MD_X2000_JZ0378_DVP_GPIO_POWER
    string "gpio power(sensor 电源控制引脚, 高有效)"
    choice from SOC_GPIO_PINS
    default -1

config MD_X2000_JZ0378_DVP_I2C_BUSNUM
    int "i2c bus num (sensor 挂接的i2c总线号)"
    default -1

config MD_X2000_JZ0378_DVP_DVP_DATE_FMT
    string "dvp_gpio_func(dvp 接口选择使用的位数)"
    choice from SENSOR_DVP_GPIO_FUNC
    default -1

array SENSOR_RESOLUTION
    string "sensor resolution"
    item "640*480 100fps" JZ0378_640_480_100FPS
    item "400*336 100fps" JZ0378_400_336_100FPS

config MD_X2000_JZ0378_DVP_RESOLUTION
    string "resolution(tt3610_dvp分辨率配置)"
    choice from SENSOR_RESOLUTION
    default -1

endmenu # MD_X2000_SENSOR_JZ0378_DVP
```

## module_driver/package/devices/camera/x2000/ov7251_mipi/Config.in
```kconfig
menuconfig MD_X2000_SENSOR_OV7251_MIPI
    bool "sensor ov7251 (mipi,raw10)"
    select MD_X2000_CAMERA_VIC
    depends on MD_SOC_X2000_BASE

source package/soc/x2000/camera/interface_type.in

config MD_X2000_OV7251_CAMERA_INDEX
    string "选择控制器(sensor 连接soc控制器接口索引)"
    choice from CAMERA_INTERFACE_TYPE_SELECT
    default -1

config MD_X2000_OV7251_GPIO_RESET
    string "gpio reset(sensor 复位脚)"
    choice from SOC_GPIO_PINS
    default -1

config MD_X2000_OV7251_I2C_BUSNUM
    int "i2c bus num (sensor 挂接的i2c总线号)"
    default -1

array SENSOR_OV7251_RESOLUTION
    string "sensor ov7251 resolution"
    item "640*480 120fps" OV7251_FULL_640_480_120FPS
    item "320*240 200fps binning" OV7251_BINNING_320_240_200FPS

config MD_X2000_SENSOR_OV7251_RESOLUTION
    string "resolution(ov7251分辨率配置)"
    choice from SENSOR_OV7251_RESOLUTION
    default -1

endmenu # MD_X2000_SENSOR_OV7251_MIPI
```

## module_driver/package/devices/camera/x2000/ov9281_mipi/Config.in
```kconfig
menuconfig MD_X2000_SENSOR_OV9281_MIPI
    bool "sensor ov9281 (mipi,raw8)"
    select MD_X2000_CAMERA_VIC
    depends on MD_SOC_X2000_BASE

source package/soc/x2000/camera/interface_type.in

config MD_X2000_OV9281_CAMERA_INDEX
    string "选择控制器(sensor 连接soc控制器接口索引)"
    choice from CAMERA_INTERFACE_TYPE_SELECT
    default -1

config MD_X2000_OV9281_GPIO_RESET
    string "gpio reset(sensor 复位脚)"
    choice from SOC_GPIO_PINS
    default -1

config MD_X2000_OV9281_GPIO_PWDN
    string "gpio pwdn(sensor 电源控制引脚, 低有效)"
    choice from SOC_GPIO_PINS
    default -1

config MD_X2000_OV9281_GPIO_POWER
    string "gpio power(sensor 电源控制引脚, 高有效)"
    choice from SOC_GPIO_PINS
    default -1

config MD_X2000_OV9281_I2C_BUSNUM
    int "i2c bus num (sensor 挂接的i2c总线号)"
    default -1

endmenu # MD_X2000_SENSOR_OV9281_MIPI
```

## module_driver/package/devices/camera/x2000/ov9732_dvp/Config.in
```kconfig
menuconfig MD_X2000_SENSOR_OV9732_DVP
	bool "sensor ov9732 (dvp,raw10)"
	select MD_X2000_CAMERA_VIC
	depends on MD_SOC_X2000_BASE

config MD_X2000_OV9732_DVP_SENSOR_NAME
	string "sensor module name"
	default "ov9732-vis"

config MD_X2000_OV9732_DVP_GPIO_RESET0
	string "gpio reset(sensor 复位脚)"
	choice from SOC_GPIO_PINS
	default -1

config MD_X2000_OV9732_DVP_GPIO_PWDN0
	string "gpio pwdn(sensor 电源控制引脚, 低有效)"
	choice from SOC_GPIO_PINS
	default -1

config MD_X2000_OV9732_DVP_GPIO_POWER0
	string "gpio power(sensor 电源控制引脚, 高有效)"
	choice from SOC_GPIO_PINS
	default -1

config MD_X2000_OV9732_DVP_SENSOR_REGULATOR_NAME
	string "regulator name(通过名字获取 sensor module 电源管理器)"
	default "GPIO-POWER0"

config MD_X2000_OV9732_DVP_I2C_BUSNUM0
	int "i2c bus num (sensor 挂接的i2c总线号)"
	default -1

config MD_X2000_OV9732_DVP_I2C_ADDR0
	int "i2c device addr (sensor的i2c地址)"
	default -1

config MD_X2000_OV9732_DVP_CAM_BUSNUM0
	int "cam bus num (sensor 挂接的vic/cim总线号)"
	default -1

endmenu
```

## module_driver/package/devices/camera/x2000/ov9732_mipi/Config.in
```kconfig
menuconfig MD_X2000_SENSOR_OV9732_MIPI
    bool "sensor ov9732 (mipi,raw10)"
    select MD_X2000_CAMERA_VIC
    depends on MD_SOC_X2000_BASE

menuconfig MD_X2000_SENSOR0_OV9732
	bool "sensor0 config"

config MD_X2000_OV9732_SENSOR0_NAME
    string "sensor module name"
    default "ov9732-vis"

config MD_X2000_OV9732_GPIO_RESET0
    string "gpio reset(sensor 复位脚)"
    choice from SOC_GPIO_PINS
    default -1

config MD_X2000_OV9732_GPIO_PWDN0
    string "gpio pwdn(sensor 电源控制引脚, 低有效)"
    choice from SOC_GPIO_PINS
    default -1

config MD_X2000_OV9732_GPIO_POWER0
    string "gpio power(sensor 电源控制引脚, 高有效)"
    choice from SOC_GPIO_PINS
    default -1

config MD_X2000_OV9732_SENSOR0_REGULATOR_NAME
	string "regulator name(通过名字获取 sensor module 电源管理器)"
	default "GPIO-POWER0"

config MD_X2000_OV9732_I2C_BUSNUM0
    int "i2c bus num (sensor 挂接的i2c总线号)"
    default -1

config MD_X2000_OV9732_I2C_ADDR0
	int "i2c device addr (sensor的i2c地址)"
	default -1

config MD_X2000_OV9732_CAM_BUSNUM0
	int "cam bus num (sensor 挂接的vic/cim总线号)"
	default -1
endmenu


menuconfig MD_X2000_SENSOR1_OV9732
	bool "sensor1 config"

config MD_X2000_OV9732_SENSOR1_NAME
    string "sensor module name"
    default "ov9732-ir"

config MD_X2000_OV9732_GPIO_RESET1
    string "gpio reset(sensor 复位脚)"
    choice from SOC_GPIO_PINS
    default -1

config MD_X2000_OV9732_GPIO_PWDN1
    string "gpio pwdn(sensor 电源控制引脚, 低有效)"
    choice from SOC_GPIO_PINS
    default -1

config MD_X2000_OV9732_GPIO_POWER1
    string "gpio power(sensor 电源控制引脚, 高有效)"
    choice from SOC_GPIO_PINS
    default -1

config MD_X2000_OV9732_SENSOR1_REGULATOR_NAME
	string "regulator name(通过名字获取 sensor module 电源管理器)"
	default "GPIO-POWER0"

config MD_X2000_OV9732_I2C_BUSNUM1
    int "i2c bus num (sensor 挂接的i2c总线号)"
    default -1

config MD_X2000_OV9732_I2C_ADDR1
	int "i2c device addr (sensor的i2c地址)"
	default -1

config MD_X2000_OV9732_CAM_BUSNUM1
	int "cam bus num (sensor 挂接的vic/cim总线号)"
	default -1
endmenu

endmenu
```

## module_driver/package/devices/camera/x2000/sc031_dvp/Config.in
```kconfig
menuconfig MD_X2000_SENSOR_SC031_DVP
    bool "sensor sc031 (dvp,raw8)"
    select MD_X2000_CAMERA_VIC
    depends on MD_SOC_X2000_BASE

config MD_X2000_SC031_DVP_GPIO_RESET
    string "gpio reset(sensor 复位脚)"
    choice from SOC_GPIO_PINS
    default -1

config MD_X2000_SC031_DVP_GPIO_PWDN
    string "gpio pwdn(sensor 电源控制引脚, 低有效)"
    choice from SOC_GPIO_PINS
    default -1

config MD_X2000_SC031_DVP_GPIO_POWER
    string "gpio power(sensor 电源控制引脚, 高有效)"
    choice from SOC_GPIO_PINS
    default -1

config MD_X2000_SC031_DVP_I2C_BUSNUM
    int "i2c bus num (sensor 挂接的i2c总线号)"
    default -1

config MD_X2000_SC031_DVP_CAM_BUSNUM
    int "cam bus num (sensor 挂接的vic/cim总线号)"
    default -1

endmenu
```

## module_driver/package/devices/camera/x2000/sc031_mipi/Config.in
```kconfig
menuconfig MD_X2000_SENSOR_SC031_MIPI
    bool "sensor sc031 (mipi,raw10)"
    select MD_X2000_CAMERA_VIC
    depends on MD_SOC_X2000_BASE

menuconfig MD_X2000_SENSOR0_SC031
	bool "sensor0 master config"

config MD_X2000_SC031_SENSOR0_NAME
    string "sensor module name"
    default "sc031-ir0"

config MD_X2000_SC031_GPIO_RESET0
    string "gpio reset(sensor 复位脚)"
    choice from SOC_GPIO_PINS
    default -1

config MD_X2000_SC031_GPIO_PWDN0
    string "gpio pwdn(sensor 电源控制引脚, 低有效)"
    choice from SOC_GPIO_PINS
    default -1

config MD_X2000_SC031_GPIO_POWER0
    string "gpio power(sensor 电源控制引脚, 高有效)"
    choice from SOC_GPIO_PINS
    default -1

config MD_X2000_SC031_SENSOR0_REGULATOR_NAME
	string "regulator name(通过名字获取 sensor module 电源管理器)"
	default "GPIO-POWER0"

config MD_X2000_SC031_I2C_BUSNUM0
    int "i2c bus num (sensor 挂接的i2c总线号)"
    default -1

config MD_X2000_SC031_I2C_ADDR0
	int "i2c device addr (sensor的i2c地址)"
	default -1

config MD_X2000_SC031_CAM_BUSNUM0
	int "cam bus num (sensor 挂接的vic/cim总线号)"
	default -1

config MD_X2000_SC031_SENSOR_STROBE
    string "sensor strobe gpio (sensor strobe gpio)"
    choice from SOC_GPIO_PINS
    default -1

config MD_X2000_SC031_LIGHT_CTL_GPIO
    string "light ctl gpio num (light ctl gpio)"
    choice from SOC_GPIO_PINS
    default -1
endmenu


menuconfig MD_X2000_SENSOR1_SC031
	bool "sensor1 slave config"
	select MD_X2000_SENSOR0_SC031

config MD_X2000_SC031_SENSOR1_NAME
    string "sensor module name"
    default "sc031-ir1"

config MD_X2000_SC031_GPIO_RESET1
    string "gpio reset(sensor 复位脚)"
    choice from SOC_GPIO_PINS
    default -1

config MD_X2000_SC031_GPIO_PWDN1
    string "gpio pwdn(sensor 电源控制引脚, 低有效)"
    choice from SOC_GPIO_PINS
    default -1

config MD_X2000_SC031_GPIO_POWER1
    string "gpio power(sensor 电源控制引脚, 高有效)"
    choice from SOC_GPIO_PINS
    default -1

config MD_X2000_SC031_SENSOR1_REGULATOR_NAME
	string "regulator name(通过名字获取 sensor module 电源管理器)"
	default "GPIO-POWER0"

config MD_X2000_SC031_I2C_BUSNUM1
    int "i2c bus num (sensor 挂接的i2c总线号)"
    default -1

config MD_X2000_SC031_I2C_ADDR1
	int "i2c device addr (sensor的i2c地址)"
	default -1

config MD_X2000_SC031_CAM_BUSNUM1
	int "cam bus num (sensor 挂接的vic/cim总线号)"
	default -1
endmenu

endmenu
```
