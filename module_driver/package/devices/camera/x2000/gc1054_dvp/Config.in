## module_driver/package/devices/camera/x2000/sc035_mipi/Config.in
```kconfig
menuconfig MD_X2000_SENSOR_SC035_MIPI
    bool "sensor sc035 (mipi,raw8)"
    select MD_X2000_CAMERA_VIC
    depends on MD_SOC_X2000_BASE

array SENSOR_MODE_SELECT
    string "sensor mode select"
    item "master mode" MASTER_MODE
    item "salve mode" SALVE_MODE
    item " Not used " -1

menuconfig MD_X2000_SENSOR0_SC035
	bool "sensor0 config"

config MD_X2000_SC035_SENSOR0_NAME
    string "sensor module name"
    default "sc035-ir0"

config MD_X2000_SC035_SENSOR0_MODE
    string "sensor mode select(master/salve)"
    choice from SENSOR_MODE_SELECT
    default -1

config MD_X2000_SC035_GPIO_RESET0
    string "gpio reset(sensor 复位脚)"
    choice from SOC_GPIO_PINS
    default -1

config MD_X2000_SC035_GPIO_PWDN0
    string "gpio pwdn(sensor 电源控制引脚, 低有效)"
    choice from SOC_GPIO_PINS
    default -1

config MD_X2000_SC035_GPIO_POWER0
    string "gpio power(sensor 电源控制引脚, 高有效)"
    choice from SOC_GPIO_PINS
    default -1

config MD_X2000_SC035_SENSOR0_REGULATOR_NAME
	string "regulator name(通过名字获取 sensor module 电源管理器)"
	default "GPIO-POWER0"

config MD_X2000_SC035_I2C_BUSNUM0
    int "i2c bus num (sensor 挂接的i2c总线号)"
    default -1

config MD_X2000_SC035_I2C_ADDR0
	int "i2c device addr (sensor的i2c地址)"
	default -1

config MD_X2000_SC035_CAM_BUSNUM0
	int "cam bus num (sensor 挂接的vic/cim总线号)"
	default -1

config MD_X2000_SC035_LIGHT_CTL_GPIO
    string "light ctl gpio num (light ctl gpio)"
    choice from SOC_GPIO_PINS
    default -1

config MD_X2000_SC035_SENSOR_STROBE
    string "sensor strobe gpio (sensor strobe gpio)"
    choice from SOC_GPIO_PINS
    default -1
endmenu


menuconfig MD_X2000_SENSOR1_SC035
	bool "sensor1 config"

config MD_X2000_SC035_SENSOR1_NAME
    string "sensor module name"
    default "sc035-ir1"

config MD_X2000_SC035_SENSOR1_MODE
    string "sensor mode select(master/salve)"
    choice from SENSOR_MODE_SELECT
    default -1

config MD_X2000_SC035_GPIO_RESET1
    string "gpio reset(sensor 复位脚)"
    choice from SOC_GPIO_PINS
    default -1

config MD_X2000_SC035_GPIO_PWDN1
    string "gpio pwdn(sensor 电源控制引脚, 低有效)"
    choice from SOC_GPIO_PINS
    default -1

config MD_X2000_SC035_GPIO_POWER1
    string "gpio power(sensor 电源控制引脚, 高有效)"
    choice from SOC_GPIO_PINS
    default -1

config MD_X2000_SC035_SENSOR1_REGULATOR_NAME
	string "regulator name(通过名字获取 sensor module 电源管理器)"
	default "GPIO-POWER0"

config MD_X2000_SC035_I2C_BUSNUM1
    int "i2c bus num (sensor 挂接的i2c总线号)"
    default -1

config MD_X2000_SC035_I2C_ADDR1
	int "i2c device addr (sensor的i2c地址)"
	default -1

config MD_X2000_SC035_CAM_BUSNUM1
	int "cam bus num (sensor 挂接的vic/cim总线号)"
	default -1
endmenu

endmenu
```

## module_driver/package/devices/camera/x2000/sc1345_mipi/Config.in
```kconfig
menuconfig MD_X2000_SENSOR_SC1345_MIPI
    bool "sensor sc1345 (mipi,raw8)"
    select MD_X2000_CAMERA_VIC
    depends on MD_SOC_X2000_BASE


config MD_X2000_SC1345_SENSOR_NAME
    string "sensor module name"
    default "sc1345"

config MD_X2000_SC1345_GPIO_RESET
    string "gpio reset(sensor 复位脚)"
    choice from SOC_GPIO_PINS
    default -1

config MD_X2000_SC1345_GPIO_PWDN
    string "gpio pwdn(sensor power down 引脚)"
    choice from SOC_GPIO_PINS
    default -1

config MD_X2000_SC1345_GPIO_AVDD
    string "gpio avdd(sensor AVDD电源控制引脚, 高有效)"
    choice from SOC_GPIO_PINS
    default -1

config MD_X2000_SC1345_GPIO_DVDD
    string "gpio dvdd(sensor DVDD电源控制引脚, 高有效)"
    choice from SOC_GPIO_PINS
    default -1

config MD_X2000_SC1345_GPIO_DOVDD
    string "gpio dovdd(sensor DOVDD电源控制引脚, 高有效)"
    choice from SOC_GPIO_PINS
    default -1

config MD_X2000_SC1345_I2C_BUSNUM
    int "i2c bus num (sensor 挂接的i2c总线号)"
    default -1

config MD_X2000_SC1345_I2C_ADDR
	int "i2c device addr (sensor的i2c地址)"
	default -1

config MD_X2000_SC1345_CAM_BUSNUM
	int "cam bus num (sensor 挂接的vic/cim总线号)"
	default -1

endmenu
```

## module_driver/package/devices/camera/x2000/sc2310_mipi/Config.in
```kconfig
menuconfig MD_X2000_SENSOR_SC2310_MIPI
    bool "sensor sc2310 (mipi,raw10)"
    select MD_X2000_CAMERA_VIC
    depends on MD_SOC_X2000_BASE

menuconfig MD_X2000_SENSOR0_SC2310
	bool "sensor0 config"

config MD_X2000_SC2310_SENSOR0_NAME
    string "sensor module name"
    default "sc2310-vis"

config MD_X2000_SC2310_GPIO_RESET0
    string "gpio reset(sensor 复位脚)"
    choice from SOC_GPIO_PINS
    default -1

config MD_X2000_SC2310_GPIO_PWDN0
    string "gpio pwdn(sensor 电源控制引脚, 低有效)"
    choice from SOC_GPIO_PINS
    default -1

config MD_X2000_SC2310_GPIO_POWER0
    string "gpio power(sensor 电源控制引脚, 高有效)"
    choice from SOC_GPIO_PINS
    default -1

config MD_X2000_SC2310_SENSOR0_REGULATOR_NAME
	string "regulator name(通过名字获取 sensor module 电源管理器)"
	default "GPIO-POWER0"

config MD_X2000_SC2310_I2C_BUSNUM0
    int "i2c bus num (sensor 挂接的i2c总线号)"
    default -1

config MD_X2000_SC2310_I2C_ADDR0
	int "i2c device addr (sensor的i2c地址)"
	default -1

config MD_X2000_SC2310_CAM_BUSNUM0
	int "cam bus num (sensor 挂接的vic/cim总线号)"
	default -1
endmenu


menuconfig MD_X2000_SENSOR1_SC2310
	bool "sensor1 config"

config MD_X2000_SC2310_SENSOR1_NAME
    string "sensor module name"
    default "sc2310-ir"

config MD_X2000_SC2310_GPIO_RESET1
    string "gpio reset(sensor 复位脚)"
    choice from SOC_GPIO_PINS
    default -1

config MD_X2000_SC2310_GPIO_PWDN1
    string "gpio pwdn(sensor 电源控制引脚, 低有效)"
    choice from SOC_GPIO_PINS
    default -1

config MD_X2000_SC2310_GPIO_POWER1
    string "gpio power(sensor 电源控制引脚, 高有效)"
    choice from SOC_GPIO_PINS
    default -1

config MD_X2000_SC2310_SENSOR1_REGULATOR_NAME
	string "regulator name(通过名字获取 sensor module 电源管理器)"
	default "GPIO-POWER0"

config MD_X2000_SC2310_I2C_BUSNUM1
    int "i2c bus num (sensor 挂接的i2c总线号)"
    default -1

config MD_X2000_SC2310_I2C_ADDR1
	int "i2c device addr (sensor的i2c地址)"
	default -1

config MD_X2000_SC2310_CAM_BUSNUM1
	int "cam bus num (sensor 挂接的vic/cim总线号)"
	default -1
endmenu

endmenu
```

## module_driver/package/devices/camera/x2000/sc301_mipi/Config.in
```kconfig
menuconfig MD_X2000_SENSOR_SC301_MIPI
    bool "sensor sc301 (mipi,raw10)"
    select MD_X2000_CAMERA_VIC
    depends on MD_SOC_X2000_BASE

config MD_X2000_SC301_SENSOR_NAME
	string "sensor module name"
	default "sc301"

config MD_X2000_SC301_GPIO_RESET
    string "gpio reset(sensor 复位脚)"
    choice from SOC_GPIO_PINS
    default -1

config MD_X2000_SC301_GPIO_PWDN
    string "gpio pwdn(sensor 电源控制引脚, 低有效)"
    choice from SOC_GPIO_PINS
    default -1

config MD_X2000_SC301_GPIO_POWER
	string "gpio power(sensor 电源控制引脚, 高有效)"
	choice from SOC_GPIO_PINS
	default -1

config MD_X2000_SC301_SENSOR_REGULATOR_NAME
	string "regulator name(通过名字获取 sensor module 电源管理器)"
	default "GPIO-POWER0"

config MD_X2000_SC301_I2C_BUSNUM
    int "i2c bus num (sensor 挂接的i2c总线号)"
    default -1

config MD_X2000_SC301_I2C_ADDR
	int "i2c device addr (sensor的i2c地址)"
	default -1

config MD_X2000_SC301_CAM_BUSNUM
	int "cam bus num (sensor 挂接的vic/cim总线号)"
	default -1

endmenu # MD_X2000_SENSOR_SC301_MIPI
```

## module_driver/package/devices/codec/ak4493/Config.in
```kconfig
menuconfig MD_CODEC_AK4493
    bool "codec ak4493"

config MD_AK4493_GPIO_PDN
    string "gpio pdn(codec 电源控制引脚)"
    choice from SOC_GPIO_PINS
    default -1

config MD_AK4493_GPIO_MUTE
    string "gpio mute(codec 音频控制引脚)"
    choice from SOC_GPIO_PINS
    default -1

config MD_AK4493_GPIO_CD_SEL
    string "gpio cd_sel(74LVC244APW 信号缓冲器 OE1)"
    choice from SOC_GPIO_PINS
    default -1

config MD_AK4493_GPIO_UBW_SEL
    string "gpio usb/bt/wifi_sel(74LVC244APW 信号缓冲器 OE2)"
    choice from SOC_GPIO_PINS
    default -1

config MD_AK4493_I2C_BUSNUM
    int "i2c bus num (sensor 挂接的i2c总线号)"
    default -1

endmenu # MD_CODEC_AK4493
```

## module_driver/package/devices/isp_camera/Config.in
```kconfig
menu "isp camera设备列表(支持X1520/X1830)"

# x1520 isp cameras
source package/devices/isp_camera/x1520/ov9281_mipi/Config.in
source package/devices/isp_camera/x1520/sc031/Config.in
source package/devices/isp_camera/x1520/ov9732/Config.in
source package/devices/isp_camera/x1520/ov5693/Config.in
source package/devices/isp_camera/x1520/sc132/Config.in

# x1830 isp cameras
source package/devices/isp_camera/x1830/ov2735/Config.in
source package/devices/isp_camera/x1830/s5k6a1/Config.in
# source package/devices/isp_camera/x1830/ov9732/Config.in
# source package/devices/isp_camera/x1830/imx307/Config.in
source package/devices/isp_camera/x1830/gc2375/Config.in
source package/devices/isp_camera/x1830/ar0230/Config.in
source package/devices/isp_camera/x1830/ar0522/Config.in
source package/devices/isp_camera/x1830/bf2253l/Config.in
endmenu
```

## module_driver/package/devices/isp_camera/x1520/ov5693/Config.in
```kconfig
menuconfig MD_X1520_SENSOR_ISP_OV5693
    bool "sensor ov5693 (mipi,raw10)"
    depends on MD_SOC_X1520

config OV5693_BINNING_960P_SUPPORT
    bool "sensor ov5693 binning_1280_960_30fps (选择binnig 1280*960 30fps)"

config MD_X1520_OV5693_GPIO_RESET
    string "gpio reset(sensor 复位脚)"
    choice from SOC_GPIO_PINS
    default -1

config MD_X1520_OV5693_GPIO_PWDN
    string "gpio pwdn(sensor 电源控制引脚, 低有效)"
    choice from SOC_GPIO_PINS
    default -1

config MD_X1520_OV5693_ISPCLK
    int "isp clk (isp 时钟频率)"
    default 90000000

endmenu # MD_X1520_SENSOR_OV5693
```

## module_driver/package/devices/isp_camera/x1520/ov9281_mipi/Config.in
```kconfig
menuconfig MD_X1520_SENSOR_ISP_OV9281_MIPI
    bool "sensor ov9281 (mipi,raw10)"
    depends on MD_SOC_X1520

choice "        ov9281 mipi 分辨率选择"
    default MD_X1520_OV9281_MIPI_1280X720

config MD_X1520_OV9281_MIPI_1280X800
    bool "1280*800"

config MD_X1520_OV9281_MIPI_1280X720
    bool "1280*720"

config MD_X1520_OV9281_MIPI_640X480
    bool "640*480"

config MD_X1520_OV9281_MIPI_640X400
    bool "640*400"

endchoice

config MD_X1520_OV9281_GPIO_RESET
    string "gpio reset(sensor 复位脚)"
    choice from SOC_GPIO_PINS
    default -1

config MD_X1520_OV9281_GPIO_PWDN
    string "gpio pwdn(sensor 电源控制引脚, 低有效)"
    choice from SOC_GPIO_PINS
    default -1

config MD_X1520_OV9281_ISPCLK
    int "isp clk (isp 时钟频率)"
    default 90000000

endmenu # MD_X1520_SENSOR_OV9281_MIPI
```

## module_driver/package/devices/isp_camera/x1520/ov9732/Config.in
```kconfig
menuconfig MD_X1520_SENSOR_ISP_OV9732
    bool "sensor ov9732 (dvp,raw10)"
    depends on MD_SOC_X1520

config OV9732_USE_AGAIN_ONLY
    bool "sensor ov9732 use again only (仅使用again)"

config MD_X1520_OV9732_GPIO_RESET
    string "gpio reset(sensor 复位脚)"
    choice from SOC_GPIO_PINS
    default -1

config MD_X1520_OV9732_GPIO_PWDN
    string "gpio pwdn(sensor 电源控制引脚, 低有效)"
    choice from SOC_GPIO_PINS
    default -1

source soc/x1520/camera/dvp_gpio_func.in

config MD_X1520_OV9732_DVP_GPIO_FUNC
    string "dvp_gpio_func(dvp 接口选择使用的位数)"
    choice from SENSOR_DVP_GPIO_FUNC
    default -1

config MD_X1520_OV9732_ISPCLK
    int "isp clk (isp 时钟频率)"
    default 90000000

endmenu # MD_X1520_SENSOR_OV9732
```

## module_driver/package/devices/isp_camera/x1520/sc031/Config.in
```kconfig
menuconfig MD_X1520_SENSOR_ISP_SC031
    bool "sensor sc031gs (dvp,raw8)"
    depends on MD_SOC_X1520

config MD_X1520_SC031_120FPS_SUPPORT
    bool "sensor 640*480 120fps (选择120fps)"

config MD_X1520_SC031_GPIO_RESET
    string "gpio reset(sensor 复位脚)"
    choice from SOC_GPIO_PINS
    default -1

config MD_X1520_SC031_GPIO_PWDN
    string "gpio pwdn(sensor 电源控制引脚, 低有效)"
    choice from SOC_GPIO_PINS
    default -1

source soc/x1520/camera/dvp_gpio_func.in

config MD_X1520_SC031_DVP_GPIO_FUNC
    string "dvp_gpio_func(dvp 接口选择使用的位数)"
    choice from SENSOR_DVP_GPIO_FUNC
    default -1

config MD_X1520_SC031_ISPCLK
    int "isp clk (isp 时钟频率)"
    default 90000000

endmenu # MD_X1520_SENSOR_SC031
```

## module_driver/package/devices/isp_camera/x1520/sc132/Config.in
```kconfig
menuconfig MD_X1520_SENSOR_ISP_SC132
    bool "sensor sc132gs (mipi,raw10)"
    depends on MD_SOC_X1520

config MD_X1520_SC132_GPIO_RESET
    string "gpio reset(sensor 复位脚)"
    choice from SOC_GPIO_PINS
    default -1

config MD_X1520_SC132_GPIO_PWDN
    string "gpio pwdn(sensor 电源控制引脚, 低有效)"
    choice from SOC_GPIO_PINS
    default -1

config MD_X1520_SC132_ISPCLK
    int "isp clk (isp 时钟频率)"
    default 90000000

endmenu # MD_X1520_SENSOR_SC132
```
