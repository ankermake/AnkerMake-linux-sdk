## module_driver/package/devices/wireless/rtl8189FS_linux_v5.7.10/Config.in
```kconfig
menuconfig MD_RTL8189FS
	bool "RTL8189FS wireless cards support"

config MD_RTL8189FS_MMC_NUM
	int "wlan_mmc_num (mmc/sdio 总线号)"
	default -1
	help
	  wifi 挂接在哪个 mmc 总线,比如 0, 1

config MD_RTL8189FS_WLAN_DIS_N
	string "gpio_wl_dis_n(控制wifi的供电)"
	default -1
	choice from SOC_GPIO_PINS

config MD_RTL8189FS_BT_DIS_N
	string "gpio_bt_dis_n(用于控制bt的供电)"
	default -1
	choice from SOC_GPIO_PINS

config MD_RTL8189FS_BT_WIFI_POWER_EN
	string "gpio_bt_wifi_power_en(用于控制整个模块的供电)"
	default -1
	choice from SOC_GPIO_PINS

endmenu
```

## module_driver/package/devices/wireless/rtl8723DS_WiFi_linux_v5.10/Config.in
```kconfig
menuconfig MD_RTL8723DS
	bool "rtl8723ds wireless cards support"

config MD_RTL8723DS_MMC_NUM
	int "wlan_mmc_num (mmc/sdio 总线号)"
	default -1
	help
	  wifi 挂接在哪个 mmc 总线,比如 0, 1

config MD_RTL8723DS_WLAN_DIS_N
	string "gpio_wl_dis_n(控制wifi的供电)"
	default -1
	choice from SOC_GPIO_PINS

config MD_RTL8723DS_BT_DIS_N
	string "gpio_bt_dis_n(用于控制bt的供电)"
	default -1
	choice from SOC_GPIO_PINS

config MD_RTL8723DS_BT_WIFI_POWER_EN
	string "gpio_bt_wifi_power_en(用于控制整个模块的供电)"
	default -1
	choice from SOC_GPIO_PINS

config MD_RTL8723DS_BT_WIFI_POWER_VALID_LEVEL
	string "gpio_bt_wifi_power_valid_level(bt,wifi模块供电引脚的有效电平)"
	default 0
	choice from MD_GPIO_ACTIVE_LEVEL

endmenu
```

## module_driver/package/devices/wireless/ssv6x5x_linux/Config.in
```kconfig
menuconfig MD_SSV6X5X
    bool "SSV6X5X wireless cards support"

config MD_SSV6X5X_MMC_NUM
	int "wlan_mmc_num (mmc/sdio 总线号)"
	default -1
	help
	  wifi 挂接在哪个 mmc 总线,比如 0, 1

config MD_SSV6X5X_WIFI_POWER_EN
	string "gpio_wifi_en(控制wifi的供电)"
	default -1
	choice from SOC_GPIO_PINS

config MD_SSV6X5X_WIFI_RESET
	string "gpio_wifi_rst(控制wifi的初始上电重置)"
	default -1
	choice from SOC_GPIO_PINS

config MD_SSV6X5X_WIFI_POWER_VALID_LEVEL
	string "wifi_power_valid_level(wifi模块供电引脚的有效电平)"
	default 0
	choice from MD_GPIO_ACTIVE_LEVEL

config MD_SSV6X5X_STACFG_PATH
	string "stacfgpath"
	default "ssv6x5x-wifi.cfg"

endmenu
```

## module_driver/package/drivers/Config.in
```kconfig
menu "驱动"

source package/drivers/utils/Config.in

source package/drivers/rmem_manager/Config.in

source package/drivers/spi_gpio/Config.in

source package/drivers/spi_fb/Config.in

source package/drivers/i2c_gpio/Config.in

source package/drivers/spidev_helper/Config.in

source package/drivers/spidev/Config.in

source package/drivers/hci_uart_h5_kernel_4_4_94/Config.in

source package/drivers/hci_uart_h5_kernel_3_10_14/Config.in

source package/drivers/ps2_gpio/Config.in

source package/drivers/pwm_audio/Config.in

endmenu
```

## module_driver/package/drivers/hci_uart_h5_kernel_3_10_14/Config.in
```kconfig
config MD_BT_HCIUART_RTKH5_KERNEL_3_10_14
    bool "Realtek H5 protocol support(kernel 3.10.14 )"
```

## module_driver/package/drivers/hci_uart_h5_kernel_4_4_94/Config.in
```kconfig
config MD_BT_HCIUART_RTKH5_KERNEL_4_4_94
    bool "Realtek H5 protocol support(kernel 4.4.94 )"
```

## module_driver/package/drivers/i2c_gpio/Config.in
```kconfig
menuconfig MD_I2C_GPIO
    bool "gpio i2c 驱动"

source "package/drivers/i2c_gpio/i2c_gpio0.in"
source "package/drivers/i2c_gpio/i2c_gpio1.in"
source "package/drivers/i2c_gpio/i2c_gpio2.in"
source "package/drivers/i2c_gpio/i2c_gpio3.in"
source "package/drivers/i2c_gpio/i2c_gpio4.in"
source "package/drivers/i2c_gpio/i2c_gpio5.in"
source "package/drivers/i2c_gpio/i2c_gpio6.in"
source "package/drivers/i2c_gpio/i2c_gpio7.in"

endmenu
```

## module_driver/package/drivers/ps2_gpio/Config.in
```kconfig
menuconfig MD_GPIO_PS2
    bool "gpio模拟PS2接口"
    default n

config MD_GPIO_PS2_0
    bool "模拟PS2接口节点0"
    default n

config MD_GPIO_PS2_0_CLK
    string "PS2 时钟引脚"
    choice from SOC_GPIO_PINS
    depends on MD_GPIO_PS2_0
    default -1

config MD_GPIO_PS2_0_DATA
    string "PS2 数据引脚"
    choice from SOC_GPIO_PINS
    depends on MD_GPIO_PS2_0
    default -1

config MD_GPIO_PS2_1
    bool "模拟PS2接口节点1"
    default n

config MD_GPIO_PS2_1_CLK
    string "PS2 时钟引脚"
    choice from SOC_GPIO_PINS
    depends on MD_GPIO_PS2_1
    default -1

config MD_GPIO_PS2_1_DATA
    string "PS2 数据引脚"
    choice from SOC_GPIO_PINS
    depends on MD_GPIO_PS2_1
    default -1

endmenu
```

## module_driver/package/drivers/pwm_audio/Config.in
```kconfig
config MD_PWM_AUDIO
    bool "PMW 模拟声卡驱动"
    default n

config MD_PWM_AUDIO_PWM_GPIO_1
    string "声卡1 pwm 引脚"
    choice from SOC_GPIO_PINS
    depends on MD_PWM_AUDIO
    default -1

config MD_PWM_AUDIO_AMP_POWER_GPIO_1
    string "声卡1 功放使能引脚"
    choice from SOC_GPIO_PINS
    depends on MD_PWM_AUDIO
    default -1

config MD_PWM_AUDIO_PWM_GPIO_2
    string "声卡2 pwm 引脚"
    choice from SOC_GPIO_PINS
    depends on MD_PWM_AUDIO
    default -1

config MD_PWM_AUDIO_AMP_POWER_GPIO_2
    string "声卡2 功放使能引脚"
    choice from SOC_GPIO_PINS
    depends on MD_PWM_AUDIO
    default -1
```

## module_driver/package/drivers/rmem_manager/Config.in
```kconfig
config MD_RMEM_MANAGER
    bool "预留内存管理模块"
    default n
    help
        需先在uboot中分配内存给该模块管理
```

## module_driver/package/drivers/spi_fb/Config.in
```kconfig
menuconfig MD_SPI_FB
    bool "spi framebuffer 驱动"

config MD_X2000_FB0_FREMES
    int "spi framebuffer(fb0的帧缓冲数)"
    default 2

endmenu # MD_SPI_FB
```

## module_driver/package/drivers/spi_gpio/Config.in
```kconfig
menuconfig MD_SPI_GPIO
    bool "gpio spi 驱动/设备"

source "package/drivers/spi_gpio/spi_gpio0.in"
source "package/drivers/spi_gpio/spi_gpio1.in"
source "package/drivers/spi_gpio/spi_gpio2.in"
source "package/drivers/spi_gpio/spi_gpio3.in"
source "package/drivers/spi_gpio/spi_gpio4.in"
source "package/drivers/spi_gpio/spi_gpio5.in"
source "package/drivers/spi_gpio/spi_gpio6.in"
source "package/drivers/spi_gpio/spi_gpio7.in"

endmenu
```

## module_driver/package/drivers/spidev_helper/Config.in
```kconfig
config MD_SPI_DEVICE_HELPER
    bool "spi设备辅助模块（动态增加或删除spi设备）"
    select MD_SPI_DEVICE
    default n
```

## module_driver/package/drivers/utils/Config.in
```kconfig
array MD_GPIO_ACTIVE_LEVEL
    int "gpio 使能电平"
    item "0(低电平使能)" 0
    item "1(高电平使能)" 1

menu "utils (基础实用工具集)"

config MD_UTILS_LOG
    bool "log 日志buffer,应用层可以使用"
    default y

config MD_UTILS_STRING
    bool "string 相关的实用工具"
    default y

config MD_UTILS_GPIO
    bool "gpio 相关的实用工具"
    select MD_UTILS_STRING
    default y

config MD_UTILS_I2C
    bool "i2c 相关的实用工具"
    default y

config MD_UTILS_SPI
    bool "spi 相关的实用工具"
    default y

config MD_UTILS_CLOCK
    bool "clock 相关的实用工具"
    default y

config MD_UTILS_RING_MEM
    bool "ring_mem 环形缓冲区"
    default y

endmenu
```

## module_driver/package/soc/Config.in
```kconfig
choice "        soc(芯片)"

config MD_CHOICE_SOC_X1830
    bool "x1830"
    select MD_SOC_X1830

config MD_CHOICE_SOC_X1520
    bool "x1520"
    select MD_SOC_X1520

config MD_CHOICE_SOC_X1021
    bool "x1021"
    select MD_SOC_X1021

config MD_CHOICE_SOC_X1000
    bool "x1000"
    select MD_SOC_X1000

config MD_CHOICE_SOC_X1600
    bool "x1600"
    select MD_SOC_X1600
    select MD_SOC_X1600_BASE
    select MD_CHOICE_SOC_X1600_BASE
    select CONFIG_SOC_X1600_IO_ARRAY

config MD_CHOICE_SOC_X1660
    bool "x1660 (x1600系列)"
    select MD_SOC_X1600
    select MD_SOC_X1600_BASE
    select MD_CHOICE_SOC_X1600_BASE
    select CONFIG_SOC_X1660_IO_ARRAY

config MD_CHOICE_SOC_X1600_510
    bool "x1600 (5.10 kernel)"
    select MD_SOC_X1600_510
    select MD_SOC_X1600_BASE
    select MD_CHOICE_SOC_X1600_510_BASE
    select CONFIG_SOC_X1600_510_IO_ARRAY

config MD_CHOICE_SOC_X1660_510
    bool "x1660 (5.10 kernel)"
    select MD_SOC_X1600_510
    select MD_SOC_X1600_BASE
    select MD_CHOICE_SOC_X1600_510_BASE
    select CONFIG_SOC_X1660_510_IO_ARRAY

config MD_CHOICE_SOC_X2000
    bool "x2000"
    select MD_SOC_X2000
    select MD_SOC_X2000_BASE

config MD_CHOICE_SOC_X2000_510
    bool "x2000 (5.10 kernel)"
    select MD_SOC_X2000_510
    select MD_SOC_X2000_BASE

endchoice

config MD_SOC_X1600_BASE
    bool

config MD_CHOICE_SOC_X1600_BASE
    bool

config MD_CHOICE_SOC_X1600_510_BASE
    bool

config MD_SOC_X2000_BASE
    bool

source package/soc/x1830/Config.in
source package/soc/x1520/Config.in
source package/soc/x1021/Config.in
source package/soc/x1000/Config.in
source package/soc/x1600/Config.in
source package/soc/x1600_510/Config.in
source package/soc/x2000/Config.in
source package/soc/x2000_510/Config.in
```

## module_driver/package/soc/x1000/Config.in
```kconfig
menuconfig MD_SOC_X1000
    bool "x1000驱动列表"
    depends on MD_CHOICE_SOC_X1000

config MD_SOC_DIR
    string
    default soc/x1000

source package/soc/x1000/def_gpio_pins.in

source package/soc/x1000/spi/Config.in

source package/soc/x1000/efuse/Config.in

source package/soc/x1000/pwm/Config.in

source package/soc/x1000/fb/Config.in

source package/soc/x1000/watchdog/Config.in

source package/soc/x1000/i2c/Config.in

source package/soc/x1000/dmic/Config.in

source package/soc/x1000/camera/Config.in

source package/soc/x1000/mac/Config.in

source package/soc/x1000/utils/Config.in

source package/soc/x1000/gpio/Config.in

source package/soc/x1000/icodec/Config.in

source package/soc/x1000/aic/Config.in

source package/soc/x1000/mcu/Config.in

endmenu
```

## module_driver/package/soc/x1000/camera/Config.in
```kconfig
menuconfig MD_X1000_CAMERA
    bool "camera 驱动(cim控制器)"

config MD_X1000_CAMERA_FRAME_NUMS
    int "camera帧缓冲数"
    default 2

endmenu
```

## module_driver/package/soc/x1000/efuse/Config.in
```kconfig
menuconfig MD_X1000_EFUSE
    bool "efuse 驱动(芯片熔丝功能)"

config MD_X1000_EFUSE_VDDQ
    string "efuse 写使能引脚"
    choice from SOC_GPIO_PINS
    default -1

endmenu
```

## module_driver/package/soc/x1000/fb/Config.in
```kconfig
menuconfig MD_X1000_FB
    bool "fb 显示驱动"
    help
        Framebuffer support for the x1000 SoC.
        kernel must select those options
        select FB
        select FB_CFB_FILLRECT
        select FB_CFB_COPYAREA
        select FB_CFB_IMAGEBLIT


config MD_X1000_FB_FRAME_NUM
    int "帧缓冲数量"
    default 1

config MD_X1000_FB_PAN_DISPLAY_SYNC
    bool "pan_display 调用时等待帧刷新完成(单缓冲时选中)"
    default y

endmenu
```

## module_driver/package/soc/x1000/i2c/Config.in
```kconfig
menuconfig MD_X1000_I2C
    bool "i2c 控制器驱动"


config MD_X1000_I2C0_BUS
    bool "选择I2C0"

choice "              选择I2C0 GPIO"
    default MD_X1000_I2C0_PB
    depends on MD_X1000_I2C0_BUS

config MD_X1000_I2C0_PB
    bool "SCL:GPIO_PB(23) SDA:GPIO_PB(24)"

endchoice

config MD_X1000_I2C0_RATE
    int "       I2C0 速度 "
    default 400000
    depends on MD_X1000_I2C0_BUS



config MD_X1000_I2C1_BUS
    bool "选择I2C1"

choice "              选择I2C1 GPIO"
    default MD_X1000_I2C1_PA
    depends on MD_X1000_I2C1_BUS

config MD_X1000_I2C1_PA
    bool "SCL:GPIO_PA(0) SDA:GPIO_PA(1)"

config MD_X1000_I2C1_PC
    bool "SCL:GPIO_PC(26) SDA:GPIO_PC(27)"

endchoice

config MD_X1000_I2C1_RATE
    int "        I2C1 速度 "
    default 400000
    depends on MD_X1000_I2C1_BUS



config MD_X1000_I2C2_BUS
    bool "选择I2C2"

choice "              选择I2C2 GPIO"
    default MD_X1000_I2C2_PD
    depends on MD_X1000_I2C2_BUS

config MD_X1000_I2C2_PD
    bool "SCL:GPIO_PD(0) SDA:GPIO_PD(1)"

endchoice

config MD_X1000_I2C2_RATE
    int "       I2C2 速度 "
    default 400000
    depends on MD_X1000_I2C2_BUS

endmenu
```

## module_driver/package/soc/x1000/icodec/Config.in
```kconfig
menuconfig MD_X1000_ICODEC
    bool "icodec(内部codec)"
    select MD_X1000_AIC

config MD_X1000_ICODEC_BAIS_ON
    bool "开启偏置电压"
    default n
    help
        对于外接的模拟mic,内部codec需要提前打开偏置电压
        对于回采电路，则不需要打开偏置电压

config MD_X1000_ICODEC_SPK_GPIO
    string "功放引脚"
    choice from SOC_GPIO_PINS
    default -1

config MD_X1000_ICODEC_MAX_HPOUT_VAL
    int "外放音量最大值(对应寄存器GCR_DACL的[0,4],可填范围是0到31)"
    default 31
    help
        其中0代表-31dB，26代表5dB,31代表0dB.增加1，音量增加1.0dB

config MD_X1000_ICODEC_MIN_HPOUT_VAL
    int "外放音量最小值(对应寄存器GCR_ADCL的[0,4],可填范围是0到31)"
    default 0
    help
        其中0代表-31dB，26代表5dB,31代表0dB.增加1，音量增加1.0dB

endmenu
```
