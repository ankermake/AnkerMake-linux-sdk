## module_driver/package/devices/touchscreen/focaltech_touch/Config.in
```kconfig
menuconfig MD_TOUCHSCREEN_FTS
    bool "Focaltech Touchscreen"

config MD_FTS_I2C_BUSNUM
    int "i2c bus num(触摸屏挂接的i2c总线号)"
    default -1

config MD_FTS_X_COORDS_MIN
    int "最小X轴坐标值"
    default 0

config MD_FTS_Y_COORDS_MIN
    int "最小Y轴坐标值"
    default 0

config MD_FTS_X_COORDS_MAX
    int "最大X轴坐标值"
    default 1080

config MD_FTS_Y_COORDS_MAX
    int "最大X轴坐标值"
    default 1920

config MD_FTS_X_COORDS_FLIP
    bool "X轴是否翻转"
    default n

config MD_FTS_Y_COORDS_FLIP
    bool "Y轴是否翻转"
    default n

config MD_FTS_X_Y_COORDS_EXCHANGE
    bool "X,Y轴是否对调"
    default n

config MD_FTS_RESET_GPIO
    string "gpio reset(touchscreen 复位脚)"
    choice from SOC_GPIO_PINS

config MD_FTS_IRQ_GPIO
    string "gpio irq(touchscreen 中断引脚)"
    choice from SOC_GPIO_PINS


config MD_FTS_MAX_TOUCH_NUMBER
    int "能检测的最大触摸点个数(最大为10,最小为2，小于2计为2,大于10计为10)"
    default 2

menuconfig MD_FTS_HAVE_KEY
    bool "使用虚拟按键"
    default n

config MD_FTS_KEY_NUMBER
    int "key 的个数"

config MD_FTS_KEY0_CODE
    int "key0 的键码"

config MD_FTS_KEY0_X_COORDS
    int "key0 x轴坐标"

config MD_FTS_KEY0_Y_COORDS
    int "key0 y轴坐标"

config MD_FTS_KEY1_CODE
    int "key1 的键码"

config MD_FTS_KEY1_X_COORDS
    int "key1 x轴坐标"

config MD_FTS_KEY1_Y_COORDS
    int "key1 y轴坐标"

config MD_FTS_KEY2_CODE
    int "key2 的键码"

config MD_FTS_KEY2_X_COORDS
    int "key2 x轴坐标"

config MD_FTS_KEY2_Y_COORDS
    int "key2 y轴坐标"

config MD_FTS_KEY3_CODE
    int "key3 的键码"

config MD_FTS_KEY3_X_COORDS
    int "key3 x轴坐标"

config MD_FTS_KEY3_Y_COORDS
    int "key3 y轴坐标"

endmenu

endmenu
```

## module_driver/package/devices/touchscreen/ft6236_touch/Config.in
```kconfig
menuconfig MD_TOUCHSCREEN_FT6236
    bool "ft6236_touch"

config MD_FT6236_DEV_NAME
    string "触摸屏设备名称"
    default "ft6236"

config MD_FT6236_REGULATOR_NAME
    string "regulator name(通过名字获取 tp module 电源管理器)"
    default "GPIO-POWER0"

config MD_FT6236_GPIO_POWER
    string "gpio power(ft6236 电源控制引脚)"
    choice from SOC_GPIO_PINS
    default -1

config MD_FT6236_GPIO_RESET
    string "gpio reset(ft6236 复位脚)"
    choice from SOC_GPIO_PINS
    default -1

config MD_FT6236_GPIO_INT
    string "gpio int(ft6236 中断脚)"
    choice from SOC_GPIO_PINS
    default -1

config MD_FT6236_I2C_BUSNUM
    int "i2c bus num (ft6236 挂接的i2c总线号)"
    default -1

config MD_FT6236_MAX_TOUCH_NUMBER
    int "能检测的最大触摸点个数(最大为2,最小为1，大于2计为2)"
    default 2

config MD_FT6236_X_COORDS_MAX
    int "最大X轴坐标值"
    default 480

config MD_FT6236_Y_COORDS_MAX
    int "最大Y轴坐标值"
    default 320

config MD_FT6236_X_COORDS_FLIP
    bool "X轴是否翻转"
    default n

config MD_FT6236_Y_COORDS_FLIP
    bool "Y轴是否翻转"
    default n

config MD_FT6236_X_Y_COORDS_EXCHANGE
    bool "X,Y轴是否对调"
    default n

endmenu
```

## module_driver/package/devices/touchscreen/gt9xx_touch/Config.in
```kconfig
array GT9XX_SERIES
    int "GT9XX系列"
    item "V1 (x2000-darwin-600*1024) " 0x1
    item "V2 (x2000-halley5-720*1280) " 0x2
    item "V2 (x2000-ilock-720*1280) " 0x2
    item "V2 (x2100-kale-720*1280) " 0x2
    item "V3 (x1600-halley6-480*800) " 0x3

menuconfig MD_TOUCHSCREEN_GT9XX
    bool "gt9xx_touch"

config MD_GTP_VERSION
    string "GT9XX系列供应商版本"
    choice from GT9XX_SERIES
    default 0x1

config MD_GTP_REGULATOR_NAME
    string "regulator name(通过名字获取 tp module 电源管理器)"
    default -1

config MD_GTP_POWER_EN_GPIO
    string "gpio power(lcd power使能引脚)"
    choice from SOC_GPIO_PINS
    default -1

config MD_GTP_RESET_GPIO
    string "gpio reset(touchscreen 复位脚)"
    choice from SOC_GPIO_PINS

config MD_GTP_IRQ_GPIO
    string "gpio irq(touchscreen 中断引脚)"
    choice from SOC_GPIO_PINS

config MD_GTP_MAX_TOUCH_NUMBER
    int "能检测的最大触摸点个数(最大为10,最小为2，小于2计为2,大于10计为10)"
    default 2

config MD_GTP_I2C_BUSNUM
    int "i2c bus num(触摸屏挂接的i2c总线号)"
    default -1

config MD_GTP_X_COORDS_MIN
    int "最小X轴坐标值"
    default 0

config MD_GTP_Y_COORDS_MIN
    int "最小Y轴坐标值"
    default 0

config MD_GTP_X_COORDS_MAX
    int "最大X轴坐标值"
    default 600

config MD_GTP_Y_COORDS_MAX
    int "最大Y轴坐标值"
    default 1024

config MD_GTP_X_COORDS_FLIP
    bool "X轴是否翻转"
    default n

config MD_GTP_Y_COORDS_FLIP
    bool "Y轴是否翻转"
    default n

config MD_GTP_X_Y_COORDS_EXCHANGE
    bool "X,Y轴是否对调"
    default n

endmenu
```

## module_driver/package/devices/wireless/Config.in
```kconfig
menu "bt,wifi...无线设备"

source package/devices/wireless/bcmdhd_1.363.125.7/Config.in

source package/devices/wireless/bcmdhd_1.363.125.19_infineon/Config.in

source package/devices/wireless/bcmdhd/Config.in

source package/devices/wireless/bcmdhd_1.363.59.144/Config.in

source package/devices/wireless/rtl8723DS_WiFi_linux_v5.10/Config.in

source package/devices/wireless/rtl8189FS_linux_v5.7.10/Config.in

source package/devices/wireless/hi3861v031_linux/Config.in

source package/devices/wireless/esp8089_linux/Config.in

source package/devices/wireless/ssv6x5x_linux/Config.in

endmenu
```

## module_driver/package/devices/wireless/bcmdhd/Config.in
```kconfig
menuconfig MD_BCMDHD
	bool "Broadcom FullMAC(bcm4345c5) wireless cards support"
	help
	    This module adds support for wireless adapters based on
	    Broadcom FullMAC chipset.

config MD_BCMDHD_SET_MAC_ENABLE
    bool "使能设置mac地址"
    default y

config MD_BCMDHD_SDIO
	bool "SDIO bus interface support"
	default y

config MD_BCMDHD_MMC_NUM
	int "wlan_mmc_num (mmc/sdio 总线号)"
	default -1
	help
	    wifi 挂接在哪个 mmc 总线,比如 0, 1

config MD_BCMDHD_BT_WIFI_POWER
	string "gpio_bt_wifi_power(控制控制整个bt,wifi模块的供电)"
	default -1
	choice from SOC_GPIO_PINS

config MD_BCMDHD_WLAN_REG_ON
	string "gpio_wlan_reg_on(wifi的使能引脚)"
	default -1
	choice from SOC_GPIO_PINS

config MD_BCMDHD_WLAN_WAKE_HOST
	string "gpio_wlan_wake_host(wifi 唤醒/中断 cpu 的引脚)"
	default -1
	choice from SOC_GPIO_PINS

config MD_BCMDHD_BT_REG_ON
	string "gpio_bt_reg_on(bt的使能引脚)"
	default -1
	choice from SOC_GPIO_PINS

config MD_BCMDHD_HOST_WAKE_BT
	string "gpio_host_wake_bt(cpu 唤醒/中断 bt 的引脚)"
	default -1
	choice from SOC_GPIO_PINS

config MD_BCMDHD_BT_WAKE_HOST
	string "gpio_bt_wake_host(bt 唤醒/中断 cpu 的引脚)"
	default -1
	choice from SOC_GPIO_PINS

config MD_BCMDHD_FW_PATH
	string "Firmware path"
	default "/lib/firmware/wifi_bcm/fw_bcm43456c5_ag.bin"
	help
	    Path to the firmware file.

config MD_BCMDHD_NVRAM_PATH
	string "NVRAM path"
	default "/lib/firmware/wifi_bcm/nvram_ap6256.txt"
	help
	    Path to the calibration file.

endmenu
```

## module_driver/package/devices/wireless/bcmdhd_1.363.125.19_infineon/Config.in
```kconfig
menuconfig MD_BCMDHD_1_363_125_19
	bool "Cypress Module AW-NB197SM new(43438) wireless cards support"
	help
	  This module adds support for wireless adapters based on
	  Cypress AW-NB197SM(43438) chipset.

config MD_BCMDHD_1_363_125_19_SDIO
	bool "SDIO bus interface support"
	default y

config MD_BCMDHD_1_363_125_19_MMC_NUM
	int "wlan_mmc_num (mmc/sdio 总线号)"
	default -1
	help
	  wifi 挂接在哪个 mmc 总线,比如 0, 1

config MD_BCMDHD_1_363_125_19_BT_WIFI_POWER
	string "gpio_bt_wifi_power(控制整个bt,wifi模块的供电)"
	default -1
	choice from SOC_GPIO_PINS

config MD_BCMDHD_1_363_125_19_BT_WIFI_POWER_VALID_LEVEL
	string "gpio_bt_wifi_power_valid_level(bt,wifi模块供电引脚的有效电平)"
	default 0
	choice from MD_GPIO_ACTIVE_LEVEL

config MD_BCMDHD_1_363_125_19_WLAN_REG_ON
	string "gpio_wlan_reg_on(wifi的使能引脚)"
	default -1
	choice from SOC_GPIO_PINS

config MD_BCMDHD_1_363_125_19_WLAN_WAKE_HOST
	string "gpio_wlan_wake_host(wifi 唤醒/中断 cpu 的引脚)"
	default -1
	choice from SOC_GPIO_PINS

config MD_BCMDHD_1_363_125_19_BT_REG_ON
	string "gpio_bt_reg_on(bt的使能引脚)"
	default -1
	choice from SOC_GPIO_PINS

config MD_BCMDHD_1_363_125_19_HOST_WAKE_BT
	string "gpio_host_wake_bt(cpu 唤醒/中断 bt 的引脚)"
	default -1
	choice from SOC_GPIO_PINS

config MD_BCMDHD_1_363_125_19_BT_WAKE_HOST
	string "gpio_bt_wake_host(bt 唤醒/中断 cpu 的引脚)"
	default -1
	choice from SOC_GPIO_PINS

config MD_BCMDHD_1_363_125_19_FW_PATH
	string "Firmware path"
	default "/lib/firmware/wifi_bcm/cyw43438-7.46.58.13.bin"
	help
	  Path to the firmware file.

config MD_BCMDHD_1_363_125_19_NVRAM_PATH
	string "NVRAM path"
	default "/lib/firmware/wifi_bcm/nvram_azw372.txt"
	help
	  Path to the calibration file.

endmenu
```

## module_driver/package/devices/wireless/bcmdhd_1.363.125.7/Config.in
```kconfig
menuconfig MD_BCMDHD_1_363_125_7
	bool "Cypress Module AW-NB197SM(43438) wireless cards support"
	help
	  This module adds support for wireless adapters based on
	  Cypress AW-NB197SM(43438) chipset.

config MD_BCMDHD_1_363_125_7_SDIO
	bool "SDIO bus interface support"
	default y

config MD_BCMDHD_1_363_125_7_MMC_NUM
	int "wlan_mmc_num (mmc/sdio 总线号)"
	default -1
	help
	  wifi 挂接在哪个 mmc 总线,比如 0, 1

config MD_BCMDHD_1_363_125_7_BT_WIFI_POWER
	string "gpio_bt_wifi_power(控制整个bt,wifi模块的供电)"
	default -1
	choice from SOC_GPIO_PINS

config MD_BCMDHD_1_363_125_7_BT_WIFI_POWER_VALID_LEVEL
	string "gpio_bt_wifi_power_valid_level(bt,wifi模块供电引脚的有效电平)"
	default 0
	choice from MD_GPIO_ACTIVE_LEVEL

config MD_BCMDHD_1_363_125_7_WLAN_REG_ON
	string "gpio_wlan_reg_on(wifi的使能引脚)"
	default -1
	choice from SOC_GPIO_PINS

config MD_BCMDHD_1_363_125_7_WLAN_WAKE_HOST
	string "gpio_wlan_wake_host(wifi 唤醒/中断 cpu 的引脚)"
	default -1
	choice from SOC_GPIO_PINS

config MD_BCMDHD_1_363_125_7_BT_REG_ON
	string "gpio_bt_reg_on(bt的使能引脚)"
	default -1
	choice from SOC_GPIO_PINS

config MD_BCMDHD_1_363_125_7_HOST_WAKE_BT
	string "gpio_host_wake_bt(cpu 唤醒/中断 bt 的引脚)"
	default -1
	choice from SOC_GPIO_PINS

config MD_BCMDHD_1_363_125_7_BT_WAKE_HOST
	string "gpio_bt_wake_host(bt 唤醒/中断 cpu 的引脚)"
	default -1
	choice from SOC_GPIO_PINS

config MD_BCMDHD_1_363_125_7_FW_PATH
	string "Firmware path"
	default "/lib/firmware/wifi_bcm/fw_bcm43438a1.bin"
	help
	  Path to the firmware file.

config MD_BCMDHD_1_363_125_7_NVRAM_PATH
	string "NVRAM path"
	default "/lib/firmware/wifi_bcm/BCM43438_A1.cal"
	help
	  Path to the calibration file.

config MD_BCM4354
	bool "BCM4354 support"

config MD_BCM4356
	bool "BCM4356 support"

config MD_BCMDHD_1_363_125_7_WEXT
	bool "Enable WEXT support"
	help
	  Enables WEXT support

config MD_DHD_USE_STATIC_BUF
	bool "Enable memory preallocation"
	default n
	help
	  Use memory preallocated in platform

config MD_DHD_USE_SCHED_SCAN
	bool "Use CFG80211 sched scan"
	default n
	help
	  Use CFG80211 sched scan

config MD_DHD_SET_RANDOM_MAC_VAL
	int "Vendor OUI"
	default 0x001A11
	help
	  Set vendor OUI for SoftAP

endmenu
```

## module_driver/package/devices/wireless/bcmdhd_1.363.59.144/Config.in
```kconfig
menuconfig MD_BCMDHD_1_363_59_144
	bool "bcmdhd_1.363.59.144(bcm43362) wireless cards support"

config MD_BCMDHD_1_363_59_144_SDIO
	bool "SDIO bus interface support"
	default y

config MD_BCMDHD_1_363_59_144_MMC_NUM
	int "wlan_mmc_num (mmc/sdio 总线号)"
	default -1
	help
	    wifi 挂接在哪个 mmc 总线,比如 0, 1

config MD_BCMDHD_1_363_59_144_BT_WIFI_POWER
	string "gpio_bt_wifi_power(控制整个bt,wifi模块的供电)"
	default -1
	choice from SOC_GPIO_PINS

config MD_BCMDHD_1_363_59_144_BT_WIFI_POWER_VALID_LEVEL
	string "gpio_bt_wifi_power_valid_level(bt,wifi模块供电引脚的有效电平)"
	default 0
	choice from MD_GPIO_ACTIVE_LEVEL

config MD_BCMDHD_1_363_59_144_WLAN_REG_ON
	string "gpio_wlan_reg_on(wifi的使能引脚)"
	default -1
	choice from SOC_GPIO_PINS

config MD_BCMDHD_1_363_59_144_WLAN_WAKE_HOST
	string "gpio_wlan_wake_host(wifi 唤醒/中断 cpu 的引脚)"
	default -1
	choice from SOC_GPIO_PINS

config MD_BCMDHD_1_363_59_144_BT_REG_ON
	string "gpio_bt_reg_on(bt的使能引脚)"
	default -1
	choice from SOC_GPIO_PINS

config MD_BCMDHD_1_363_59_144_HOST_WAKE_BT
	string "gpio_host_wake_bt(cpu 唤醒/中断 bt 的引脚)"
	default -1
	choice from SOC_GPIO_PINS

config MD_BCMDHD_1_363_59_144_BT_WAKE_HOST
	string "gpio_bt_wake_host(bt 唤醒/中断 cpu 的引脚)"
	default -1
	choice from SOC_GPIO_PINS

config MD_BCMDHD_1_363_59_144_FW_PATH
	string "Firmware path"
	default "/lib/firmware/wifi_bcm/fw_bcm40181a2.bin"
	help
	    Path to the firmware file.

config MD_BCMDHD_1_363_59_144_NVRAM_PATH
	string "NVRAM path"
	default "/lib/firmware/wifi_bcm/nvram_ap6181.txt"
	help
	    Path to the calibration file.

endmenu
```

## module_driver/package/devices/wireless/esp8089_linux/Config.in
```kconfig
menuconfig MD_ESP8089
    bool "ESP8089 wireless cards support"

config MD_ESP8089_MMC_NUM
    int "wlan_mmc_num (mmc/sdio 总线号)"
    default -1
    help
      wifi 挂接在哪个 mmc 总线,比如 0, 1

config MD_ESP8089_WLAN_REG_ON
    string "gpio_wlan_reg_on(wifi的使能引脚)"
    default -1
    choice from SOC_GPIO_PINS

endmenu
```

## module_driver/package/devices/wireless/hi3861v031_linux/Config.in
```kconfig
menuconfig MD_HI3861
	bool "HI3861 wireless cards support"

config MD_HI3861_MMC_NUM
	int "wlan_mmc_num (mmc/sdio 总线号)"
	default -1
	help
	  wifi 挂接在哪个 mmc 总线,比如 0, 1

config MD_HI3861_WIFI_INT
	string "gpio_wifi_int(控制wifi的中断)"
	default -1
	choice from SOC_GPIO_PINS

config MD_HI3861_WIFI_POWER_ON
	string "gpio_wifi_power_on(控制wifi的供电)"
	default -1
	choice from SOC_GPIO_PINS

config MD_HI3861_WIFI_POWER_EN
	string "gpio_wifi_power_en(用于控制整个模块的供电)"
	default -1
	choice from SOC_GPIO_PINS

endmenu
```
