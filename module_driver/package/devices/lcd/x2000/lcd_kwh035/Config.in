## module_driver/package/devices/lcd/x2000/lcd_kwh035/Config.in
```kconfig
menuconfig MD_X2000_LCD_KWH035
    bool "SLCD KWH035 (320x480) (X2000)"
    select MD_X2000_FB
    depends on MD_SOC_X2000_BASE

config MD_X2000_KWH035_CS
    string "gpio chip select(lcd 片选引脚)"
    choice from SOC_GPIO_PINS
    default -1

config MD_X2000_KWH035_RD
    string "gpio lcd read signal(lcd 读引脚)"
    choice from SOC_GPIO_PINS
    default -1

config MD_X2000_KWH035_RST
    string "gpio reset(lcd 复位引脚)"
    choice from SOC_GPIO_PINS
    default -1

config MD_X2000_KWH035_POWER_EN
    string "gpio power enable(lcd power使能引脚)"
    choice from SOC_GPIO_PINS
    default -1

endmenu # MD_X2000_LCD_KWH035
```

## module_driver/package/devices/lcd/x2000/lcd_m1700/Config.in
```kconfig
menuconfig MD_X2000_LCD_M1700
    bool "TFT M1700 (640x480) (X2000)"
    select MD_X2000_FB
    depends on MD_SOC_X2000_BASE

config MD_X2000_M1700_RST
    string "gpio reset(lcd 复位引脚)"
    choice from SOC_GPIO_PINS
    default -1

config MD_X2000_M1700_POWER_EN
    string "gpio power enable(lcd power使能引脚)"
    choice from SOC_GPIO_PINS
    default -1

config MD_X2000_M1700_SPI_SCL
    string "spi clk(时钟引脚)"
    choice from SOC_GPIO_PINS
    default -1

config MD_X2000_M1700_SPI_SDA
    string "spi sda(mosi 输出引脚)"
    choice from SOC_GPIO_PINS
    default -1

config MD_X2000_M1700_SPI_CS
    string "spi cs(片选脚)"
    choice from SOC_GPIO_PINS
    default -1

endmenu # MD_X2000_LCD_M1700
```

## module_driver/package/devices/lcd/x2000/lcd_ma0060/Config.in
```kconfig
menuconfig MD_X2000_LCD_MA0060
    bool "SLCD MA0060 (720x1280) (X2000) (mipi接口)"
    select MD_X2000_FB
    depends on MD_SOC_X2000_BASE

config MD_X2000_MA0060_BACKLIGHT_EN
    string "gpio backlight enable(lcd backlight背光使能)"
    choice from SOC_GPIO_PINS
    default -1

config MD_X2000_MA0060_RST
    string "gpio reset(lcd 复位引脚)"
    choice from SOC_GPIO_PINS
    default -1

config MD_X2000_MA0060_POWER_EN
    string "gpio power enable(lcd power使能引脚)"
    choice from SOC_GPIO_PINS
    default -1

config MD_X2000_MA0060_POWER_VALID
    string "power valid(lcd power 有效电平引脚)"
    choice from POWER_VALID_LEVELS
    default 0

endmenu # MD_X2000_LCD_MA0060

array POWER_VALID_LEVELS
    int "power 活跃电平"
    item "power_valid_low" 0
    item "power_valid_high" 1
```

## module_driver/package/devices/lcd/x2000/lcd_s6d04d1/Config.in
```kconfig
menuconfig MD_X2000_LCD_S6D04D1
    bool "SLCD S6D04D1 (240x400) (X2000)"
    select MD_X2000_FB
    depends on MD_SOC_X2000_BASE

config MD_X2000_S6D04D1_CS
    string "gpio chip select(lcd 片选引脚)"
    choice from SOC_GPIO_PINS
    default -1

config MD_X2000_S6D04D1_RST
    string "gpio reset(lcd 复位引脚)"
    choice from SOC_GPIO_PINS
    default -1

config MD_X2000_S6D04D1_POWER_EN
    string "gpio power enable(lcd power使能引脚)"
    choice from SOC_GPIO_PINS
    default -1

endmenu # MD_X2000_LCD_S6D04D1
```

## module_driver/package/devices/lcd/x2000/lcd_st7701s/Config.in
```kconfig
menuconfig MD_X2000_LCD_ST7701S
    bool "SLCD ST7701S (480 x 800) (X2000)"
    select MD_X2000_FB
    depends on MD_SOC_X2000_BASE

config MD_X2000_ST7701S_TE
    string "gpio TE select"
    choice from SOC_GPIO_PINS
    default -1

config MD_X2000_ST7701S_RST
    string "gpio reset(lcd 复位引脚)"
    choice from SOC_GPIO_PINS
    default -1

config MD_X2000_ST7701S_POWER_EN
    string "gpio power enable(lcd power使能引脚 不设置则使用regulator) "
    choice from SOC_GPIO_PINS
    default -1

config MD_X2000_ST7701S_REGULATOR_NAME
    string "regulator name(通过名字获取 lcd module 电源管理器)"
    default -1

config MD_X2000_ST7701S_LCD_BACKLIGHT_ENABLE
    string "gpio backlight enable(lcd backlight背光使能)(lcd 读引脚)"
    choice from SOC_GPIO_PINS
    default -1

endmenu # MD_X2000_LCD_ST7701S
```

## module_driver/package/devices/lcd/x2000/lcd_st7785m/Config.in
```kconfig
menuconfig MD_X2000_LCD_ST7785M
    bool "TFT ST7785M (240x320) (X2000)"
    select MD_X2000_FB
    depends on MD_SOC_X2000_BASE

config MD_X2000_LCD_REGULATOR_NAME
    string "regulator name(通过名字获取 lcd module 电源管理器)"
    default -1

config MD_X2000_ST7785M_RST
    string "gpio reset(lcd 复位引脚)"
    choice from SOC_GPIO_PINS
    default -1

config MD_X2000_ST7785M_POWER_EN
    string "gpio power enable(lcd power使能引脚)"
    choice from SOC_GPIO_PINS
    default -1

endmenu # MD_X2000_LCD_ST7785M
```

## module_driver/package/devices/lcd/x2000/lcd_st7789/Config.in
```kconfig
menuconfig MD_X2000_LCD_ST7789
    bool "SLCD ST7789 (170x320) (X2000)"
    select MD_X2000_FB
    depends on MD_SOC_X2000_BASE

config MD_X2000_LCD_REGULATOR_NAME
    string "regulator name(通过名字获取 lcd module 电源管理器)"
    default -1

config MD_X2000_ST7789_CS
    string "gpio chip select(lcd 片选引脚)"
    choice from SOC_GPIO_PINS
    default -1

config MD_X2000_ST7789_RD
    string "gpio lcd read signal(lcd 读引脚)"
    choice from SOC_GPIO_PINS
    default -1

config MD_X2000_ST7789_RST
    string "gpio reset(lcd 复位引脚)"
    choice from SOC_GPIO_PINS
    default -1

config MD_X2000_ST7789_POWER_EN
    string "gpio power enable(lcd power使能引脚)"
    choice from SOC_GPIO_PINS
    default -1

endmenu # MD_X2000_LCD_ST7789
```

## module_driver/package/devices/other/pwm_battery/Config.in
```kconfig
menuconfig MD_PWM_BATTERY
    bool "pwm检测电压"

config MD_PWM_BATTERY_PWM_GPIO
    string "pwm输入引脚"
    choice from SOC_GPIO_PINS
    default -1

config MD_PWM_BATTERY_STATUS_GPIO
    string "状态引脚"
    choice from SOC_GPIO_PINS
    default -1

config MD_PWM_BATTERY_STATUS_GPIO_ACTIVE
    int "状态引脚的使能电平"
    default 0

config MD_PWM_BATTERY_POWER_GPIO
    string "电源引脚"
    choice from SOC_GPIO_PINS
    default -1

config MD_PWM_BATTERY_POWER_GPIO_ACTIVE
    int "电源引脚的使能电平"
    default 0

config MD_PWM_BATTERY_PWM_MAX_LEVEL
    int "pwm最大级数"
    default 170

config MD_PWM_BATTERY_PWM_MAX_VOLTAGE
    int "pwm最大电压"
    default 0

config MD_PWM_BATTERY_RES1_VALUE
    int "分压电阻1（请按照实际电阻填写，单位：kΩ）"

config MD_PWM_BATTERY_RES2_VALUE
    int "分压电阻2（请按照实际电阻填写，单位：kΩ）"

config MD_PWM_BATTERY_DEVIATION
    int "翻转误差(mv)"

endmenu
```

## module_driver/package/devices/pmu/axp-216/Config.in
```kconfig
array MD_X2000_BOOT_STATUS
    string "启动时状态"
    item "启动时使能" enable
    item "启动时失能" disable

menuconfig MD_X2000_AXP_POWER
    bool "AXP 216"

config MD_X2000_AXP216_INT_GPIO
    string "pmu interrupt gpio(电源管理外设设置中断脚)"
    choice from SOC_GPIO_PINS
    default -1

config MD_X2000_AXP216_I2C_BUSNUM
    int "pmu i2c bus num (电源管理外设挂接的i2c总线号)"
    default -1

menu "RTCLDO 配置"

config MD_X2000_AXP216_RTCLDO_NAME
    string "rtcldo_name"
    default RTCLDO

config MD_X2000_AXP216_RTCLDO_BOOTON
    string "rtcldo_boot_status (启动时是否使能)"
    choice from MD_X2000_BOOT_STATUS
    default enable

config MD_X2000_AXP216_RTCLDO_WORK_VOLTAGE
    int "rtcldo_work_voltage (工作时电压, 单位：uV)"
    default 3000000

config MD_X2000_AXP216_RTCLDO_SUSPEND_VOLTAGE
    int "rtcldo_suspend_voltage (休眠时电压, 单位：uV)"
    default 3000000

endmenu


menu "ALDO1 配置"

config MD_X2000_AXP216_ALDO1_NAME
    string "aldo1_name"
    default ALDO1

config MD_X2000_AXP216_ALDO1_BOOTON
    string "aldo1_boot_status (启动时是否使能)"
    choice from MD_X2000_BOOT_STATUS
    default enable

config MD_X2000_AXP216_ALDO1_WORK_VOLTAGE
    int "aldo1_work_voltage (工作时电压, 单位：uV)"
    default 2800000

config MD_X2000_AXP216_ALDO1_SUSPEND_VOLTAGE
    int "aldo1_suspend_voltage (休眠时电压, 单位：uV)"
    default 2800000

endmenu

menu "ALDO2 配置"

config MD_X2000_AXP216_ALDO2_NAME
    string "aldo2_name"
    default ALDO2

config MD_X2000_AXP216_ALDO2_BOOTON
    string "aldo2_boot_on (启动时是否使能)"
    choice from MD_X2000_BOOT_STATUS
    default enable

config MD_X2000_AXP216_ALDO2_WORK_VOLTAGE
    int "aldo2_work_voltage (工作时电压, 单位：uV)"
    default 3300000

config MD_X2000_AXP216_ALDO2_SUSPEND_VOLTAGE
    int "aldo2_suspend_voltage (休眠时电压, 单位：uV)"
    default 3300000

endmenu

menu "ALDO3 配置"

config MD_X2000_AXP216_ALDO3_NAME
    string "aldo3_name"
    default ALDO3

config MD_X2000_AXP216_ALDO3_BOOTON
    string "aldo3_boot_on (启动时是否使能)"
    choice from MD_X2000_BOOT_STATUS
    default disable

config MD_X2000_AXP216_ALDO3_WORK_VOLTAGE
    int "aldo3_work_voltage (工作时电压, 单位：uV)"
    default 1400000

config MD_X2000_AXP216_ALDO3_SUSPEND_VOLTAGE
    int "aldo3_suspend_voltage (休眠时电压, 单位：uV)"
    default 1400000

endmenu

menu "ELDO1 配置"

config MD_X2000_AXP216_ELDO1_NAME
    string "eldo1_name"
    default ELDO1

config MD_X2000_AXP216_ELDO1_BOOTON
    string "eldo1_boot_on (启动时是否使能)"
    choice from MD_X2000_BOOT_STATUS
    default enable

config MD_X2000_AXP216_ELDO1_WORK_VOLTAGE
    int "eldo1_work_voltage (工作时电压, 单位：uV)"
    default 1800000

config MD_X2000_AXP216_ELDO1_SUSPEND_VOLTAGE
    int "eldo1_suspend_voltage (休眠时电压, 单位：uV)"
    default 1800000

endmenu

menu "ELDO2 配置"

config MD_X2000_AXP216_ELDO2_NAME
    string "eldo2_name"
    default ELDO2

config MD_X2000_AXP216_ELDO2_BOOTON
    string "eldo2_boot_on (启动时是否使能)"
    choice from MD_X2000_BOOT_STATUS
    default enable

config MD_X2000_AXP216_ELDO2_WORK_VOLTAGE
    int "eldo2_work_voltage (工作时电压, 单位：uV)"
    default 1800000

config MD_X2000_AXP216_ELDO2_SUSPEND_VOLTAGE
    int "eldo2_suspend_voltage (休眠时电压, 单位：uV)"
    default 1800000

endmenu

menu "DCDC1 配置"

config MD_X2000_AXP216_DCDC1_NAME
    string "dcdc1_name"
    default DCDC1

config MD_X2000_AXP216_DCDC1_BOOTON
    string "dcdc1_boot_status (启动时是否使能)"
    choice from MD_X2000_BOOT_STATUS
    default enable

config MD_X2000_AXP216_DCDC1_WORK_VOLTAGE
    int "dcdc1_work_voltage (工作时电压, 单位：uV)"
    default 3300000

config MD_X2000_AXP216_DCDC1_SUSPEND_VOLTAGE
    int "dcdc1_suspend_voltage (休眠时电压, 单位：uV)"
    default 3300000

endmenu

menu "DCDC2 配置"

config MD_X2000_AXP216_DCDC2_NAME
    string "dcdc2_name"
    default DCDC2

config MD_X2000_AXP216_DCDC2_BOOTON
    string "dcdc2_boot_status (启动时是否使能)"
    choice from MD_X2000_BOOT_STATUS
    default enable

config MD_X2000_AXP216_DCDC2_WORK_VOLTAGE
    int "dcdc2_work_voltage (工作时电压, 单位：uV)"
    default 1200000

config MD_X2000_AXP216_DCDC2_SUSPEND_VOLTAGE
    int "dcdc2_suspend_voltage (休眠时电压, 单位：uV)"
    default 1200000

endmenu

menu "DCDC3 配置"

config MD_X2000_AXP216_DCDC3_NAME
    string "dcdc3_name"
    default DCDC3

config MD_X2000_AXP216_DCDC3_BOOTON
    string "dcdc3_boot_status (启动时是否使能)"
    choice from MD_X2000_BOOT_STATUS
    default enable

config MD_X2000_AXP216_DCDC3_WORK_VOLTAGE
    int "dcdc3_work_voltage (工作时电压, 单位：uV)"
    default 900000

config MD_X2000_AXP216_DCDC3_SUSPEND_VOLTAGE
    int "dcdc3_suspend_voltage (休眠时电压, 单位：uV)"
    default 900000

endmenu

menu "DCDC4 配置"

config MD_X2000_AXP216_DCDC4_NAME
    string "dcdc4_name"
    default DCDC4

config MD_X2000_AXP216_DCDC4_BOOTON
    string "dcdc4_boot_status (启动时是否使能)"
    choice from MD_X2000_BOOT_STATUS
    default enable

config MD_X2000_AXP216_DCDC4_WORK_VOLTAGE
    int "dcdc4_work_voltage (工作时电压, 单位：uV)"
    default 1540000

config MD_X2000_AXP216_DCDC4_SUSPEND_VOLTAGE
    int "dcdc4_suspend_voltage (休眠时电压, 单位：uV)"
    default 1540000

endmenu

menu "DCDC5 配置"

config MD_X2000_AXP216_DCDC5_NAME
    string "dcdc5_name"
    default DCDC5

config MD_X2000_AXP216_DCDC5_BOOTON
    string "dcdc5_boot_status (启动时是否使能)"
    choice from MD_X2000_BOOT_STATUS
    default enable

config MD_X2000_AXP216_DCDC5_WORK_VOLTAGE
    int "dcdc5_work_voltage (工作时电压, 单位：uV)"
    default 1800000

config MD_X2000_AXP216_DCDC5_SUSPEND_VOLTAGE
    int "dcdc5_suspend_voltage (休眠时电压, 单位：uV)"
    default 1800000

endmenu

menu "GPIOLDO1 配置"

config MD_X2000_AXP216_GPIOLDO1_NAME
    string "gpiolod1_name"
    default GPIOLDO1

config MD_X2000_AXP216_GPIOLDO1_BOOTON
    string "gpioldo1_boot_on (启动时是否使能)"
    choice from MD_X2000_BOOT_STATUS
    default enable

config MD_X2000_AXP216_GPIOLDO1_WORK_VOLTAGE
    int "gpioldo1_work_voltage (工作时电压, 单位：uV)"
    default 3300000

config MD_X2000_AXP216_GPIOLDO1_SUSPEND_VOLTAGE
    int "gpioldo1_suspend_voltage (休眠时电压, 单位：uV)"
    default 3300000
endmenu

endmenu
```

## module_driver/package/devices/regulator/Config.in
```kconfig
menu "设备电源管理"
source /package/devices/regulator/gpio_regulator/Config.in
endmenu
```

## module_driver/package/devices/regulator/gpio_regulator/Config.in
```kconfig
menuconfig MD_X2000_GPIO_REGULATOR
    bool "gpios regulator"

menuconfig MD_X2000_GPIO_REGULATOR0
    bool "regulator0 config"

config MD_X2000_GPIO_REGULATOR0_PIN
    string "regulator0 pin(电源控制引脚)"
    choice from SOC_GPIO_PINS
    default -1

config MD_X2000_GPIO0_ACTIVET_LEVEL
	int "active level (1为高有效)"
	default 1

config MD_X2000_GPIO_REGULATOR0_NAME
	string "regulator0 name"
	default "GPIO-POWER0"

endmenu

menuconfig MD_X2000_GPIO_REGULATOR1
    bool "regulator1 config"

config MD_X2000_GPIO_REGULATOR1_PIN
    string "regulator1 pin(电源控制引脚)"
    choice from SOC_GPIO_PINS
    default -1

config MD_X2000_GPIO1_ACTIVET_LEVEL
	int "active level (1为高有效)"
	default 1

config MD_X2000_GPIO_REGULATOR1_NAME
	string "regulator1 name"
	default "GPIO-POWER1"

endmenu

menuconfig MD_X2000_GPIO_REGULATOR2
    bool "regulator2 config"

config MD_X2000_GPIO_REGULATOR2_PIN
    string "regulator2 pin(电源控制引脚)"
    choice from SOC_GPIO_PINS
    default -1

config MD_X2000_GPIO2_ACTIVET_LEVEL
	int "active level (1为高有效)"
	default 1

config MD_X2000_GPIO_REGULATOR2_NAME
	string "regulator2 name"
	default "GPIO-POWER2"

endmenu

endmenu # MD_X2000_GPIO_REGULATOR
```

## module_driver/package/devices/touchscreen/Config.in
```kconfig
menu "触摸屏设备列表"

source package/devices/touchscreen/focaltech_touch/Config.in

source package/devices/touchscreen/gt9xx_touch/Config.in
source package/devices/touchscreen/cst3xx_touch/Config.in
source package/devices/touchscreen/ft6236_touch/Config.in

endmenu
```

## module_driver/package/devices/touchscreen/cst3xx_touch/Config.in
```kconfig
array CST_I2C_ADDR_LIST
    int "CST 触摸屏设备地址列表"
    item "1" 0x1A
    item "2" 0x55

menuconfig MD_TOUCHSCREEN_CST3XX
    bool "hyn_cst3xx"

config MD_CST_I2C_BUSNUM
    int "i2c bus num(触摸屏挂接的i2c总线号)"
    default -1

config MD_CST_I2C_ADDR
    int "i2c addr(触摸屏设备地址)"
    choice from CST_I2C_ADDR_LIST

config MD_CST_REGULATOR_NAME
    string "regulator name(通过名字获取 tp module 电源管理器)"
    default -1

config MD_CST_I2C_POWER_ENABLE_LEVEL
    string "gpio active level (tp power 使能电平)"
    choice from MD_GPIO_ACTIVE_LEVEL
    default 1

config MD_CST_I2C_POWER_ENABLE_GPIO
    string "gpio power enable(tp power 使能引脚)"
    choice from SOC_GPIO_PINS
    default -1

config MD_CST_RESET_GPIO
    string "gpio reset(touchscreen 复位脚)"
    choice from SOC_GPIO_PINS

config MD_CST_IRQ_GPIO
    string "gpio irq(touchscreen 中断引脚)"
    choice from SOC_GPIO_PINS

config MD_CST_X_COORDS_MIN
    int "最小X轴坐标值"
    default 0

config MD_CST_Y_COORDS_MIN
    int "最小Y轴坐标值"
    default 0

config MD_CST_X_COORDS_MAX
    int "最大X轴坐标值"
    default 170

config MD_CST_Y_COORDS_MAX
    int "最大Y轴坐标值"
    default 320

config MD_CST_X_COORDS_FLIP
    bool "X轴是否翻转"
    default n

config MD_CST_Y_COORDS_FLIP
    bool "Y轴是否翻转"
    default n

config MD_CST_X_Y_COORDS_EXCHANGE
    bool "X,Y轴是否对调"
    default n

config MD_CST_MAX_TOUCH_NUMBER
    int "能检测的最大触摸点个数(最大为10,最小为2，小于2计为2,大于10计为10)"
    default 2

endmenu
```
