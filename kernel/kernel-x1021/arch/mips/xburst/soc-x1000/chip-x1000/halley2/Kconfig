## kernel/kernel-x1021/arch/mips/xburst/soc-x1000/chip-x1000/halley2/Kconfig
```kconfig
choice
prompt "Core Board Version"
depends on PRODUCT_X1000_HALLEY2
default HALLEY2_CORE_V10

config HALLEY2_CORE_V10
bool "halley2 core board v10"
endchoice


choice
prompt "Ext BOARD version"
depends on PRODUCT_X1000_HALLEY2
default BOARD_X1000_HALLEY2_V10

config BOARD_X1000_HALLEY2_V10
bool "board x1000 halley2 v10"
depends on PRODUCT_X1000_HALLEY2

config BOARD_X1000_HALLEY2_V41
bool "board x1000 halley2 v41"
depends on PRODUCT_X1000_HALLEY2

config BOARD_X1000_HALLEY2_COREBOARDTEST
bool "board x1000 halley2 coreboardtest"
depends on PRODUCT_X1000_HALLEY2
endchoice

config BOARD_NAME
string
default "halley2_v10" if BOARD_X1000_HALLEY2_V10
default "halley2_v41" if BOARD_X1000_HALLEY2_V41
default "halley2_coreboardtest" if BOARD_X1000_HALLEY2_COREBOARDTEST
```

## kernel/kernel-x1021/arch/mips/xburst/soc-x1000/chip-x1500/Kconfig
```kconfig
choice
	prompt "Board type"
	depends on CHIP_X1500
	default PRODUCT_X1500_YAK

config PRODUCT_X1500_YAK
    bool "product x1500 yak"

config PRODUCT_X1500L_WOLF
    bool "product x1500l wolf"

endchoice

if PRODUCT_X1500_YAK
config PRODUCT_NAME
string
default "yak"
source "arch/mips/xburst/soc-x1000/chip-x1500/yak/Kconfig"
endif


if PRODUCT_X1500L_WOLF
config PRODUCT_NAME
string
default "wolf"
source "arch/mips/xburst/soc-x1000/chip-x1500/wolf/Kconfig"
endif
```

## kernel/kernel-x1021/arch/mips/xburst/soc-x1000/chip-x1500/wolf/Kconfig
```kconfig
choice
prompt "Board Version"
depends on PRODUCT_X1500L_WOLF
default BOARD_X1500L_WOLF_V10

config BOARD_X1500L_WOLF_V10
bool "wolf board v10"

endchoice

config BOARD_NAME
string
default "wolf_v10" if BOARD_X1500L_WOLF_V10
```

## kernel/kernel-x1021/arch/mips/xburst/soc-x1021/Kconfig
```kconfig
choice
	prompt "Chip type"
	depends on SOC_X1021
	default CHIP_X1021

config CHIP_X1021
       bool "chip-x1021"
       select TRACEPOINTS
       select SYS_SUPPORTS_HIGHMEM
       select GENERIC_CLOCKEVENTS_BROADCAST

endchoice

if CHIP_X1021
source "arch/mips/xburst/soc-x1021/chip-x1021/Kconfig"
endif
```

## kernel/kernel-x1021/arch/mips/xburst/soc-x1021/chip-x1021/Kconfig
```kconfig
choice
	prompt "Board type"
	depends on CHIP_X1021
	default PRODUCT_X1021_SEPAL

config PRODUCT_X1021_SEPAL
	bool "product x1021 sepal"

endchoice

if PRODUCT_X1021_SEPAL
config PRODUCT_NAME
string
default "sepal"
source "arch/mips/xburst/soc-x1021/chip-x1021/sepal/Kconfig"
endif
```

## kernel/kernel-x1021/arch/mips/xburst/soc-x1021/chip-x1021/sepal/Kconfig
```kconfig
choice
prompt "Board version"
depends on PRODUCT_X1021_SEPAL
default BOARD_X1021_SEPAL_V10

config BOARD_X1021_SEPAL_V10
bool "sepal board v10"

endchoice


config BOARD_NAME
string
default "sepal_v10" if BOARD_X1021_SEPAL_V10
```

## kernel/kernel-x1021/arch/mips/xburst/soc-x1630/chip-x1630/Kconfig
```kconfig
choice
	prompt "Board type"
	depends on CHIP_X1630
	default PRODUCT_X1630_DOLPHIN

config PRODUCT_X1630_DOLPHIN
	bool "product x1630 dolphin"

endchoice

if PRODUCT_X1630_DOLPHIN
config PRODUCT_NAME
string
default "dolphin"
source "arch/mips/xburst/soc-x1630/chip-x1630/dolphin/Kconfig"
endif
```

## kernel/kernel-x1021/arch/mips/xburst/soc-x1630/chip-x1630/dolphin/Kconfig
```kconfig
choice
prompt "Board version"
depends on PRODUCT_X1630_DOLPHIN
default BOARD_X1630_DOLPHIN_V10

config BOARD_X1630_DOLPHIN_V10
bool "dolphin board v10"

endchoice


config BOARD_NAME
string
default "dolphin_v10" if BOARD_X1630_DOLPHIN_V10
```

## kernel/kernel-x1021/drivers/char/jzchar/Kconfig
```kconfig
#
# JzSOC char devices configuration
#

menu "JZSOC char device support(Only for ZKSoftware)"
	depends on SOC_X1021

config JZCHAR
	tristate "JzSOC char device support"
	depends on SOC_X1021

config JZ_CAMERA_SENSOR
	tristate "Select the camera sensor"
	depends on JZCHAR

config JZ_VIC_CORE
	tristate "JZ VIC Camera driver"
	depends on JZCHAR

config CAMERA_GC0308_SUPPORT
	tristate "gc0308 camera support"
	depends on JZCHAR
	help
	  This is a misc camera driver for the gc0308 sensor

config CAMERA_GC0328_SUPPORT
	tristate "gc0328 camera support"
	depends on JZCHAR
	help
	  This is a misc camera driver for the gc0328 sensor

config CAMERA_SC031GS_SUPPORT
	tristate "sc031gs camera support"
	depends on JZCHAR
	help
	  This is a misc camera driver for the sc031gs sensor
endmenu
```

## kernel/kernel-x1021/drivers/misc/jz_factory_test/Kconfig
```kconfig
menuconfig JZ_FACTORY_TEST
	bool "jz factory test"
	default n
	help
		support for ingenic slt test
choice
	prompt "halley2 coreboard factory test choice"
	depends on JZ_FACTORY_TEST
	default  JZ_X1000_HALLEY2_COREBOARD_TEST_V10
config	JZ_X1000_HALLEY2_COREBOARD_TEST_V10
	bool "jz x1000 halley2 coreboard test v10"
endchoice
```

## kernel/kernel-x1021/drivers/net/ethernet/stmicro/stmmac/Kconfig
```kconfig
config STMMAC_ETH
	tristate "STMicroelectronics 1000 Ethernet driver"
	depends on HAS_IOMEM && HAS_DMA
	select NET_CORE
	select MII
	select PHYLIB
	select CRC32
	select PTP_1588_CLOCK
	---help---
	  This is the driver for the Ethernet IPs are built around a
	  Synopsys IP Core and only tested on the STMicroelectronics
	  platforms.

if STMMAC_ETH

config STMMAC_PLATFORM
	bool "STMMAC Platform bus support"
	depends on STMMAC_ETH
	default y
	---help---
	  This selects the platform specific bus support for
	  the stmmac device driver. This is the driver used
	  on many embedded STM platforms based on ARM and SuperH
	  processors.
	  If you have a controller with this interface, say Y or M here.

	  If unsure, say N.

config STMMAC_DEBUG_FS
	bool "Enable monitoring via sysFS "
	default n
	depends on STMMAC_ETH && DEBUG_FS
	---help---
	  The stmmac entry in /sys reports DMA TX/RX rings
	  or (if supported) the HW cap register.

config STMMAC_DA
	bool "STMMAC DMA arbitration scheme"
	default n
	---help---
	  Selecting this option, rx has priority over Tx (only for Giga
	  Ethernet device).
	  By default, the DMA arbitration scheme is based on Round-robin
	  (rx:tx priority is 1:1).

endif
```

## kernel/kernel-x1021/drivers/net/wireless/cypress_module/Kconfig
```kconfig
menuconfig WL_CYPRESS_MODULE
	bool "Cypress Module Wireless LAN support"
	---help---
	  This section contains support for all the wireless drivers
	  for cypress modules, such as AW-NB197SM(43438), AW-NM288SM(43362)
	  and AW-CM256SM (43455).

if WL_CYPRESS_MODULE

source "drivers/net/wireless/cypress_module/bcmdhd_1.363.125.7/Kconfig"
endif #WL_CYPRESS_MODULE
```

## kernel/kernel-x1021/drivers/soc/ingenic/mcu/Kconfig
```kconfig
#
# MCU configuration
#

menuconfig MCUDEVICE
	bool "PDMA MCU support"
	depends on MACH_XBURST
	help
	  MCU in PDMA is a mini CPU compatible with XBurst-1
	  ISA without implementing CACHE, MMU, DEBUG, FPU and
	  MXU. It is very similar as the AUX in VPU but has
	  different memory mapped control and status register.

if MCUDEVICE

comment "MCU Device"

config XBURST_PDMA_MCU
       bool "PDMA MCU support"
       depends on MACH_XBURST
       help
         Support the XBURST PDMA MCU. Now only support the
         SOC_X1000 chip.
endif
```

## kernel/kernel-x1021/drivers/video/jz_fb_v13/Kconfig
```kconfig
# JZ LCD V1.3  configuration

menuconfig FB_JZ_V13
	tristate "JZ LCDC framebuffer V1.3"
	depends on FB
	select FB_CFB_FILLRECT
	select FB_CFB_COPYAREA
	select FB_CFB_IMAGEBLIT
	help
	  Framebuffer support for the M200/T10 SoC.

choice
	depends on FB_JZ_V13
	prompt "set lcd gpio"
	default LCD_GPIO_FUNC0_24BIT

config LCD_V13_SLCD_8BIT
	bool "lcd v13  8bit slcd"
	help
	 set lcd gpio function1 only for 8bit smart panel
		for example,
		for truly_tft240240_2_e panel, set it
config LCD_V13_SLCD_9BIT
	bool "lcd v13 9bit slcd"
	help
	 set lcd gpio function1 only for 9bit smart panel
config LCD_V13_SLCD_16BIT
	bool "lcd v13 16bit slcd"
	help
	 set lcd gpio function1 only for 16bit smart panel
endchoice

choice
	depends on FB_JZ_V13
	prompt "Framebuffer format"
	default LCD_FB_FORMAT_16BIT
config LCD_FB_FORMAT_16BIT
	bool "Support 16bpp framebuffer"
config LCD_FB_FORMAT_24BIT
	bool "Support 24bpp framebuffer"
endchoice

config FB_JZ_DEBUG
        bool "fb test for displaying color bar"
        depends on FB_JZ_V13
        default n
        help
           fb test for displaying color bar in your board.

config SLCDC_LOW_POWER_CONSUMPTION
        bool "Low power consumption mode (experimental)"
        depends on FB_JZ_V13
        default n
        help
	In this mode, will startup the LCD clk and pixel clk only at user operate the frame buffer device.
	This will save 6mW at sigal frame mode, or 24mW at contiune frame mode.
	notice:
	    Because of the clk has been shutdown, the sys node will invalid like read register draw color bar ...
```

## kernel/kernel-x1021/drivers/video/jz_fb_v14/Kconfig
```kconfig
config FB_JZ_V14
	tristate "JZ LCDC framebuffer V1.4"
	depends on FB
	select FB_CFB_FILLRECT
	select FB_CFB_COPYAREA
	select FB_CFB_IMAGEBLIT
	help
	  Framebuffer support for the T30 SoC.

config FB_JZ_DEBUG
	  bool "fb test for displaying color bar"
	  depends on FB_JZ_V14
	  default n
	  help
	  fb test for displaying color bar in your board.
```

## kernel/kernel-x1021/drivers/video/jz_fb_x1021/Kconfig
```kconfig
config FB_JZ_X1021
	tristate "JZ LCDC framebuffer for x1021"
	depends on FB
	select FB_CFB_FILLRECT
	select FB_CFB_COPYAREA
	select FB_CFB_IMAGEBLIT
	help
	  Framebuffer support for the x1021 SoC.
```

## kernel/kernel-x1021/drivers/video/logo-ingenic/Kconfig
```kconfig
menuconfig TRUE_COLOR_LOGO
       bool "True Color Logo for Ingenic"
       default n

config TRUE_COLOR_LOGO_FILE
       string "Logo File"
       depends on TRUE_COLOR_LOGO
       default "drivers/video/logo-ingenic/logo.png"
       help
         set a png type file directory.

config TRUE_COLOR_LOGO_BACKGROUND
       hex "Background Color"
       depends on TRUE_COLOR_LOGO
       default '0x00ffffff'
       help
         set default background color.
```

## kernel/kernel-x2000/Kconfig
```kconfig
#
# For a description of the syntax of this configuration file,
# see Documentation/kbuild/kconfig-language.txt.
#
mainmenu "Linux/$ARCH $KERNELVERSION Kernel Configuration"

config SRCARCH
	string
	option env="SRCARCH"
config OUTSIDE_DRIVERS
	string
	option env="OUTSIDE_DRIVERS"
	default "module_drivers"

config OUTSIDE_BUILD
	string
	option env="OUTSIDE_BUILD"
source "arch/$SRCARCH/Kconfig"
source "$OUTSIDE_DRIVERS/Kconfig"
source "$OUTSIDE_BUILD/Kconfig"
```

## kernel/kernel-x2000/arch/mips/xburst/Kconfig
```kconfig
menuconfig SOC_TYPE
	tristate "SOC type"
	depends on MACH_XBURST
	default y

if SOC_TYPE
choice
	prompt "SOC types"
	depends on MACH_XBURST
	default SOC_X1000

config SOC_X1000
	bool "x1000 socs"
	select INGENIC_INTC
	select CLK_X1000
	select CLKSRC_OF
	select PINCTRL
	select BUILTIN_DTB
	select CLKDEV_LOOKUP
	select PINCTRL_INGENIC
	select CLKSRC_INGENIC_SYS_OST

config SOC_X1800
	bool "x1800 socs"
	select INGENIC_INTC
	select CLK_X1800
	select CLKSRC_OF
	select PINCTRL
	select BUILTIN_DTB
	select CLKDEV_LOOKUP
	select PINCTRL_INGENIC
	select PINCTRL_INGENIC_LEGACY_GPIO
	select CLKSRC_INGENIC_SYS_OST
	select XBURST_MXUV2

config SOC_X1021
	bool "x1021 socs"
	select INGENIC_INTC
	select CLK_X1021
	select CLKSRC_OF
	select PINCTRL
	select BUILTIN_DTB
	select CLKDEV_LOOKUP
	select PINCTRL_INGENIC
	select PINCTRL_INGENIC_LEGACY_GPIO
	select CLKSRC_INGENIC_SYS_OST
	select XBURST_MXUV2

config SOC_X1520
	bool "x1520 socs"
	select INGENIC_INTC
	select CLK_X1520
	select CLKSRC_OF
	select PINCTRL
	select BUILTIN_DTB
	select CLKDEV_LOOKUP
	select PINCTRL_INGENIC
	select PINCTRL_INGENIC_LEGACY_GPIO
	select CLKSRC_INGENIC_SYS_OST
	select XBURST_MXUV2

config SOC_X1630
	bool "x1630 socs"
	select INGENIC_INTC
	select CLK_X1630
	select CLKSRC_OF
	select PINCTRL
	select BUILTIN_DTB
	select CLKDEV_LOOKUP
	select PINCTRL_INGENIC
	select PINCTRL_INGENIC_LEGACY_GPIO
	select CLKSRC_INGENIC_SYS_OST
	select XBURST_MXUV2

config SOC_X1600
	bool "x1600 socs"
	select INGENIC_INTC
	select CLK_X1600
	select CLKSRC_OF
	select PINCTRL
	select BUILTIN_DTB
	select CLKDEV_LOOKUP
	select PINCTRL_INGENIC
	select PINCTRL_INGENIC_LEGACY_GPIO
	select CLKSRC_INGENIC_SYS_OST
	select MMU_NOTIFIER
endchoice


choice
	prompt "device tree select"
	default DT_NONE
config DT_NONE

config DT_XBURST_EXTERNAL_BOARD
	bool "xburst external board."


if SOC_X1000
source "arch/mips/xburst/soc-x1000/Kconfig.DT"
endif
if SOC_X1800
source "arch/mips/xburst/soc-x1800/Kconfig.DT"
endif
if SOC_X1021
source "arch/mips/xburst/soc-x1021/Kconfig.DT"
endif
if SOC_X1520
source "arch/mips/xburst/soc-x1520/Kconfig.DT"
endif
if SOC_X1630
source "arch/mips/xburst/soc-x1630/Kconfig.DT"
endif
if SOC_X1600
source "arch/mips/xburst/soc-x1600/Kconfig.DT"
endif
endchoice

config DT_X1600_MODULE_BASE_DTS_FILE
    string "dts file for x1600 module driver"
    depends on DT_X1600_MODULE_BASE
    default x1600_module_base.dts
    help
        the dts file location is arch/mips/boot/dts/ingenic/

config EXTAL_CLOCK
	depends on MACH_XBURST
	int "extal clock in MHz"
	default 24

config INGENIC_GPT_CHECK
	depends on MACH_XBURST
	bool "The physical space is larger than the virtual space"
	default y

config SUSPEND_TEST
	bool "auto suspend test"
	default n

config SUSPEND_ALARM_TIME
	int "suspend alarm time(second)"
	depends on SUSPEND_TEST
	default 2

config XBURST_MXUV2
	bool
	default n

endif
```

## kernel/kernel-x2000/arch/mips/xburst/soc-x1000/Kconfig.DT
```kconfig
config DT_HALLEY2_V20
	bool "halley2 v20"

config DT_X1500_YAK
	bool "X1500 Yak"
```
