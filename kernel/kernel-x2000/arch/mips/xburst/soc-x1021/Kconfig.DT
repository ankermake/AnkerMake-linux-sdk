## kernel/kernel-x2000/arch/mips/xburst/soc-x1600/Kconfig.DT
```kconfig
config DT_PANDA_V10
	bool "x1600 panda v10"

config DT_HALLEY6_V10
	bool "x1600 halley6 v10"

config DT_HALLEY6_V10_AWTK
	bool "x1600 halley6 v10 awtk"

config DT_X1600_MODULE_BASE
	bool "x1600 base for module drivers"

config DT_X1600_IRIS_V10
	bool "X1600 IRIS v10"
```

## kernel/kernel-x2000/arch/mips/xburst2/Kconfig
```kconfig
if MACH_XBURST2

menu "SOC Type Selection"
	depends on MACH_XBURST2


choice
	prompt "SOC types"
	depends on MACH_XBURST2
	default SOC_X2000

config SOC_X2000
	bool "x2000"
	select IRQ_INGENIC_CPU
	select CLK_X2000
	select INGENIC_INTC_CHIP
	select PINCTRL
	select PINCTRL_INGENIC
	select CLKSRC_OF
	select CLKDEV_LOOKUP
	select CLKSRC_INGENIC_CORE_OST


config SOC_X2000_V12
	bool "x2000-v12"
	select IRQ_INGENIC_CPU
	select CLK_X2000_V12
	select INGENIC_INTC_CHIP
	select PINCTRL
	select PINCTRL_INGENIC
	select CLKSRC_OF
	select CLKDEV_LOOKUP
	select CLKSRC_INGENIC_CORE_OST
	select MMU_NOTIFIER

config SOC_X2100
	bool "x2100"
	select IRQ_INGENIC_CPU
	select CLK_X2100
	select INGENIC_INTC_CHIP
	select PINCTRL
	select PINCTRL_INGENIC
	select CLKSRC_OF
	select CLKDEV_LOOKUP
	select CLKSRC_INGENIC_CORE_OST
	select MMU_NOTIFIER

config SOC_M300
	bool "m300"
	select IRQ_INGENIC_CPU
	select CLK_M300
	select INGENIC_INTC_CHIP
	select PINCTRL
	select PINCTRL_INGENIC
	select CLKSRC_OF
	select CLKDEV_LOOKUP
	select CLKSRC_INGENIC_CORE_OST
	select MMU_NOTIFIER

config SOC_X2500
	bool "x2500"
	select IRQ_INGENIC_CPU
	select CLK_X2500
	select INGENIC_INTC_CHIP
	select PINCTRL
	select PINCTRL_INGENIC
	select CLKSRC_OF
	select CLKDEV_LOOKUP
	select CLKSRC_INGENIC_CORE_OST
	select MMU_NOTIFIER

endchoice

config INGENIC_BUILTIN_DTB
	select BUILTIN_DTB
	depends on MACH_XBURST2
	bool "Ingenic Device Tree build into Kernel."
	default y

choice
	prompt "device tree select"
	default DT_NONE_V12

config DT_NONE_V12
	bool "dt_none_v12"

config DT_EXTERNAL_BOARD
	bool "x2000-v12 external board."

if SOC_X2000
source "arch/mips/xburst2/soc-x2000/Kconfig.DT"
endif

if SOC_X2000_V12
source "arch/mips/xburst2/soc-x2000-v12/Kconfig.DT"
endif

if SOC_X2100
source "arch/mips/xburst2/soc-x2100/Kconfig.DT"
endif

if SOC_M300
source "arch/mips/xburst2/soc-m300/Kconfig.DT"
endif

if SOC_X2500
source "arch/mips/xburst2/soc-x2500/Kconfig.DT"
endif

endchoice

config DT_X2000_MODULE_BASE_DTS_FILE
	string "dts file for x2000 module driver"
	depends on DT_X2000_MODULE_BASE
	default x2000_module_base.dts
	help
		the dts file location is arch/mips/boot/dts/ingenic/

config RAW_BOOT
	bool "Raw Boot Kernel"
	select BOOT_RAW
	default n

config EXTAL_CLOCK
	depends on MACH_XBURST2
	int "extal clock in MHz"
	default 24

config FPGA_TEST
	depends on MACH_XBURST2
	bool "FPGA_TEST"
	default n

config INGENIC_GPT_CHECK
	depends on MACH_XBURST2
	bool "The physical space is larger than the virtual space"
	default y

config XBURST2_CPU_TEST
	depends on MACH_XBURST2
	bool "xburst2 cpu ddr test"
	default n


config FASTBOOT
	bool "FastBoot"

endmenu

endif
```

## kernel/kernel-x2000/arch/mips/xburst2/soc-m300/Kconfig.DT
```kconfig
config DT_GEWU
	bool "m300 gewu"

config DT_M300_ZEBRA
	bool "m300 zebra"

config DT_GEWU_V12
	bool "m300 gewu_v12"
```

## kernel/kernel-x2000/arch/mips/xburst2/soc-x2000-v12/Kconfig.DT
```kconfig
config DT_HALLEY5_V10
	bool "x2000-v12 halley5_v10"

config DT_HALLEY5_V20
	bool "x2000-v12 halley5_v20"

config DT_HALLEY5_V30
	bool "x2000-v12 halley5_v30"

config DT_HALLEY5_V20_QT
	bool "x2000-v12 halley5_v20_qt"

config DT_ZEBRA
	bool "x2000-v12 zebra"

config DT_ZEBRA_ISP
	bool "x2000-v12 zebra with isp camera board."

config DT_ZEBRA_CIM
	bool "x2000-v12 zebra with cim camera board."

config DT_X2000_EVB
	bool "x2000-v12 x2000_evb"

config DT_X2000_MODULE_BASE
	bool "x2000-v12 base for module drivers"

config DT_WICOM_CUSTOMER
	bool "x2000-v12 Wicom Customer platform"

config DT_FULLCOLOR_7INCH
	bool "x2000-v12 Fullcolor 7inch platform"

config DT_ZEBRA_POWER
	bool "x2000-v12 zebra with cim power test."

config DT_WICOM_HALLEY5_PANEL
    bool "x2000-v12 wicom halley5 panel."

config DT_X2000_YIAN_V10
    bool "x2000 yian v10 board"

config DT_LIFESMART_480P
    bool "x2000 liftsmart_86 480p"

config DT_X2000_HUABY
    bool "x2000 huaby panel 1024 x 600"
```

## kernel/kernel-x2000/arch/mips/xburst2/soc-x2100/Kconfig.DT
```kconfig
config DT_KALE
	bool "x2100 kale board."
config DT_ROBAM_CQ925
	bool "x2100 robam cq925 board."
config DT_ROBAM_DB620
	bool "x2100 robam db620 board."
config DT_ROBAM_9YC05
	bool "x2100 robam 9yc05 board."
config DT_HUABY
	bool "x2100 huaby board."
config DT_WICOM_KALE_PANEL
    bool "x2100 wicom kale panel"
config DT_WICOM_KALE_PANEL_KD050
    bool "x2100 wicom kale panel kd050"
```

## kernel/kernel-x2000/arch/mips/xburst2/soc-x2500/Kconfig.DT
```kconfig
config DT_GANDER_V10
	bool "x2500 gander_v10"
config DT_DARWIN_V14
	bool "x2500 darwin_v14"
config DT_HIPPO_V10
	bool "x2500 hippo_v10"
config DT_HIPPO_V12
	bool "x2500 hippo_v12"
config DT_BEAR_V10
	bool "x2500 bear_v10"
```

## kernel/kernel-x2000/drivers/clk/ingenic/Kconfig
```kconfig
config COMMON_CLK_INGENIC
	bool
	depends on MACH_XBURST || MACH_XBURST2
	select MFD_SYSCON
	select COMMON_CLK
	select INGENIC_CLK_DEBUG_FS

config INGENIC_CLK_DEBUG_FS
	bool
	depends on DEBUG_FS
	help
	  enable ingenic common clock debugfs

config CLK_X1000
	bool
	depends on SOC_X1000
	select COMMON_CLK_INGENIC
	help
	  build the ingenic x1000 soc clock driver.

config CLK_X1800
	bool
	depends on SOC_X1800
	select COMMON_CLK_INGENIC
	help
	  build the ingenic x1800 soc clock driver.

config CLK_X1021
	bool
	depends on SOC_X1021
	select COMMON_CLK_INGENIC
	help
	  build the ingenic x1021 soc clock driver.

config CLK_X1520
	bool
	depends on SOC_X1520
	select COMMON_CLK_INGENIC
	help
	  build the ingenic x1520 soc clock driver.

config CLK_X1630
	bool
	depends on SOC_X1630
	select COMMON_CLK_INGENIC
	help
	  build the ingenic x1630 soc clock driver.

config CLK_X2000
	bool
	depends on SOC_X2000
	select COMMON_CLK_INGENIC
	help
	  build the ingenic x2000 soc clock driver.
```

## kernel/kernel-x2000/drivers/gpu/drm/ingenic/Kconfig
```kconfig
menuconfig DRM_INGENIC
	tristate "DRM Support for Ingenic LCDC Display Controller"
	depends on DRM && OF
	select DRM_KMS_HELPER
	select DRM_KMS_FB_HELPER
	select DRM_KMS_CMA_HELPER
	select DRM_GEM_CMA_HELPER
	select DRM_PANEL
	select VIDEOMODE_HELPERS
	select BACKLIGHT_CLASS_DEVICE
	select BACKLIGHT_LCD_SUPPORT
	help
	  Choose this option if you have an Ingenic SoC with LCDC display
	  controller

config DRM_INGENIC_DISPLAYS_V10
	tristate "Ingenic DPU Display Controller"
	depends on DRM_INGENIC
	help
	  Choose this option if you want to use ingenic dpu controller.

config DRM_INGENIC_CMP_CRTC
	tristate "Ingenic Composition Display Controller"
	depends on DRM_INGENIC_DISPLAYS_V10
	help
	  Select Composition Display Controller for 4 layers.

config DRM_INGENIC_SRD_CRTC
	tristate "Ingenic Simple Read Display Controller"
	depends on DRM_INGENIC_DISPLAYS_V10
	help
	  Select Simple Read Display Controller for low consumption.

choice
	prompt "Ingenic drm display interfaces select"
	depends on DRM_INGENIC_DISPLAYS_V10
	default CONFIG_DRM_INGENIC_DISPLAY_INTERFACE_TFT

config DRM_INGENIC_DISPLAY_INTERFACE_TFT
	bool "dpi display interface for tft lcd"
	help
	  Select for tft lcd

config DRM_INGENIC_DISPLAY_INTERFACE_SLCD
	bool "dbi display interface for smart lcd"
	help
	  Select for smart lcd

config DRM_INGENIC_DISPLAY_INTERFACE_MIPI_SLCD
	bool "mipi-dsi display interface for smart lcd"
	help
	  Select for mipi-dsi smart lcd

config DRM_INGENIC_DISPLAY_INTERFACE_MIPI_TFT
	bool "mipi-dsi display interface for tft lcd"
	help
	  Select for mipi-dsi tft lcd
endchoice
source "drivers/gpu/drm/ingenic/panel/Kconfig"
```

## kernel/kernel-x2000/drivers/gpu/drm/ingenic/panel/Kconfig
```kconfig
menuconfig DRM_INGENIC_PANEL
	tristate "Supported lcd panels"
	depends on DRM_INGENIC_DISPLAYS_V10
	select BACKLIGHT_LCD_SUPPORT
	select LCD_CLASS_DEVICE
	select BACKLIGHT_CLASS_DEVICE

config PANEL_V12_Y88249
	tristate "lcd panel y88249"
	depends on DRM_INGENIC_PANEL
	help
		lcd panel y88249, for ingenicfb drivers.

config PANEL_V12_KD050HDFIA019
	tristate "lcd panel kd050hdfia019"
	depends on DRM_INGENIC_PANEL
	help
		lcd panel kd050hdfia019, for ingenicfb drivers.

config PANEL_V12_MA0060
	tristate "lcd panel MA0060"
	depends on DRM_INGENIC_PANEL
	help
		lcd panel MA0060, for ingenicfb drivers.

config PANEL_V12_TL040WVS03CT
	tristate "lcd panel tl040wvs03ct"
	depends on DRM_INGENIC_PANEL
	help
		lcd panel tl040wvs03ct, for ingenicfb drivers.

config PANEL_V12_TL040HDS01CT
	tristate "lcd panel tl040hds01ct"
	depends on DRM_INGENIC_PANEL
	help
		lcd panel tl040hds01ct, for ingenicfb drivers.

config PANEL_V12_JD9161Z
	tristate "lcd panel JD9161Z"
	depends on DRM_INGENIC_PANEL
	help
		lcd panel JD9161Z, for ingenicfb drivers.

config PANEL_V12_YLYM286A
	tristate "lcd panel YLYM286A"
	depends on DRM_INGENIC_PANEL
	help
		lcd panel YLYM286A, for ingenicfb drivers.
```

## kernel/kernel-x2000/drivers/input/touchscreen/gt9xx_touch_v2/Kconfig
```kconfig
#
# Focaltech Touchscreen driver configuration
#

config TOUCHSCREEN_GT9XX_V2
    bool "GT9XX Touchscreen_v2"
    default n
    help
      Say Y here if you have Focaltech touch panel.
      If unsure, say N.

config TOUCHSCREEN_GT9XX_V2_DIRECTORY
    string "gt ts directory name"
    default "gt9xx_touch_v2"
    depends on TOUCHSCREEN_GT9XX_V2
```

## kernel/kernel-x2000/drivers/mmc/core/Kconfig
```kconfig
#
# MMC core configuration
#
comment "MMC Core configuration"

config MMC_CORE_INIT_SEQUENCE_DELAY
    bool "MMC CORE spec init sequence delay"
    default n

config MMC_CORE_INIT_DELAY_TIME_MS
    int "mmc card core spec init delay unit:ms"
    range 0 100
    default 10
    depends on MMC_CORE_INIT_SEQUENCE_DELAY
```

## kernel/kernel-x2000/drivers/usb/dwc2_new/Kconfig
```kconfig
# SPDX-License-Identifier: GPL-2.0

config USB_DWC2_NEW
	tristate "DesignWare USB2 DRD Core Support (NEW)"
	depends on HAS_DMA
	depends on USB || USB_GADGET
	depends on HAS_IOMEM
	select USB_ROLE_SWITCH
	help
	  Say Y here if your system has a Dual Role Hi-Speed USB
	  controller based on the DesignWare HSOTG IP Core.

	  For host mode, if you choose to build the driver as dynamically
	  linked modules, the core module will be called dwc2.ko, the PCI
	  bus interface module (if you have a PCI bus system) will be
	  called dwc2_pci.ko, and the platform interface module (for
	  controllers directly connected to the CPU) will be called
	  dwc2_platform.ko. For all modes(host, gadget and dual-role), there
	  will be an additional module named dwc2.ko.

if USB_DWC2_NEW

choice
	bool "DWC2 Mode Selection"
	default USB_DWC2_NEW_DUAL_ROLE if (USB && USB_GADGET)
	default USB_DWC2_NEW_HOST if (USB && !USB_GADGET)
	default USB_DWC2_NEW_PERIPHERAL if (!USB && USB_GADGET)

config USB_DWC2_NEW_HOST
	bool "Host only mode"
	depends on USB=y || (USB_DWC2_NEW=m && USB)
	help
	  The Designware USB2.0 high-speed host controller
	  integrated into many SoCs. Select this option if you want the
	  driver to operate in Host-only mode.

comment "Gadget/Dual-role mode requires USB Gadget support to be enabled"

config USB_DWC2_NEW_PERIPHERAL
	bool "Gadget only mode"
	depends on USB_GADGET=y || USB_GADGET=USB_DWC2_NEW
	help
	  The Designware USB2.0 high-speed gadget controller
	  integrated into many SoCs. Select this option if you want the
	  driver to operate in Peripheral-only mode. This option requires
	  USB_GADGET to be enabled.

config USB_DWC2_NEW_DUAL_ROLE
	bool "Dual Role mode"
	depends on (USB=y && USB_GADGET=y) || (USB_DWC2_NEW=m && USB && USB_GADGET)
	help
	  Select this option if you want the driver to work in a dual-role
	  mode. In this mode both host and gadget features are enabled, and
	  the role will be determined by the cable that gets plugged-in. This
	  option requires USB_GADGET to be enabled.
endchoice

config USB_DWC2_NEW_VERBOSE
	bool "Enable Verbose Debugging Messages"
	depends on USB_DWC2_NEW_DEBUG
	help
	  Say Y here to enable verbose debugging messages in the DWC2 Driver.
	  WARNING: Enabling this will quickly fill your message log.
	  If in doubt, say N.

config USB_DWC2_NEW_TRACK_MISSED_SOFS
	bool "Enable Missed SOF Tracking"
	help
	  Say Y here to enable logging of missed SOF events to the dmesg log.
	  WARNING: This feature is still experimental.
	  If in doubt, say N.

config USB_DWC2_NEW_DEBUG_PERIODIC
	bool "Enable Debugging Messages For Periodic Transfers"
	depends on USB_DWC2_NEW_DEBUG || USB_DWC2_NEW_VERBOSE
	default y
	help
	  Say N here to disable (verbose) debugging messages to be
	  logged for periodic transfers. This allows better debugging of
	  non-periodic transfers, but of course the debug logs will be
	  incomplete. Note that this also disables some debug messages
	  for which the transfer type cannot be deduced.

config USB_DWC2_NEW_FORCE_FULL_SPEED
	bool "Force full speed mode"
	help
	  Say Y here to force full speed mode in the DWC2 Driver.

config USB_DWC2_NEW_EXT_ID_PIN
	bool "External Id Pin"
	help
	  Say Y here to enable external id pin in the DWC2 Driver.
	  Example：
	    echo "device" > /sys/class/usb_role/dwc2_new-role-switch/role
	    echo "host" > /sys/class/usb_role/dwc2_new-role-switch/role
	    echo "none" > /sys/class/usb_role/dwc2_new-role-switch/role

config USB_DWC2_NEW_EXT_VBUS_DETECT
	bool "External Vbus Detect"
	help
	  Say Y here to enable external vbus detect in the DWC2 Driver.

endif
```

## kernel/kernel-x2000/drivers/video/fbdev/ingenic/fb_v12/Kconfig
```kconfig
menuconfig FB_INGENIC_V12
	tristate "Ingenic Framebuffer Driver for Version 12"
	depends on FB_INGENIC
	select FB_INGENIC_DISPLAYS_V12
	select FB_CFB_FILLRECT
	select FB_CFB_COPYAREA
	select FB_CFB_IMAGEBLIT
	help
	  Framebuffer support for the Version 12 DPU SoC.


config INGENIC_FB_SIMPLE_RDMA
	tristate "Use SIMPLE RDMA in dpu driver"
	depends on FB_INGENIC_V12
	default n
	help
	    use simple rdma in dpu driver. for advacned usage.
	    this will cause more memory allocated.

source "drivers/video/fbdev/ingenic/fb_v12/displays/Kconfig"
```
