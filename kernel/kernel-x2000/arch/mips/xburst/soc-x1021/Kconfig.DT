## kernel/kernel-x2000/drivers/video/fbdev/ingenic/fb_v12/displays/Kconfig
```kconfig
menuconfig FB_INGENIC_DISPLAYS_V12
	tristate "Supported lcd panels"
	depends on FB_INGENIC_V12
	select BACKLIGHT_LCD_SUPPORT
	select LCD_CLASS_DEVICE
	select BACKLIGHT_CLASS_DEVICE


config PANEL_V12_Y88249
	tristate "lcd panel y88249"
	depends on FB_INGENIC_DISPLAYS_V12
	help
		lcd panel y88249, for ingenicfb drivers.

config PANEL_V12_KD050HDFIA019
	tristate "lcd panel kd050hdfia019"
	depends on FB_INGENIC_DISPLAYS_V12
	help
		lcd panel kd050hdfia019, for ingenicfb drivers.

config PANEL_V12_MA0060
	tristate "lcd panel MA0060"
	depends on FB_INGENIC_DISPLAYS_V12
	help
		lcd panel MA0060, for ingenicfb drivers.

config PANEL_V12_FW050
	tristate "lcd panel FW050"
	depends on FB_INGENIC_DISPLAYS_V12
	help
		lcd panel FW050, for ingenicfb drivers.

config PANEL_V12_TL040WVS03CT
	tristate "lcd panel tl040wvs03ct"
	depends on FB_INGENIC_DISPLAYS_V12
	help
		lcd panel tl040wvs03ct, for ingenicfb drivers.

config PANEL_V12_TL040HDS01CT
	tristate "lcd panel tl040hds01ct"
	depends on FB_INGENIC_DISPLAYS_V12
	help
		lcd panel tl040hds01ct, for ingenicfb drivers.

config PANEL_V12_JD9161Z
	tristate "lcd panel JD9161Z"
	depends on FB_INGENIC_DISPLAYS_V12
	help
		lcd panel JD9161Z, for ingenicfb drivers.

config PANEL_V12_JD9365D
	tristate "lcd panel JD9365D"
	depends on FB_INGENIC_DISPLAYS_V12
	help
		lcd panel JD9365D, for ingenicfb drivers.
config PANEL_V12_JD9366
	tristate "lcd panel JD9366"
	depends on FB_INGENIC_DISPLAYS_V12
	help
		lcd panel JD9366, for ingenicfb drivers.

config PANEL_V12_ST7701S
	tristate "lcd panel ST7701S"
	depends on FB_INGENIC_DISPLAYS_V12
	help
		lcd panel ST7701S, for ingenicfb drivers.

config PANEL_V12_ST7701S_DX
	tristate "lcd panel st7701s_dx3.95ips"
	depends on FB_INGENIC_DISPLAYS_V12
	help
		lcd panel st7701s_dx3.95ips(mipi)480*480, for ingenicfb drivers.
config PANEL_V12_ST7282
	tristate "lcd panel st7282"
	depends on FB_INGENIC_DISPLAYS_V12
	help
		lcd panel st7282, for ingenicfb drivers.

config PANEL_V12_RM690A0
	tristate "lcd panel rm690a0"
	depends on FB_INGENIC_DISPLAYS_V12
	help
		lcd panel rm690a0(mipi), for ingenicfb drivers.


config PANEL_V12_YTS500XLAI
	tristate "lcd panel YTS500XLAI"
	depends on FB_INGENIC_DISPLAYS_V12
	help
		lcd panel YTS500XLAI, for ingenicfb drivers.

config PANEL_V12_YLYM286A
	tristate "lcd panel ylym286a"
	depends on FB_INGENIC_DISPLAYS_V12
	help
		lcd panel ylym286a with bridge lt9211, for ingenicfb drivers.

config PANEL_X2000_KD035HVFBD037
	tristate "SLCD KD035HVFBD037 with control IC otm4802a (320x480)"
	depends on FB_INGENIC_DISPLAYS_V12
	help
		lcd panel KD035HVFBD037, for ingenicfb drivers.

config PANEL_V12_BM8766
	tristate "tft bm8766 (480x800)"
	depends on FB_INGENIC_DISPLAYS_V12
	help
		lcd panel bm8766, for ingenicfb drivers.
```

## kernel/kernel-x2000/module_drivers/Kconfig
```kconfig
menu "Ingenic device-drivers Configurations"


config OUTSIDE_DRIVERS_PATH
	string
	default OUTSIDE_DRIVERS

source "$OUTSIDE_DRIVERS/drivers/Kconfig"
source "$OUTSIDE_DRIVERS/sound/soc/ingenic/Kconfig"

endmenu
```

## kernel/kernel-x2000/module_drivers/drivers/Kconfig
```kconfig
comment "---- Minimal required Drivers ----"
menu "[Interrupt] Drivers"
source "$OUTSIDE_DRIVERS/drivers/irqchip/Kconfig"
endmenu

menu "[OST] clocksoure Drivers"
source "$OUTSIDE_DRIVERS/drivers/clocksource/Kconfig"
endmenu

menu "[CPM] clk Drivers"
source "$OUTSIDE_DRIVERS/drivers/clk/ingenic-v2/Kconfig"
endmenu

menu "[GPIO] Pinctroller Drivers"
source "$OUTSIDE_DRIVERS/drivers/pinctrl/Kconfig"
endmenu

menu "[UART] Drivers"
source "$OUTSIDE_DRIVERS/drivers/tty/serial/Kconfig"
endmenu

menu "[MSC] (eMMC/SD/SDIO) and Device Drivers"
source "$OUTSIDE_DRIVERS/drivers/mmc/host/Kconfig"
endmenu

menu "SDIO-WIFI drivers"

source "$OUTSIDE_DRIVERS/drivers/net/wireless/Kconfig"

endmenu

menu "[DMA] Drivers"
source "$OUTSIDE_DRIVERS/drivers/dma/ingenic/Kconfig"
endmenu

menu "[SFC] (SPI Nand/Nor Flash) Drivers"
source "$OUTSIDE_DRIVERS/drivers/mtd/devices/Kconfig"
endmenu

menu "[SPI] Master/Slave Drivers"
source "$OUTSIDE_DRIVERS/drivers/spi/Kconfig"
source "$OUTSIDE_DRIVERS/drivers/spi_poll/Kconfig"
endmenu

menu "[ADC_POLL] ADC POLL DRVIERS"
source "$OUTSIDE_DRIVERS/drivers/adc_poll/Kconfig"
endmenu

menu "[I2C] Master Drivers"
source "$OUTSIDE_DRIVERS/drivers/i2c/busses/Kconfig"
endmenu

comment "---- minimal OS requirements. ----"

menu "[LCD] Panel/Touchscreen Drivers"

source "$OUTSIDE_DRIVERS/drivers/video/fbdev/ingenic/Kconfig"
source "$OUTSIDE_DRIVERS/drivers/video/logo-ingenic/Kconfig"

menu "Touchscreen Drivers"
source "$OUTSIDE_DRIVERS/drivers/input/touchscreen/Kconfig"
endmenu
endmenu



menu "[GMAC] (ethernet) Drivers"
source "$OUTSIDE_DRIVERS/drivers/net/ethernet/ingenic/Kconfig"
endmenu

menu "[CAN] (ethernet) Drivers"
source "$OUTSIDE_DRIVERS/drivers/net/can/ingenic/Kconfig"
endmenu

comment "---- (V4L2) Media Device Drivers ----"
source "$OUTSIDE_DRIVERS/drivers/media/platform/Kconfig"
menu "[Sensors] Camera Sensors"
source "$OUTSIDE_DRIVERS/drivers/media/i2c/Kconfig"
endmenu

source "$OUTSIDE_DRIVERS/drivers/video/ingenic_bscaler/Kconfig"
source "$OUTSIDE_DRIVERS/drivers/video/ingenic-nna/Kconfig"
source "$OUTSIDE_DRIVERS/drivers/video/ingenic_ipu/Kconfig"
source "$OUTSIDE_DRIVERS/drivers/video/ingenic_avpu/Kconfig"



comment "---- MISC Device Drivers ----"
source "$OUTSIDE_DRIVERS/drivers/misc/Kconfig"

menu "[RANDOM] drivers"
source "$OUTSIDE_DRIVERS/drivers/char/hw_random/Kconfig"
endmenu

comment "[MFD] Multi Function Device Drivers"
source "$OUTSIDE_DRIVERS/drivers/mfd/Kconfig"

comment "[Power] power and regulator Drivers"
source "$OUTSIDE_DRIVERS/drivers/power/Kconfig"
source "$OUTSIDE_DRIVERS/drivers/regulator/Kconfig"

source "$OUTSIDE_DRIVERS/drivers/crypto/Kconfig"


menu "[WDT] watchdog Drivers"
source "$OUTSIDE_DRIVERS/drivers/watchdog/Kconfig"
endmenu


menu "[PWM] drivers"
source "$OUTSIDE_DRIVERS/drivers/pwm/Kconfig"
endmenu

menu "[RISCV] drivers"
depends on SOC_X2500
source "$OUTSIDE_DRIVERS/drivers/riscv/Kconfig"
endmenu

menu "[CONN] drivers"
source "$OUTSIDE_DRIVERS/drivers/conn/Kconfig"
endmenu
```

## kernel/kernel-x2000/module_drivers/drivers/adc_poll/Kconfig
```kconfig
config INGENIC_ADC_POLL_X1600
    bool "x1600 adc poll driver"
    depends on SOC_X1600
```

## kernel/kernel-x2000/module_drivers/drivers/conn/Kconfig
```kconfig
config X2000_CONN
        tristate "Ingenic X2000 CONN base driver"
        depends on SOC_X2000_V12 || SOC_X2000 || SOC_M300 || SOC_X2100 || SOC_X2500
        default n
        help
          ingenic X2000 Serial Multi-core, inter-core communication base driver

config X2000_CONN_BLK
        tristate "Ingenic X2000 CONN block driver"
        depends on SOC_X2000_V12 || SOC_X2000 || SOC_M300 || SOC_X2100 || SOC_X2500
		select X2000_CONN
        default n
        help
          ingenic X2000 Serial Multi-core, inter-core communication block driver
          one core obtains reading and writing ability from another one
```

## kernel/kernel-x2000/module_drivers/drivers/input/touchscreen/chipone_touch/Kconfig
```kconfig
#
# Focaltech Touchscreen driver configuration
#

config TOUCHSCREEN_CHIPONE
    tristate "chipone Touchscreen"
    default n
    help
      Say Y here if you have chipone touch panel.
      If unsure, say N.

config TOUCHSCREEN_CHIPONE_DIRECTORY
    string "chipone tp directory name"
    default "chipone_touch"
    depends on TOUCHSCREEN_CHIPONE
```

## kernel/kernel-x2000/module_drivers/drivers/input/touchscreen/focaltech_ft5x16_touch/Kconfig
```kconfig
#
# Focaltech Touchscreen driver configuration
#

config TOUCHSCREEN_FT5X16
    bool "Focaltech ft5x16 Touchscreen"
    default n
    help
      Say Y here if you have Focaltech touch panel.
      If unsure, say N.

config TOUCHSCREEN_FTS_DIRECTORY
    string "Focaltech ft5x16 ts directory name"
    default "focaltech_ft5x16_touch"
    depends on TOUCHSCREEN_FT5X16
```
