## kernel/kernel-x2000/module_drivers/drivers/input/touchscreen/msm8909w/Kconfig
```kconfig
#
# MSM8909W Touchscreen driver configuration
#

config TOUCHSCREEN_MSM8909W
    bool "msm8909w Touchscreen"
    default n
    help
      Say Y here if you have MSM8909W touch panel.
      If unsure, say N.

config TOUCHSCREEN_MSM8909W_DIRECTORY
    string "msm8909w ts directory name"
    default "msm8909w"
    depends on TOUCHSCREEN_MSM8909W
```

## kernel/kernel-x2000/module_drivers/drivers/media/i2c/Kconfig
```kconfig
source "$OUTSIDE_DRIVERS/drivers/media/i2c/ingenic-isp/Kconfig"
source "$OUTSIDE_DRIVERS/drivers/media/i2c/ingenic-isp-v2/Kconfig"
source "$OUTSIDE_DRIVERS/drivers/media/i2c/soc_camera/Kconfig"
```

## kernel/kernel-x2000/module_drivers/drivers/media/platform/Kconfig
```kconfig
menu "[ISP] Drivers"


config VIDEO_INGENIC_ISP
        tristate "V4L2 Driver for ingenic isp"
        depends on VIDEO_DEV && VIDEO_V4L2
	depends on SOC_X2000_V12 || SOC_X2000 || SOC_M300 || SOC_X2100
        select VIDEOBUF2_DMA_CONTIG
        select VIDEOBUF2_DMA_CONTIG_INGENIC
source "$OUTSIDE_DRIVERS/drivers/media/platform/ingenic-isp/Kconfig"


config VIDEO_INGENIC_ISP_V2
        tristate "V4L2 Driver for ingenic isp version 2"
        depends on VIDEO_DEV && VIDEO_V4L2
	depends on SOC_X2500
        select VIDEOBUF2_DMA_CONTIG
        select VIDEOBUF2_DMA_CONTIG_INGENIC
source "$OUTSIDE_DRIVERS/drivers/media/platform/ingenic-isp-v2/Kconfig"
endmenu

menu "[CIM] Drivers"
	depends on SOC_X2000_V12 || SOC_X2000 || SOC_M300 || SOC_X1600 || SOC_X2100
source "$OUTSIDE_DRIVERS/drivers/media/platform/soc_camera/ingenic/Kconfig"
endmenu


menu "[Rotator] Drivers"
	depends on SOC_X2000_V12 || SOC_X2000 || SOC_M300 || SOC_X2100
source "$OUTSIDE_DRIVERS/drivers/media/platform/ingenic-rotate/Kconfig"
endmenu

menu "[I2D] Drivers"
	depends on SOC_X2500
source "$OUTSIDE_DRIVERS/drivers/media/platform/ingenic-i2d/Kconfig"
endmenu

menu "[VPU] Drivers"
	depends on SOC_X2000_V12 || SOC_X2000 || SOC_M300 || SOC_X2100
source "$OUTSIDE_DRIVERS/drivers/media/platform/ingenic-vcodec/Kconfig"
source "$OUTSIDE_DRIVERS/drivers/media/platform/ingenic-jpeg/Kconfig"
endmenu
```

## kernel/kernel-x2000/module_drivers/drivers/media/platform/ingenic-jpeg/Kconfig
```kconfig
config VIDEO_INGENIC_JPEG
        tristate "[JPEG] V4L2 driver for ingenic JPEG"
        depends on VIDEO_DEV && VIDEO_V4L2	&& SOC_X1000
        select V4L2_MEM2MEM_DEV
        select VIDEOBUF2_DMA_CONTIG_INGENIC
        select VIDEOBUF2_DMA_CONTIG
```

## kernel/kernel-x2000/module_drivers/drivers/media/platform/soc_camera/ingenic/Kconfig
```kconfig
config VIDEO_INGENIC
        tristate "Ingenic Camera Sensor Interface driver"
        depends on VIDEO_DEV && SOC_CAMERA
        depends on HAS_DMA
        select VIDEOBUF2_DMA_CONTIG
        select VIDEOBUF2_DMA_CONTIG_INGENIC
        ---help---
          This is a v4l2 driver for the ingenic Camera Sensor Interface


source "$OUTSIDE_DRIVERS/drivers/media/platform/soc_camera/ingenic/cim-v2/Kconfig"
```

## kernel/kernel-x2000/module_drivers/drivers/net/can/ingenic/Kconfig
```kconfig
menu "INGENIC CAN support"

config INGENIC_CAN
	tristate "ingenic on-chip CAN support"
#	depends on
	---help---
	  Driver for the Microchip INGENIC CAN controllers.

config INGENIC_CAN_USE_PDMA
	bool "ingenic can use dma transmission"
	default y
	depends on INGENIC_CAN
	---help---
	Configure CAN to use DMA to transfer data

endmenu
```

## kernel/kernel-x2000/module_drivers/drivers/pinctrl/Kconfig
```kconfig
config PINCTRL_INGENIC
	bool "Pinctrl driver for ingenic"
	select PINMUX
	select PINCONF
	select GENERIC_PINCONF

config DISABLE_GPIOA_IRQ_CONTROLLER
	bool "disable GPIO A GROUP IRQ CONTROLLER"
	depends on PINCTRL_INGENIC
	default n

config DISABLE_GPIOB_IRQ_CONTROLLER
	bool "disable GPIO B GROUP IRQ CONTROLLER"
	depends on PINCTRL_INGENIC
	default n

config DISABLE_GPIOC_IRQ_CONTROLLER
	bool "disable GPIO C GROUP IRQ CONTROLLER"
	depends on PINCTRL_INGENIC
	default n

config DISABLE_GPIOD_IRQ_CONTROLLER
	bool "disable GPIO D GROUP IRQ CONTROLLER"
	depends on PINCTRL_INGENIC
	default n

config DISABLE_GPIOE_IRQ_CONTROLLER
	bool "disable GPIO E GROUP IRQ CONTROLLER"
	depends on PINCTRL_INGENIC
	default n

config MULTI_VGPIO_INGENIC
	   bool "multiple input lineout to signle output"
```

## kernel/kernel-x2000/module_drivers/drivers/power/Kconfig
```kconfig
menuconfig BATTERY_RICOH619
	tristate "Ricoh R5T619 PMIC battery driver"
	depends on MFD_RICOH619 && I2C
	help
	  Say Y to enable support for the battery control of the Ricoh R5T619
	  Power Management device.
if BATTERY_RICOH619

config LARGE_CAPACITY_BATTERY
	  bool "Large capacity battery for 2000mA 4000mA"
	  help
	  Say "Y" to enable large capacity battery.

config 10000MAH_ZBRZFY_C_CAPACITY_BATTERY
	  bool "10000mAh zbrzfy_c capacity battery for 10000mA"
	  help
	  Say "Y" to enable 10000mAh zbrzfy capacity battery.

config 2000MAH_ZBRZFY_CAPACITY_BATTERY
	  bool "2000mAh zbrzfy capacity battery for 2000mA"
	  help
	  Say "Y" to enable 2000mAh zbrzfy capacity battery.

config 2200MAH_ZBRZFY_CAPACITY_BATTERY
	  bool "2200mAh zbrzfy capacity battery for 2200mA"
	  help
	  Say "Y" to enable 2200mAh zbrzfy capacity battery.

config 2300MAH_ZBRZFY_CAPACITY_BATTERY
	  bool "2300mAh zbrzfy capacity battery for 2300mA"
	  help
	  Say "Y" to enable 2300mAh zbrzfy capacity battery.

config 2500MAH_ZYCZZFY_CAPACITY_BATTERY
	  bool "2500mAh zyczzfy capacity battery for 2500mA"
	  help
	  Say "Y" to enable 2500mAh zyczzfy capacity battery.

config 2500MAH_HJ_CAPACITY_BATTERY
	  bool "2500mAh hongjing capacity battery for 2500mA"
	  help
	  Say "Y" to enable 2500mAh zbrzfy capacity battery.

config 780MAH_RAYPAI_CAPACITY_BATTERY
       bool "780 mAh regularity capacity battery for 780mA"
       help
       Say "Y" to enable 780mAh regularity capacity battery.

config 600MAH_REGULARITY_CAPACITY_BATTERY
	  bool "600mAh regularity capacity battery for 600mA"
	  help
	  Say "Y" to enable 600mAh regularity capacity battery.

config 500MAH_DOOR_CAPACITY_BATTERY
	  bool "500mAh door capacity battery for 500mA"
	  help
	  Say "Y" to enable 500mAh door capacity battery.

config 500MAH_CRUISE_CAPACITY_BATTERY
	  bool "500mAh cruise capacity battery for 500mA"
	  help
	  Say "Y" to enable 500mAh cruise capacity battery.

config 500MAH_LG1_CAPACITY_BATTERY
	  bool "500mAh longjing1 capacity battery for 500mA"
	  help
	  Say "Y" to enable 500mAh longjing1 capacity battery.

config 430MAH_CRUISE_CAPACITY_BATTERY
	  bool "430mAh cruise capacity battery for 430mA"
	  help
	  Say "Y" to enable 430mAh cruise capacity battery.

config 400MAH_WESEEING_CAPACITY_BATTERY
	  bool "400mAh weseeing capacity battery for 400mA"
	  help
	  Say "Y" to enable 400mAh weseeing capacity battery.

config 400MAH_PARAMOUNT_CAPACITY_BATTERY
	  bool "400mAh paramount capacity battery for 400mA"
	  help
	  Say "Y" to enable 400mAh paramount capacity battery.

config 400MAH_KEPTER_CAPACITY_BATTERY
	  bool "400mAh kepter capacity battery for 400mA"
	  help
	  Say "Y" to enable 400mAh kepter capacity battery.

config 320MAH_CAPACITY_BATTERY
	  bool "320mAh capacity battery for 320mA"
	  help
	  Say "Y" to enable 320mAh capacity battery.

config 310MAH_JZZHG9_CAPACITY_BATTERY
	  bool "310mAh capacity battery for jzzhg9 310mA"
	  help
	  Say "Y" to enable jzzhg9 310mAh capacity battery.

config 160MAH_DV010_CAPACITY_BATTERY
	  bool "160mAh capacity battery for dv010"
	  help
	  Say "Y" to enable dv010 160mAh capacity battery.

config 300MAH_CAPACITY_BATTERY
	  bool "300mAh capacity battery for 300mA"
	  help
	  Say "Y" to enable 300mAh capacity battery.

config 300MAH_RAYPAI_CAPACITY_BATTERY
	  bool "300mAh capacity battery for raypai"
	  help
	  Say "Y" to enable raypai 300mAh capacity battery.

config 350MAH_DISATCH_CAPACITY_BATTERY
	  bool "350mAh capacity battery for disatch"
	  help
	  Say "Y" to enable disatch 350mAh capacity battery.

config 370MAH_CLOFY_CAPACITY_BATTERY
	  bool "370mAh capacity battery for clofy"
	  help
	  Say "Y" to enable clofy 350mAh capacity battery.

config 400MAH_DISATCH_CAPACITY_BATTERY
	  bool "400mAh capacity battery for disatch"
	  help
	  Say "Y" to enable disatch 400mAh capacity battery.

config 480MAH_DISATCH_CAPACITY_BATTERY
	  bool "480mAh capacity battery for disatch"
	  help
	  Say "Y" to enable disatch 480mAh capacity battery.

config 140MAH_ZBRGLASS_CAPACITY_BATTERY
	  bool "140mAh capacity battery for zbrglass"
	  help
	  Say "Y" to enable zbrglass 140mAh capacity battery.

config 130MAH_FSHD_CAPACITY_BATTERY
	  bool "130mAh capacity battery for fshd"
	  help
	  Say "Y" to enable fshd 130mAh capacity battery.
config 250MAH_CIRCLEV2_CAPACITY_BATTERY
	  bool "250mAh capacity battery for circlev2"
	  help
	  Say "Y" to enable circlev2 250mAh capacity battery.
config SMALL_CAPACITY_BATTERY
	  bool "Small capacity battery for 260mA 500mA"
	  help
	  Say "Y" to enable small capacity battery.

endif


source "$OUTSIDE_DRIVERS/drivers/power/axp_power/Kconfig"
```

## kernel/kernel-x2000/module_drivers/drivers/regulator/Kconfig
```kconfig
config REGULATOR_RICOH619
        tristate "RICOH RICOH619 Power regulators"
        depends on MFD_RICOH619
        help
          Select this option to enable the power regulator of RICOH
          PMIC RN5T619.
          This driver supports the control of different power rails of device
          through regulator interface. The device supports multiple DCDC/LDO
          outputs which can be controlled by i2c communication.
```

## kernel/kernel-x2000/module_drivers/drivers/remoteproc/Kconfig
```kconfig
config INGENIC_RPROC
        tristate "ingenic remoteproc support"
        depends on HAS_DMA
        select REMOTEPROC
        default n
        help
          Say y or m here to support ingenic mcu remoteproc.
          This can be either built-in or a loadable module.
          If unsure say N.

config INGENIC_MCU_RPROC
        tristate "ingenic mcu remoteproc support"
        depends on HAS_DMA
        select REMOTEPROC
        default n
        help
          Say y or m here to support ingenic mcu remoteproc.
          This can be either built-in or a loadable module.
          This module needs to be used with the mcu-host application.
          If unsure say N.
```

## kernel/kernel-x2000/module_drivers/drivers/riscv/Kconfig
```kconfig
config X2500_RISCV
depends on SOC_X2500
default n
bool "x2500 riscv driver"
help
        Select to support riscv.
```

## kernel/kernel-x2000/module_drivers/drivers/spi_poll/Kconfig
```kconfig
config INGENIC_POLL_SPI
        tristate "X1600 Ingenic SPI Controller POLL"
        depends on SOC_X1600
        help
                SPI driver for Ingenic series SoCs

config INGENIC_POLL_SPI_CLK_RATE
    int "spi clk rate"
    default 100000000
    depends on INGENIC_POLL_SPI

config INGENIC_POLL_SPI0
       tristate "X1600 POLL SPI0"
       depends on INGENIC_POLL_SPI

choice
        prompt "SPI0_MOSI_GPIO"
        depends on INGENIC_POLL_SPI0
        default INGENIC_POLL_SPI0_MOSI_PB13

config INGENIC_POLL_SPI0_MOSI_PB13
    bool "GPIO_PB(13)"

config INGENIC_POLL_SPI0_MOSI_PA30
    bool "GPIO_PA(30)"

config INGENIC_POLL_SPI0_MOSI_NULL
    bool "NULL"

endchoice


choice
        prompt "SPI0_MISO_GPIO"
        depends on INGENIC_POLL_SPI0
        default INGENIC_POLL_SPI0_MISO_PB14

config INGENIC_POLL_SPI0_MISO_PB14
    bool "GPIO_PB(14)"

config INGENIC_POLL_SPI0_MISO_PA29
    bool "GPIO_PA(29)"

config INGENIC_POLL_SPI0_MISO_NULL
    bool "NULL"

endchoice

choice
        prompt "SPI0_CLK_GPIO"
        depends on INGENIC_POLL_SPI0
        default INGENIC_POLL_SPI0_CLK_PB12

config INGENIC_POLL_SPI0_CLK_PB12
    bool "GPIO_PB(12)"

config INGENIC_POLL_SPI0_CLK_PA31
    bool "GPIO_PA(31)"

endchoice


choice
        prompt "SPI0_CS_GPIO"
        depends on INGENIC_POLL_SPI0
        default INGENIC_POLL_SPI0_CS_PB16

config INGENIC_POLL_SPI0_CS_PB16
    bool "GPIO_PB(16)"

config INGENIC_POLL_SPI0_CS_PA28
    bool "GPIO_PA(28)"

config INGENIC_POLL_SPI0_CS_NULL
    bool "NULL"

endchoice
```

## kernel/kernel-x2000/module_drivers/drivers/video/fbdev/ingenic/spi_fb_v12/Kconfig
```kconfig
menuconfig SPI_FB_V12
	tristate "JZ framebuffer sfc nand interface support."
	depends on FB
	select FB_CFB_FILLRECT
	select FB_CFB_COPYAREA
	select FB_CFB_IMAGEBLIT
	help
	  virtual Framebuffer support
config VFB_XRES
        int "vfb xres"
        depends on SPI_FB_V12
        default 194
        help
          virtual fb size:pix number of each line
config VFB_YRES
        int "vfb yres"
        depends on SPI_FB_V12
        default 368
        help
          virtual fb size: number of lines
config VFB_BPP
        int "vfb bpp"
        depends on SPI_FB_V12
        default 24
        help
          virtual fb bpp info
source "$OUTSIDE_DRIVERS/drivers/video/fbdev/ingenic/spi_fb_v12/ingenic_sfc_oled_v2/Kconfig"
```

## kernel/kernel-x2000/module_drivers/drivers/video/fbdev/ingenic/spi_fb_v12/ingenic_sfc_oled_v2/Kconfig
```kconfig
menuconfig INGENIC_SFC_OLED_V2
	tristate "Supported oled panels"
	depends on SPI_FB_V12

config OLED_FT2306
	tristate "oled ft2306"
	depends on INGENIC_SFC_OLED_V2
	help
		lcd panel oled ft2306, for ingenic vfb drivers.
```

## module_driver/package/Config.in
```kconfig
source package/vendor/Config.in
source package/build/Config.in
source package/devices/Config.in
source package/drivers/Config.in
source package/soc/Config.in
```

## module_driver/package/build/Config.in
```kconfig
menu "通用选项"

config MD_INIT_ORDER_FILE
    string "定义驱动初始化顺序的文件"
    default package/default_driver_init_order.mk

config MD_INIT_START_FILE
    string "开机启动时调用模块驱动的文件"
    default package/S11module_driver_default

endmenu
```

## module_driver/package/devices/Config.in
```kconfig
menu "外设"

source package/devices/keyboard/Config.in
source package/devices/keyboard/keyboard_keys.in
source package/devices/lcd/Config.in
source package/devices/backlight/Config.in
source package/devices/touchscreen/Config.in
source package/devices/camera/Config.in
source package/devices/isp_camera/Config.in
source package/devices/codec/Config.in
source package/devices/wireless/Config.in
source package/devices/Ethernet/Config.in
source package/devices/alsa-sound-card/Config.in
source package/devices/pmu/Config.in
source package/devices/regulator/Config.in
source package/devices/other/Config.in

endmenu
```

## module_driver/package/devices/Ethernet/Config.in
```kconfig
menu "Ethernet(以太网设备)"

source package/devices/Ethernet/ax88796c_spi/Config.in

endmenu
```

## module_driver/package/devices/Ethernet/ax88796c_spi/Config.in
```kconfig
menuconfig MD_AX88796C_SPI
    bool "AX88796C SPI ETHERNET"
    select MD_UTILS_SPI

config MD_AX88796C_SPI_SPI_BUS_NUM
    int "spi bus num(挂接在哪个spi 总线)"
    default -1

config MD_AX88796C_SPI_GPIO_CS
    string "cs gpio(spi 片选)"
    default -1
    choice from SOC_GPIO_PINS

config MD_AX88796C_SPI_GPIO_IRQ
    string "irq gpio(接收ax88796c-spi的中断)"
    default -1
    choice from SOC_GPIO_PINS

config MD_AX88796C_SPI_GPIO_RESET
    string "reset gpio(复位脚)"
    default -1
    choice from SOC_GPIO_PINS

config MD_AX88796C_SPI_DEBUG
    bool "开启网卡debug打印"
    default n

endmenu
```
