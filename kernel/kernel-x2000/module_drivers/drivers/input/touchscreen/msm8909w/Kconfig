## module_driver/package/devices/alsa-sound-card/Config.in
```kconfig
menu "alsa声卡设备列表"

source package/devices/alsa-sound-card/x1000_icodec_sound_card/Config.in

source package/devices/alsa-sound-card/x1000_dummy_sound_card/Config.in

source package/devices/alsa-sound-card/x1600_dummy_sound_card/Config.in

source package/devices/alsa-sound-card/x1600_510_dummy_sound_card/Config.in

source package/devices/alsa-sound-card/x1021_icodec_sound_card/Config.in

source package/devices/alsa-sound-card/x1520_icodec_sound_card/Config.in

source package/devices/alsa-sound-card/x1830_icodec_sound_card/Config.in

source package/devices/alsa-sound-card/x2000_icodec_sound_card/Config.in

source package/devices/alsa-sound-card/x2000_ecodec_sound_card/Config.in

source package/devices/alsa-sound-card/x2000_spdif_sound_card/Config.in

source package/devices/alsa-sound-card/x2000_510_icodec_sound_card/Config.in

source package/devices/alsa-sound-card/x2000_510_ecodec_sound_card/Config.in

source package/devices/alsa-sound-card/x2000_510_spdif_sound_card/Config.in
endmenu
```

## module_driver/package/devices/alsa-sound-card/x1000_dummy_sound_card/Config.in
```kconfig
config  MD_X1000_DUMMY_SOUND_CARD
    bool "使用 x1000 创建一个虚拟外部声卡(用户没有外部声卡驱动时可以用虚拟声卡输出i2s信号)"
```
