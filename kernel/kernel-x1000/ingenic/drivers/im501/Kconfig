## kernel/kernel-x1000/sound/soc/ingenic/Kconfig
```kconfig
menuconfig SND_ASOC_INGENIC
	tristate "ASoC support for Ingenic"
	depends on JZRISC && SND_SOC
	help
		Say 'Y' to enable Alsa drivers of xburst.

if SND_ASOC_INGENIC

config SND_ASOC_JZ_AIC_V12
	tristate

config SND_ASOC_DMA_V13
	tristate

config SND_ASOC_DMA_V12
	tristate

config SND_ASOC_DMA_HRTIMER
	tristate
	depends on HIGH_RES_TIMERS && DMA_ENGINE
	default n
	help
		Say 'Y' if you want use dma engine with hrtimer interupt for pcm(dma) driver

config SND_ASOC_JZ_AIC_I2S_V12
	tristate
	select SND_ASOC_JZ_AIC_V12

config SND_ASOC_JZ_AIC_I2S_V13
	tristate
	select SND_ASOC_JZ_AIC_V12

config SND_ASOC_JZ_PCM_DUMP_CDC
	tristate

config SND_ASOC_JZ_PCM_V12
	tristate
	select SND_ASOC_JZ_PCM_DUMP_CDC

config SND_ASOC_JZ_PCM_V13
	tristate
	select SND_ASOC_JZ_PCM_DUMP_CDC

config SND_ASOC_JZ_SPDIF_DUMP_CDC
	tristate

config SND_ASOC_JZ_AIC_SPDIF_V12
	tristate
	select SND_ASOC_JZ_AIC_V12
	select SND_ASOC_JZ_SPDIF_DUMP_CDC

config SND_ASOC_JZ_AIC_SPDIF_V13
	tristate
	select SND_ASOC_JZ_AIC_V12
	select SND_ASOC_JZ_SPDIF_DUMP_CDC

config SND_ASOC_JZ_ICDC_D1
	tristate
	select SND_ASOC_JZ_AIC_V12

config SND_ASOC_JZ_ICDC_D2
	tristate
	select SND_ASOC_JZ_AIC_V12

config SND_ASOC_JZ_ICDC_D3
	tristate
	select SND_ASOC_JZ_AIC_V12

config SND_ASOC_JZ_ICDC_D4
        tristate
        select SND_ASOC_JZ_AIC_V12

config SND_ASOC_JZ_DMIC_DUMP_CDC
	tristate

config SND_ASOC_JZ_DMIC_V13
	tristate
	select SND_ASOC_JZ_DMIC_DUMP_CDC

config SND_ASOC_JZ_DMIC_MODULE
	tristate "ALSA DMIC Driver work with wakeup module"
	select SND_ASOC_JZ_DMIC_DUMP_CDC

config SND_ASOC_JZ_DMIC_V12
	tristate
	select SND_ASOC_JZ_DMIC_DUMP_CDC

config SND_ASOC_JZ_DMIC_FREQ
	int "dmic frequency"
	depends on SND_ASOC_JZ_AIC_V12
	default 24000000
	help
	  The frequency of x1000 dmic is 24Mhz and The frequency of m200 dmic is 12Mhz ,
	  If unsure, say N.

config SND_ASOC_DMA_ENCRPTY
	bool "support encrpty the data capture from dma"
	default n


menu "ingenic board type select"

choice
	prompt "ingenic codec type select"
	depends on MACH_XBURST
	default SND_ASOC_JZ_INCODEC

config SND_ASOC_JZ_INCODEC
	tristate "ingenic audio internal codec"
	select SND_ASOC_JZ_AIC_V12

config SND_ASOC_JZ_EXTCODEC
	tristate "ingenic audio external codec"
	select SND_ASOC_JZ_AIC_V12
endchoice

choice
	prompt "soc m200 codec type select"
	depends on SOC_M200 && SND_ASOC_JZ_INCODEC

config SND_ASOC_INGENIC_DORADO_ICDC
	tristate "Audio support for dorado with internal codec"
	select SND_ASOC_DMA_V12
	select SND_ASOC_JZ_AIC_I2S_V12
	select SND_ASOC_JZ_ICDC_D1
	select SND_ASOC_JZ_PCM_V12
	select SND_ASOC_JZ_DMIC_V12
	help
	  Say Y if you want to add audio support for M200 Dorado
	  reference board with internal codec
config SND_ASOC_INGENIC_NEWTON2_PLUS_ICDC
	tristate "Audio support for newton2 plus with internal codec"
	select SND_ASOC_DMA_V12
	select SND_ASOC_JZ_AIC_I2S_V12
	select SND_ASOC_JZ_ICDC_D1
	select SND_ASOC_JZ_PCM_V12
	select SND_ASOC_JZ_DMIC_V12
	help
	  Say Y if you want to add audio support for M200S Newton2 Plus
	  reference board with internal codec
config SND_ASOC_INGENIC_WATCH_AW808_ICDC
	tristate "Audio support for watch aw808 with internal codec"
	select SND_ASOC_DMA_V12
	select SND_ASOC_JZ_AIC_I2S_V12
	select SND_ASOC_JZ_ICDC_D1
	select SND_ASOC_JZ_PCM_V12
	help
	  Say Y if you want to add audio support for M200 watch aw808
	  reference board with internal codec
endchoice


choice
	prompt "soc 4775 codec type select"
	depends on SOC_4775 && SND_ASOC_JZ_INCODEC

config SND_ASOC_INGENIC_MENSA_ICDC
	bool "Audio support for mensa with internal codec"
	select SND_ASOC_DMA_V12
	select SND_ASOC_JZ_AIC_I2S_V12
	select SND_ASOC_JZ_ICDC_D2
	select SND_ASOC_JZ_PCM_V12

config SND_ASOC_INGENIC_MENSA_SPDIF_V12
	bool "Audio support for mensa with spdif"
	select SND_ASOC_DMA_V12
	select SND_ASOC_JZ_AIC_SPDIF_V12
	select SND_ASOC_JZ_PCM_V12
endchoice

choice
	prompt "soc x1000 codec type select"
	depends on SOC_X1000 && SND_ASOC_JZ_INCODEC

config SND_ASOC_INGENIC_PHOENIX_ICDC
	tristate "Audio support for phoenix with internal codec"
	select SND_ASOC_DMA_V13
	select SND_ASOC_JZ_AIC_I2S_V13
	select SND_ASOC_JZ_ICDC_D3
	select SND_ASOC_JZ_PCM_V13
	select SND_ASOC_JZ_DMIC_V13

config SND_ASOC_INGENIC_PHOENIX_SPDIF
	bool "Audio support for phoenix with spdif"
	select SND_ASOC_DMA_V13
	select SND_ASOC_JZ_AIC_SPDIF_V13
	select SND_ASOC_JZ_PCM_V13
	select SND_ASOC_JZ_DMIC_V13

config SND_ASOC_INGENIC_CANNA_ICDC
	tristate "Audio support for canna with internal codec"
	select SND_ASOC_DMA_V13
	select SND_ASOC_JZ_AIC_I2S_V13
	select SND_ASOC_JZ_ICDC_D3
	select SND_ASOC_JZ_PCM_V13
	select SND_ASOC_JZ_DMIC_V13
endchoice

choice
	prompt "soc x1830 codec type select"
	depends on SOC_X1830 && SND_ASOC_JZ_INCODEC

config SND_ASOC_INGENIC_PDX1830_AUDIO_ICDC
	tristate "Audio support for PD_x1830_AUDIO with internal codec"
	select SND_ASOC_DMA_HRTIMER
	select SND_ASOC_JZ_AIC_I2S_V12
	select SND_ASOC_JZ_ICDC_D4
	select SND_ASOC_JZ_DMIC_V13
	
config SND_ASOC_INGENIC_PDX1830_SUNING_ALARM_ICDC
	tristate "Audio support for PDX1830_SUNING_ALARM with internal codec"
	select SND_ASOC_DMA_HRTIMER
	select SND_ASOC_JZ_AIC_I2S_V12
	select SND_ASOC_JZ_ICDC_D4
	select SND_ASOC_JZ_DMIC_V13

config SND_ASOC_INGENIC_IM501_DEVEL_BOARD
	tristate "debug for im501"
	select SND_ASOC_DMA_V12
	select SND_ASOC_JZ_AIC_I2S_V12
	select SND_ASOC_JZ_ICDC_D4
	select SPI
	select SPI_IM501
	select SND_ASOC_JZ_DMIC_V13

endchoice

choice
	prompt "external codec type select"
	depends on SND_ASOC_JZ_EXTCODEC

config SND_ASOC_INGENIC_EXTCODEC_NPCP215
	tristate "Audio support for phoenix with ext codec npcp215"
	select SND_ASOC_DMA_V13
	select SND_ASOC_JZ_AIC_I2S_V13
	select SND_ASOC_JZ_PCM_V13
	select SND_ASOC_JZ_DMIC_V13
	select SND_SOC_NPCP215 if I2C

config SND_ASOC_INGENIC_EXTCODEC_AK4951
	tristate "Audio support for phoenix with ext codec ak4951"
	select SND_ASOC_DMA_V13
	select SND_ASOC_JZ_AIC_I2S_V13
	select SND_ASOC_JZ_PCM_V13
	select SND_ASOC_JZ_DMIC_V13
	select SND_SOC_AK4951 if I2C

config SND_ASOC_INGENIC_PDX1830_SY6026L
	tristate "Audio support for pdx1830 with ext codec sy6026l"
	select SND_ASOC_DMA_V12
	select SND_ASOC_JZ_AIC_I2S_V12
	select SND_SOC_SY6026L
	select SND_ASOC_JZ_DMIC_V13
	
config SND_ASOC_INGENIC_SUNING_SMA1301_ES7241
	tristate "Audio support for suning with ext amp sma1301 and ext adc es7241"
	select SND_ASOC_DMA_V12
	select SND_ASOC_JZ_AIC_I2S_V12
	select SND_SOC_SMA1301_ES7241
	select SND_ASOC_JZ_DMIC_V13

config SND_ASOC_INGENIC_IM501_DEVEL_BOARD
	tristate "debug for im501"
	select SND_ASOC_DMA_V12
	select SND_ASOC_JZ_AIC_I2S_V12
	select SPI
	select SPI_IM501
	select SND_ASOC_JZ_DMIC_V13

endchoice

config SND_ASOC_AK4951_AEC_MODE
	tristate "AK4951 support reference for AEC "
	depends on SND_ASOC_INGENIC_EXTCODEC_AK4951

endmenu


config SND_ASOC_JZ_DMIC0
	bool "select dmic0"
	depends on SND_ASOC_JZ_DMIC_V13
	help
	  Say "Y" to enable dmic0.

config SND_ASOC_JZ_DMIC1
	bool "select dmic1"
	depends on SND_ASOC_JZ_DMIC_V13
	help
	  Say "Y" to enable dmic1.

config JZ_ASOC_DMA_AUTO_CLR_DRT_MEM
	bool "JZ audio dma clear auto dirty memory"
	help
	  Say Y if you audio dma clear auto dirty memory, so you would not
	  clear by slience_threshold set by user app

config JZ_ASOC_CODEC_HP_INSERT_REV
	bool "JZ headphone jack detect is Reversal"
	depends on SND_ASOC_JZ_ICDC_D1
	default n
	help
	  Say Y if you headphone jack detect is Reversal

config JZ_ASOC_CODEC_INNER_REFERENCE_SOUND
	bool "JZ codec inner-reference-sound select"
	default y
	help
	  Say Y if you want loopback the playback-sound to the capture-path by codec mixer
config JZ_ASOC_ICDC_USE_SOC_MICBIAS
	bool "JZ inner codec use soc micbias"
	default y
	help
	  Say Y if you want use soc-micbias as default
endif
```

## kernel/kernel-x1021/arch/mips/xburst/soc-4775/chip-4775/mensa/Kconfig
```kconfig
choice
prompt "BOARD version"
depends on PRODUCT_MENSA
default BOARD_MENSA_V12

config BOARD_MANSA_V12
bool "board mensa v12"
depends on PRODUCT_MENSA

config BOARD_MANSA_V20
bool "board mensa v20"
depends on PRODUCT_MENSA

endchoice

config BOARD_NAME
string
default "mensa_v12" if BOARD_MANSA_V12
default "mensa_v20" if BOARD_MANSA_V20
```

## kernel/kernel-x1021/arch/mips/xburst/soc-m200/chip-m200/Kconfig
```kconfig
choice
	prompt "Board type"
	depends on CHIP_M200
	default PRODUCT_DEVELOP

config BOARD_4785_FPGA
       bool "FPGA"

config PRODUCT_DEVELOP
       bool "DEVELOP"

config BOARD_NEWTON
       bool "NEWTON"

config BOARD_WATCH
       bool "watch"

config BOARD_HALLEY2_PLUS
       bool "halley2_plus"

config BOARD_HALLEY2_PRO
       bool "halley2_pro"

endchoice

config PRODUCT_NAME
	string
	default "fpga" if BOARD_4785_FPGA
	default "dorado" if PRODUCT_DEVELOP
	default "newton" if BOARD_NEWTON
	default "watch" if BOARD_WATCH
	default "halley2_plus" if BOARD_HALLEY2_PLUS
	default "halley2_pro" if BOARD_HALLEY2_PRO

if PRODUCT_DEVELOP
source "arch/mips/xburst/soc-m200/chip-m200/dorado/Kconfig"
endif

if BOARD_NEWTON
source "arch/mips/xburst/soc-m200/chip-m200/newton/Kconfig"
endif

if BOARD_WATCH
source "arch/mips/xburst/soc-m200/chip-m200/watch/Kconfig"
endif

if BOARD_HALLEY2_PLUS
source "arch/mips/xburst/soc-m200/chip-m200/halley2_plus/Kconfig"
endif

if BOARD_HALLEY2_PRO
source "arch/mips/xburst/soc-m200/chip-m200/halley2_pro/Kconfig"
endif
```

## kernel/kernel-x1021/arch/mips/xburst/soc-m200/chip-m200/halley2_plus/Kconfig
```kconfig
choice
	prompt "BOARD type"
	depends on BOARD_HALLEY2_PLUS
	default BOARD_HALLEY2_PLUS_V10

config BOARD_HALLEY2_PLUS_V10
       bool "halley2 plus v1.0"
       depends on BOARD_HALLEY2_PLUS

endchoice

config BOARD_NAME
	string
	default "halley2_plus_v10" if BOARD_HALLEY2_PLUS_V10
```

## kernel/kernel-x1021/arch/mips/xburst/soc-m200/chip-m200/halley2_pro/Kconfig
```kconfig
choice
	prompt "BOARD type"
	depends on BOARD_HALLEY2_PRO
	default BOARD_HALLEY2_PRO_V10

config BOARD_HALLEY2_PRO_V10
       bool "halley2 pro v1.0"
       depends on BOARD_HALLEY2_PRO

endchoice

config BOARD_NAME
	string
	default "halley2_pro_v10" if BOARD_HALLEY2_PRO_V10
```

## kernel/kernel-x1021/arch/mips/xburst/soc-x1000/chip-x1000/Kconfig
```kconfig
choice
	prompt "Board type"
	depends on CHIP_X1000
	default PRODUCT_X1000_PHOENIX

config  PRODUCT_X1000_PHOENIX
    bool "product x1000 phoenix"

config	PRODUCT_X1000_HALLEY2
	bool "product x1000 halley2"

config  PRODUCT_X1000_CANNA
    bool "product x1000 canna"

config	PRODUCT_X1000_PANSY
	bool "product x1000 pansy"

config	PRODUCT_X1000_FIR
	bool "product x1000E fir"
endchoice

if PRODUCT_X1000_PHOENIX
config PRODUCT_NAME
string
default "phoenix"
source "arch/mips/xburst/soc-x1000/chip-x1000/phoenix/Kconfig"
endif

if PRODUCT_X1000_CANNA
config PRODUCT_NAME
string
default "canna"
source "arch/mips/xburst/soc-x1000/chip-x1000/canna/Kconfig"
endif

if PRODUCT_X1000_HALLEY2
config PRODUCT_NAME
string
default "halley2"
source "arch/mips/xburst/soc-x1000/chip-x1000/halley2/Kconfig"
endif

if PRODUCT_X1000_PANSY
config PRODUCT_NAME
string
default "pansy"
source "arch/mips/xburst/soc-x1000/chip-x1000/pansy/Kconfig"
endif

if PRODUCT_X1000_FIR
config PRODUCT_NAME
string
default "fir"
source "arch/mips/xburst/soc-x1000/chip-x1000/fir/Kconfig"
endif
```

## kernel/kernel-x1021/arch/mips/xburst/soc-x1000/chip-x1000/canna/Kconfig
```kconfig
choice

prompt "BOARD version"
depends on PRODUCT_X1000_CANNA
default BOARD_X1000_CANNA_V23

config BOARD_X1000_CANNA_V23
bool "board x1000 canna v23"
depends on PRODUCT_X1000_CANNA

config BOARD_X1000_CANNA_V10
bool "board x1000 canna v10"
depends on PRODUCT_X1000_CANNA


endchoice

config BOARD_NAME
string
default "canna_v23" if BOARD_X1000_CANNA_V23
default "canna_v10" if BOARD_X1000_CANNA_V10
```

## kernel/kernel-x1021/arch/mips/xburst/soc-x1000/chip-x1000/fir/Kconfig
```kconfig
choice
prompt "Core Board Version"
depends on PRODUCT_X1000_FIR
default FIR_CORE_V10

config FIR_CORE_V10
	bool "fir core board v10"

config FIR_CORE_V20
	bool "fir core board v20"
endchoice

choice
prompt "Ext BOARD version"
	depends on PRODUCT_X1000_FIR
	default BOARD_X1000_FIR_V10

config BOARD_X1000_FIR_V10
	bool "board x1000 fir v10"
	depends on PRODUCT_X1000_FIR

config BOARD_X1000_FIR_V20
	bool "board x1000 fir v20"
	depends on PRODUCT_X1000_FIR

endchoice

config BOARD_NAME
	string
	default "fir_v10" if BOARD_X1000_FIR_V10

config BOARD_NAME
	string
	default "fir_v20" if BOARD_X1000_FIR_V20
```
