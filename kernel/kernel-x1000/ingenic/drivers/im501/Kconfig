## kernel/kernel-x1000/ingenic/drivers/im501/Kconfig
```kconfig
config SPI_IM501
    tristate "FM IM501 SPI interface"
    help
        This selects im501 spi support.
```

## kernel/kernel-x1000/ingenic/drivers/leds/Kconfig
```kconfig
config RGB_LED
    bool "rgb led"
    help
        rgb led for doss board

config JZ_X01_LED
    bool "JZ X01 LED"
	select JZ_PWM
	select PWM
	select PWM_SYSFS
    default n
    help
        JZ X01 LED driver for usr interface
```

## kernel/kernel-x1000/ingenic/drivers/mic/Kconfig
```kconfig
menuconfig JZ_MICCHAR
	bool "MIC char support for Ingenic"
	depends on JZRISC && SOUND && SND && !SND_ASOC_INGENIC && HIGH_RES_TIMERS && DMA_ENGINE
	default n
	select SND_PCM
	help
		Say 'Y' to enable mic char drivers of xburst.

if JZ_MICCHAR

config	JZ_MICHAR_I2S
	bool
######################################
if JZ_MICHAR_I2S
config	JZ_MICCHAR_I2S_DEF_MCLK_RATE
	int "default mclk rate"
	default 12288000
config	JZ_MICCHAR_I2S_ICDC
	bool
config	JZ_MICCHAR_I2S_MASTER
	bool
config	JZ_MICCHAR_I2S_SLAVE
	bool
endif
########################################
choice
	prompt "mic char codec select"
	default JZ_MICCHAR_X1830_CODEC
config JZ_MICCHAR_X1830_CODEC
	bool "x1830 internal codec"
	select JZ_MICCHAR_I2S_ICDC
	select JZ_MICHAR_I2S
endchoice
######################################
config JZ_MICCHAR_WITH_SND_I2S
	bool "use i2s sound output"
	default y
if JZ_MICCHAR_WITH_SND_I2S
choice
	prompt "sound out codec select"
	default JZ_MICCHAR_SND_USB_ICDC
config JZ_MICCHAR_SND_USB_ICDC
	bool "internal codec"
endchoice
endif  #JZ_MICCHAR_WITH_SND_I2S
######################################
endif  #JZ_MICCHAR
```

## kernel/kernel-x1000/ingenic/for_module/Kconfig
```kconfig
menuconfig INGENIC_MODULE
	bool "options for module drivers"
	default n
	help
		say Y if you have module drivers

if INGENIC_MODULE

config INGENIC_MODULE_FB
    bool "select fb drivers for module"
    default n
    select FB
    select FB_CFB_FILLRECT
    select FB_CFB_COPYAREA
    select FB_CFB_IMAGEBLIT

endif
```

## kernel/kernel-x1000/ingenic/x1520/Kconfig
```kconfig
menuconfig SOC_X1520_DRIVERS
    tristate "X1520 drivers&boards"
    depends on SOC_X1520
    help
        x1520 drivers & boards

source "ingenic/x1520/boards/Kconfig"
source "ingenic/x1520/Kconfig.gpiofunc"

config X1520_MIC
    bool "x1520 mic driver"
    help
        X1520 mic driver

config X1520_MIC_SND_INTERNAL_CODEC
     bool "x1520 snd internal codec"
     help
        x1520 internal codec with alsa in mic driver
```

## kernel/kernel-x1000/ingenic/x1520/Kconfig.gpiofunc
```kconfig
comment "X1520 gpio funcion fin select"

menu "PWM function pin select"
	depends on JZ_PWM

config JZ_PWM0
	bool "JZ_PWM0"
	depends on JZ_PWM

config JZ_PWM1
	bool "JZ_PWM1"
	depends on JZ_PWM

endmenu	#PWM function pin select
```

## kernel/kernel-x1000/ingenic/x1520/boards/Kconfig
```kconfig
choice
	prompt "Platform Type"
	depends on SOC_X1520_DRIVERS
	default PLATFORM_SCANNER

config PLATFORM_SCANNER
	bool "scanner"

config PLATFORM_X1520_MODULE_BASE
	bool "module base"

endchoice

if PLATFORM_SCANNER
source "ingenic/x1520/boards/scanner/Kconfig"
endif

if PLATFORM_X1520_MODULE_BASE
source "ingenic/x1520/boards/module_base/Kconfig"
endif

config PLATFORM_NAME
	string
	default "scanner" if PLATFORM_SCANNER
	default "module_base" if PLATFORM_X1520_MODULE_BASE
```

## kernel/kernel-x1000/ingenic/x1520/boards/module_base/Kconfig
```kconfig
choice
	prompt "Board type"
	depends on SOC_X1520_DRIVERS
	default BOARD_1520_MODULE_BASE0

config BOARD_1520_MODULE_BASE0
       bool "board0(ingenic test version)"

endchoice

config BOARD_NAME
	string
	default "board0" if BOARD_1520_MODULE_BASE0
config PRODUCT_NAME
	string
	default "board0" if BOARD_1520_MODULE_BASE0
```

## kernel/kernel-x1000/ingenic/x1520/boards/scanner/Kconfig
```kconfig
choice
	prompt "Board type"
	depends on SOC_X1520_DRIVERS
	default BOARD_SNIPER_V10

config BOARD_SNIPER_V10
       bool "sniper-v10(x1520)"

endchoice

config BOARD_NAME
	string
	default "sniper-v10" if BOARD_SNIPER_V10
config PRODUCT_NAME
	string
	default "sniper" if BOARD_SNIPER_V10
```

## kernel/kernel-x1000/ingenic/x1830/Kconfig
```kconfig
menuconfig SOC_X1830_DRIVERS
    tristate "X1830 drivers&boards"
    depends on SOC_X1830
    help
        x1830 drivers & boards

source "ingenic/x1830/Kconfig.gpiofunc"
source "ingenic/x1830/boards/Kconfig"

config x1800_MIC
    bool "x1800 mic driver"
    help
        x1800 mic driver
if x1800_MIC
choice
	prompt "choice dmic data"
	default DMIC_DATA_DOUBLE
	config DMIC_DATA_DOUBLE
		bool "dmic data_double"
	config DMIC_DATA0
		bool "dmic data0"
	config DMIC_DATA1
		bool "dmic data1"
endchoice
endif


config X1800_MIC_SND_INTERNAL_CODEC
     bool "x1800 snd internal codec"
     depends on x1800_MIC
     help
        x1800 internal codec with alsa in mic driver
```

## kernel/kernel-x1000/ingenic/x1830/Kconfig.gpiofunc
```kconfig
comment "X1830 gpio funcion fin select"

menu "PWM function pin select"
	depends on JZ_PWM

config PWM_CH0_FUNC
	bool "pwm0 func pin select"
	default n
if PWM_CH0_FUNC
choice
	prompt "pwm0"
	default JZ_PWM_GPIO_PC11
config JZ_PWM_GPIO_PC11
	bool "gpc11"
config JZ_PWM_GPIO_PB17
	bool "gpb17"
endchoice
endif	#PWM_CH0_FUNC

config PWM_CH1_FUNC
	bool "pwm1 func pin select"
	default n
if PWM_CH1_FUNC
choice
	prompt "pwm1"
	default JZ_PWM_GPIO_PC12
config JZ_PWM_GPIO_PC12
	bool "gpc12"
config JZ_PWM_GPIO_PB18
	bool "gpb18"
endchoice
endif	#PWM_CH1_FUNC

config PWM_CH2_FUNC
	bool "pwm2 func pin select"
	default n
if PWM_CH2_FUNC
choice
	prompt "pwm2"
	default JZ_PWM_GPIO_PC13
config JZ_PWM_GPIO_PC13
	bool "gpc13"
config JZ_PWM_GPIO_PC8
	bool "gpc8"
endchoice
endif	#PWM_CH2_FUNC

config PWM_CH3_FUNC
	bool "pwm3 func pin select"
	default n
if PWM_CH3_FUNC
choice
	prompt "pwm3"
	default JZ_PWM_GPIO_PC14
config JZ_PWM_GPIO_PC14
	bool "gpc14"
config JZ_PWM_GPIO_PC9
	bool "gpc9"
endchoice
endif	#PWM_CH3_FUNC

config PWM_CH4_FUNC
	bool "pwm4 func pin select"
	default n
if PWM_CH4_FUNC
choice
	prompt "pwm4"
	default JZ_PWM_GPIO_PC15
config JZ_PWM_GPIO_PC15
	bool "gpc15"
config JZ_PWM_GPIO_PC25
	bool "gpc10"
endchoice
endif	#PWM_CH4_FUNC

config PWM_CH5_FUNC
	bool "pwm5 func pin select"
	default n
if PWM_CH5_FUNC
choice
	prompt "pwm5"
	default JZ_PWM_GPIO_PC16
config JZ_PWM_GPIO_PC16
	bool "gpc16"
config JZ_PWM_GPIO_PC26
	bool "gpc26"
endchoice
endif	#PWM_CH5_FUNC

config PWM_CH6_FUNC
	bool "pwm6 func pin select"
	default n
if PWM_CH6_FUNC
choice
	prompt "pwm6"
	default JZ_PWM_GPIO_PC17
config JZ_PWM_GPIO_PC17
	bool "gpc17"
config JZ_PWM_GPIO_PC27
	bool "gpc27"
endchoice
endif	#PWM_CH6_FUNC

config PWM_CH7_FUNC
	bool "pwm7 func pin select"
	default n
if PWM_CH7_FUNC
choice
	prompt "pwm7"
	default JZ_PWM_GPIO_PC18
config JZ_PWM_GPIO_PC18
	bool "gpc18"
config JZ_PWM_GPIO_PC28
	bool "gpc28"
endchoice
endif	#PWM_CH7_FUNC
endmenu	#PWM function pin select
```

## kernel/kernel-x1000/ingenic/x1830/boards/Kconfig
```kconfig
choice
	prompt "Platform Type"
	depends on SOC_X1830_DRIVERS
	default PLATFORM_AUDIO

config PLATFORM_AUDIO
	bool	"audio"

config PLATFORM_DARWIN
	bool	"darwin"

config PLATFORM_BASE
	bool    "base"

endchoice

if PLATFORM_AUDIO
source "ingenic/x1830/boards/audio/Kconfig"
endif

if PLATFORM_DARWIN
source "ingenic/x1830/boards/darwin/Kconfig"
endif

if PLATFORM_BASE
source "ingenic/x1830/boards/base/Kconfig"
endif

config PLATFORM_NAME
	string
	default "audio" if PLATFORM_AUDIO
	default "darwin" if PLATFORM_DARWIN
	default "base" if PLATFORM_BASE
```

## kernel/kernel-x1000/ingenic/x1830/boards/audio/Kconfig
```kconfig
choice
	prompt "Board type"
	depends on SOC_X1830_DRIVERS
	default BOARD_AUDIO

config BOARD_AUDIO
	bool	"audio-30 (x1830)"

config BOARD_SUNING_ALARM
	bool	"suning-alarm (x1830)"

config BOARD_MINIS1_BOX_V2
	bool	"miniS1-box-v2 (x1830)"

config BOARD_X1830_IM501_DEVEL
	bool	"im501 development board (x1830)"

config BOARD_X1830_HUAZHEN_IM501
	bool	"huazhen im501 board (x1830)"

endchoice

config BOARD_NAME
	string
	default "audio-30" if BOARD_AUDIO
	default "suning-alarm" if BOARD_SUNING_ALARM
	default "miniS1-box-v2" if BOARD_MINIS1_BOX_V2
	default "im501-devel" if BOARD_X1830_IM501_DEVEL
	default "huazhen-im501" if BOARD_X1830_HUAZHEN_IM501

config PRODUCT_NAME
	string
	default "audio" if BOARD_AUDIO
	default "suning-alarm" if BOARD_SUNING_ALARM
	default "miniS1-box-v2" if BOARD_MINIS1_BOX_V2
	default "huazhen-im501" if BOARD_X1830_HUAZHEN_IM501
```

## kernel/kernel-x1000/ingenic/x1830/boards/base/Kconfig
```kconfig
choice
	prompt "Board type"
	depends on SOC_X1830_DRIVERS
	default BOARD_BASE

config BOARD_BASE
	bool	"base board"

endchoice

config BOARD_NAME
	string
	default "base" if BOARD_BASE

config PRODUCT_NAME
	string
	default "base" if BOARD_BASE
```

## kernel/kernel-x1000/ingenic/x1830/boards/darwin/Kconfig
```kconfig
choice
	prompt "Board type"
	depends on SOC_X1830_DRIVERS
	default BOARD_HAWK_V10

config BOARD_HAWK_V12
	bool	"hawk-v12 (x1830)"

config BOARD_HAWK_V10
	bool	"hawk-v10 (x1830)"

config BOARD_HAWK_V00
	bool	"hawk-v00 (x1830)"

config BOARD_MOTO_V10
	bool	"moto-v10 (x1830)"

config BOARD_ZNMOTO_V10
	bool	"znmoto-v10 (x1830)"


endchoice

config BOARD_NAME
	string
	default "hawk-v12" if BOARD_HAWK_V12
	default "hawk-v10" if BOARD_HAWK_V10
	default "hawk-v00" if BOARD_HAWK_V00
	default "moto-v10" if BOARD_MOTO_V10
	default "znmoto-v10" if BOARD_ZNMOTO_V10

config PRODUCT_NAME
	string
	default "hawk-v12" if BOARD_HAWK_V12
	default "hawk-v10" if BOARD_HAWK_V10
	default "hawk-v00" if BOARD_HAWK_V00
	default "moto-v10" if BOARD_MOTO_V10
	default "znmoto-v10" if BOARD_ZNMOTO_V10
```
